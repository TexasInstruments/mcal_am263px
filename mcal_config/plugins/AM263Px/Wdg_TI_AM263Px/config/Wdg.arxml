AUTOSAR XML (schema 00044)
package /TI_AM263Px
  module definition Wdg: refined-module-def=Wdg, variants link-time/post-build/pre-compile  # Configuration of the Wdg (Watchdog driver) module.
    container WdgDemEventParameterRefs [0..1]  # Container for the references to DemEventParameter elements which shall be invoked using the API Dem_ReportErrorStatus in case the corresponding error occurs. The EventId is taken from the referenced DemEventParameter's DemEventId value.
      symbolic name reference WDG_E_DISABLE_REJECTED [0..1]: multiplicity set at pre-compile, set at pre-compile, destination=DemEventParameter  # Reference to the DemEventParameter which shall be issued when the error "Initialization or mode switch failed because it would disable the watchdog" has occurred.
      symbolic name reference WDG_E_MODE_FAILED [0..1]: multiplicity set at pre-compile, set at pre-compile, destination=DemEventParameter  # Reference to the DemEventParameter which shall be issued when the error "Setting a watchdog mode failed (during initialization or mode switch)" has occurred.
      symbolic name reference WDG_E_HARDWARE_ERROR [0..1]: multiplicity set at pre-compile, origin=Texas Instruments, set at pre-compile, destination=DemEventParameter  # Reference to the DemEventParameter which shall be issued when the error "Timeout on blocking API call occurs " has occurred.
    container WdgGeneral  # All general parameters of the watchdog driver are collected here.
      boolean WdgDevErrorDetect: set at pre-compile, default-value=true  # Compile switch to enable / disable development error detection for this module.
      boolean WdgDisableAllowed: set at pre-compile, default-value=false  # Compile switch to allow / forbid disabling the watchdog driver during runtime.
      integer WdgIndex: 0..255, set at pre-compile, symbolic-name-value=true, default-value=0  # Represents the watchdog driver's ID so that it can be referenced by the watchdog interface.
      float WdgInitialTimeout: 0.0..65.535, set at pre-compile, default-value=1.0  # The initial timeout (seconds) for the trigger condition to be initialized during Init function. It shall be not larger than WdgMaxTimeout.
      float WdgMaxTimeout: 0.0..65.535, set at pre-compile, default-value=65.535  # The maximum timeout (seconds) to which the watchdog trigger condition can be initialized.
      enumeration WdgWindowSize: {WINDOW_SIZE_3_125_PERCENT, WINDOW_SIZE_6_25_PERCENT, WINDOW_SIZE_12_5_PERCENT, WINDOW_SIZE_25_PERCENT, WINDOW_SIZE_50_PERCENT, WINDOW_SIZE_100_PERCENT}, origin=Texas Instruments, set at post-build, default-value=WINDOW_SIZE_100_PERCENT  # The Digital Windowed Watchdog window size. Selecting 100% enables standard watchdod (not windowed)
      enumeration WdgRunArea: {RAM, ROM}, set at pre-compile, default-value=RAM  # Represents the watchdog driver execution area is either from ROM(Flash) or RAM as required with the particular microcontroller.
      function name WdgTriggerLocation: set at pre-compile, default-value=NULL_PTR  # Location (memory address) of the watchdog trigger routine.
      boolean WdgVersionInfoApi: set at pre-compile, default-value=true  # Compile switch to enable / disable the version information API
      boolean WdgRegisterReadbackApi: origin=Texas Instruments, set at pre-compile, default-value=false  # Compile switch to enable / disable the Register Readback API
      integer WdgRtiFrequency: 0..200, origin=Texas Instruments, set at pre-compile, default-value=200  # RTI Clock Frequency (MHz)
      boolean WdgSkipForceReset: origin=Texas Instruments, set at pre-compile, default-value=false  # Compile switch to enable / disable skipping force reset of WDG when 0 timeout is passed in Wdg_SetTriggerCondition
    container WdgPublishedInformation  # Container holding all Wdg specific published information parameters
      enumeration WdgTriggerMode: {WDG_BOTH, WDG_TOGGLE, WDG_WINDOW}, set at published-information, default-value=WDG_WINDOW  # Watchdog trigger mode (toggle/window/both)
      enumeration WdgDeviceVariant [0..1]: {AM263Px}, multiplicity set at published-information, origin=Texas Instruments, set at published-information, default-value=AM263Px  # Select SOC AM263Px variant
    container WdgSettingsConfig  # Configuration items for the different watchdog settings, including those for external watchdog hardware.
      enumeration WdgDefaultMode: {WDGIF_FAST_MODE, WDGIF_OFF_MODE, WDGIF_SLOW_MODE}, set at post-build, default-value=WDGIF_FAST_MODE  # Default mode for watchdog driver initialization.
      integer WdgInstanceId: 0..3, origin=Texas Instruments, set at post-build, default-value=0  # Watchdog HW instance id. 0 - R5FSS0 Core0, 1 - R5FSS0 Core1, 2 - R5FSS1 Core0, 3 - R5FSS1 Core1
      container WdgExternalConfiguration [0..1]  # Configuration items for an external watchdog hardware
        choice reference WdgExternalContainerRef [0..1]: multiplicity set at post-build, destination=[DioChannelGroup, SpiSequence]  # Reference to either
      container WdgSettingsFast  # Hardware dependent settings for the watchdog driver's "fast" mode.
        integer WdgPreloadValue: 0..4095, origin=Texas Instruments, set at pre-compile, default-value=4095  # Watchdog preload value to be set in RTIDWDPRLD register. Expiration time is calculated using this function: texp = (WdgPreloadValue + 1) x 2^13 / RTICLK1
        enumeration WdgReaction: {WDG_GENERATE_RESET, WDG_GENERATE_NMI}, origin=Texas Instruments, set at post-build, default-value=WDG_GENERATE_NMI  # Watchdog reaction for timer expiration or incorrect service.
        enumeration WdgWindowSize: {WINDOW_SIZE_3_125_PERCENT, WINDOW_SIZE_6_25_PERCENT, WINDOW_SIZE_12_5_PERCENT, WINDOW_SIZE_25_PERCENT, WINDOW_SIZE_50_PERCENT, WINDOW_SIZE_100_PERCENT}, origin=Texas Instruments, set at post-build, default-value=WINDOW_SIZE_100_PERCENT  # The Digital Windowed Watchdog window size. Selecting 100% enables standard watchdod (not windowed)
      container WdgSettingsOff [0..0]  # Hardware dependent settings for the watchdog driver's "off" mode.
      container WdgSettingsSlow  # Hardware dependent settings for the watchdog driver's "slow" mode.
        integer WdgPreloadValue: 0..4095, origin=Texas Instruments, set at pre-compile, default-value=4095  # Watchdog preload value to be set in RTIDWDPRLD register. Expiration time is calculated using this function: texp = (WdgPreloadValue + 1) x 2^13 / RTICLK1
        enumeration WdgReaction: {WDG_GENERATE_RESET, WDG_GENERATE_NMI}, origin=Texas Instruments, set at post-build, default-value=WDG_GENERATE_NMI  # Watchdog reaction for timer expiration or incorrect service.
        enumeration WdgWindowSize: {WINDOW_SIZE_3_125_PERCENT, WINDOW_SIZE_6_25_PERCENT, WINDOW_SIZE_12_5_PERCENT, WINDOW_SIZE_25_PERCENT, WINDOW_SIZE_50_PERCENT, WINDOW_SIZE_100_PERCENT}, origin=Texas Instruments, set at post-build, default-value=WINDOW_SIZE_100_PERCENT  # The Digital Windowed Watchdog window size. Selecting 100% enables standard watchdod (not windowed)
