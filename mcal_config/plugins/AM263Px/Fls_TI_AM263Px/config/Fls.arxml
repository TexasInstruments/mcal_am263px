AUTOSAR XML (schema 00044)
package /TI_AM263Px
  module definition Fls [0..*]: post-build-variant-support=true, refined-module-def=Fls, variants post-build/pre-compile  # Configuration of the Fls (internal or external flash driver) module.
    container FlsConfigSet  # Container for runtime configuration parameters of the flash driver.
      integer FlsAcErase: 0..4294967295, post-build-variant-value=true, set at post-build in variant post-build / pre-compile in variant pre-compile  # Address offset in RAM to which the erase flash access code shall be loaded. Currenly, Flash Access code Erase/Write functionality is not supported.
      integer OspiInstanceId: 0..0, origin=Texas Instruments, post-build-variant-value=true, set at post-build in variant post-build / pre-compile in variant pre-compile  # Instance Id of OSPI. In this variant only one is supported
      integer FlsAcWrite: 0..4294967295, post-build-variant-value=true, set at post-build in variant post-build / pre-compile in variant pre-compile  # Address offset in RAM to which the write flash access code shall be loaded. Currenly, Flash Access code Erase/Write functionality is not supported.
      float FlsCallCycle: 0.0..INF, post-build-variant-value=true, set at post-build in variant post-build / pre-compile in variant pre-compile, default-value=1.0  # Cycle time of calls of the flash driver's main function (in seconds).
      enumeration FlsDefaultMode: {MEMIF_MODE_FAST, MEMIF_MODE_SLOW}, post-build-variant-value=true, set at post-build in variant post-build / pre-compile in variant pre-compile, default-value=MEMIF_MODE_SLOW  # This parameter is the default FLS device mode after initialization. Currently, not supported as different modes are not available is Hardware.
      boolean FlsEnableDMA [0..1]: origin=Texas Instruments, set at pre-compile, default-value=false  # This parameter is used to specify if the flash read operation should occur using DMA. Only applicable in DAC mode.
      function name FlsJobEndNotification [0..1]: multiplicity set at post-build in variant post-build / pre-compile in variant pre-compile, post-build-variant-multiplicity=true, post-build-variant-value=true, set at post-build in variant post-build / pre-compile in variant pre-compile  # Mapped to the job end notification routine provided by some upper layer module, typically the Fee module.
      function name FlsJobErrorNotification [0..1]: multiplicity set at post-build in variant post-build / pre-compile in variant pre-compile, post-build-variant-multiplicity=true, post-build-variant-value=true, set at post-build in variant post-build / pre-compile in variant pre-compile  # Mapped to the job error notification routine provided by some upper layer module, typically the Fee module.
      integer FlsMaxReadFastMode: 0..4294967295, post-build-variant-value=true, set at post-build in variant post-build / pre-compile in variant pre-compile, default-value=768  # The maximum number of bytes to read or compare in one cycle of the flash driver's job processing function in fast mode. Currenly not supported as different modes are not available in hardware.
      integer FlsMaxReadNormalMode: 0..4294967295, post-build-variant-value=true, set at post-build in variant post-build / pre-compile in variant pre-compile, default-value=768  # The maximum number of bytes to read or compare in one cycle of the flash driver's job processing function in normal mode.
      integer FlsMaxWriteFastMode: 0..4294967295, post-build-variant-value=true, set at post-build in variant post-build / pre-compile in variant pre-compile, default-value=256  # The maximum number of bytes to write in one cycle of the flash driver's job processing function in fast mode. Currenly not supported as different modes are not available in hardware.
      integer FlsMaxWriteNormalMode: 0..4294967295, post-build-variant-value=true, set at post-build in variant post-build / pre-compile in variant pre-compile, default-value=768  # The maximum number of bytes to write in one cycle of the flash driver's job processing function in normal mode.
      integer FlsProtection: 0..4294967295, post-build-variant-value=true, set at post-build in variant post-build / pre-compile in variant pre-compile  # Erase/write protection settings. Only relevant if supported by hardware. Currently, not supported by Hardware.
      integer FlsBaudRateDiv: 0..4294967295, origin=Texas Instruments, set at post-build in variant post-build / pre-compile in variant pre-compile  # To Select the baud rate divider values
      enumeration FlsProtocol: {FLS_1S_1S_1S, FLS_1S_1S_2S, FLS_1S_1S_4S, FLS_1S_1S_8S, FLS_4S_4S_4S, FLS_4S_4D_4D, FLS_8S_8S_8S, FLS_8D_8D_8D}, origin=Texas Instruments, post-build-variant-value=true, set at post-build in variant post-build / pre-compile in variant pre-compile, default-value=FLS_8D_8D_8D  # This parameter is used to select different modes for command, address and data transfer. First parameter denotes number of lines to transfer command, second parameter denotes number of lines to transfer address and third parameter denotes data lines S(Single) and D(Dual) are used denote data rates
      boolean FlsDacEnable: origin=Texas Instruments, set at pre-compile, default-value=true  # The driver shall enable Direct Access Mode for OSPI.
      integer FlsOspiClkSpeed: origin=Texas Instruments, set at pre-compile, default-value=133333333  # The driver shall specify the OSPI Clk speed to be used.
      boolean FlsPhyEnable: origin=Texas Instruments, set at pre-compile, default-value=false  # The driver shall enable Phy Speed mode for DAC.
      reference FlsHwUnitCddDmaHandler [0..1]: multiplicity set at pre-compile, origin=Texas Instruments, set at pre-compile, destination=CddDmaDriverHandler  # Configures the Cdd Dma handler used for FLS transmission
      container FlsExternalDriver [0..1]  # This container is present for external Flash drivers only. Internal Flash drivers do not use the parameter listed in this container, hence its multiplicity is 0 for internal drivers. Currently, not supported as only one external driver present.
        symbolic name reference FlsSpiReference [1..*]: multiplicity set at pre-compile, set at pre-compile, destination=SpiSequence  # Reference to SPI sequence (required for external Flash drivers).
      container FlsSectorList  # List of flashable sectors and pages.The maximum number of sectors/sector size/pages/pagesize that can be configured, is based on external flash used, and care must be taken to configure these parameters as per the external flash used
        container FlsSector [1..*]  # Configuration description of a flashable sector
          integer FlsNumberOfSectors: 0..65535, set at pre-compile, default-value=32  # Number of continuous sectors with identical configuration
          integer FlsPageSize: 0..4294967295, set at pre-compile, default-value=256  # Size of one page of this sector.
          integer FlsSectorSize: 0..4294967295, set at pre-compile, default-value=4096  # Size of this sector.
          integer FlsSectorStartaddress: 0..4294967295, set at pre-compile, default-value=0  # Start address of this sector.
    container FlsGeneral  # Container for general parameters of the flash driver. These parameters are always pre-compile.
      boolean FlsAcLoadOnJobStart: set at pre-compile, default-value=false  # The flash driver shall load the flash access code to RAM whenever an erase or write job is started and unload (overwrite) it after that job has been finished or canceled.
      integer FlsBaseAddress: 0..4294967295, set at pre-compile, default-value=1610612736  # The flash memory start address (see also SWS_Fls_00208 and SWS_Fls_00209).
      boolean FlsBlankCheckApi: set at pre-compile, default-value=false  # Compile switch to enable/disable the Fls_BlankCheck function.
      boolean FlsCancelApi: set at pre-compile  # Compile switch to enable and disable the Fls_Cancel function. Cancel API currently not supported.
      boolean FlsCompareApi: set at pre-compile  # Compile switch to enable and disable the Fls_Compare function.
      boolean FlsDevErrorDetect: set at pre-compile, default-value=false  # Switches the development error detection and notification on or off.
      integer FlsDriverIndex: 0..254, scope=ECU, set at pre-compile, symbolic-name-value=true  # Index of the driver, used by FEE.
      boolean FlsEraseVerificationEnabled: set at pre-compile, default-value=true  # Compile switch to enable erase verification. Currently not supported.
      boolean FlsGetJobResultApi: set at pre-compile  # Compile switch to enable and disable the Fls_GetJobResult function.
      boolean FlsGetStatusApi: set at pre-compile  # Compile switch to enable and disable the Fls_GetStatus function.
      boolean FlsSetModeApi: set at pre-compile  # Compile switch to enable and disable the Fls_SetMode function. Not relevant as only one mode supported.
      boolean FlsTimeoutSupervisionEnabled: set at pre-compile, default-value=false  # Compile switch to enable timeout supervision. Currently, not supported.
      integer FlsTotalSize: 0..4294967295, set at pre-compile, default-value=16777215  # The total amount of flash memory in bytes (see also SWS_Fls_00208 and SWS_Fls_00209).
      boolean FlsUseInterrupts: set at pre-compile, default-value=false  # Job processing triggered by hardware interrupt.
      boolean FlsVersionInfoApi: set at pre-compile, default-value=false  # Pre-processor switch to enable / disable the API to read out the modules version information.
      boolean FlsWriteVerificationEnabled: set at pre-compile, default-value=true  # Compile switch to enable write verification. Currenly, not supported.
      integer FlsOspiCtrlBaseAddr: 1..4294967295, origin=Texas Instruments, set at pre-compile, default-value=1400930304  # This parameter used to select the OSPI base Address
      enumeration FlsIrqType: {FLS_ISR_VOID, FLS_ISR_CAT1, FLS_ISR_CAT2}, origin=Texas Instruments, set at pre-compile, default-value=FLS_ISR_CAT1  # Type of Isr function: void functionname(void) CAT1 see description in oil tool : interrupt void func(void) CAT2 see description in oil tool : ISR(func)
      integer FlsDefaultOSCounterId: 0..16, origin=Texas Instruments, set at pre-compile, default-value=0  # Default Os Counter Id if node reference to OsCounter ref FlsOsCounterRef is not set
      reference FlsOsCounterRef [0..1]: origin=Texas Instruments, set at pre-compile, destination=OsCounter  # This parameter contains a reference to the OsCounter, which is used by the FLS driver.
    container FlsPublishedInformation  # Additional published parameters not covered by CommonPublishedInformation container.
      integer FlsAcLocationErase: 0..4294967295, set at published-information, default-value=0  # Position in RAM, to which the erase flash access code has to be loaded.
      integer FlsAcLocationWrite: 0..4294967295, set at published-information, default-value=0  # Position in RAM, to which the write flash access code has to be loaded.
      integer FlsAcSizeErase: 0..4294967295, set at published-information, default-value=0  # Number of bytes in RAM needed for the erase flash access code.
      integer FlsAcSizeWrite: 0..4294967295, set at published-information, default-value=0  # Number of bytes in RAM needed for the write flash access code.
      integer FlsErasedValue: 0..4294967295, set at published-information, default-value=255  # The contents of an erased flash memory cell.
      float FlsEraseTime: 0.0..INF, set at published-information, default-value=1000.0  # Maximum time to erase one complete flash sector.
      string FlsExpectedHwId: set at published-information, default-value=23322  # Unique identifier of the hardware device that is expected by this driver (the device for which this driver has been implemented).
      integer FlsSpecifiedEraseCycles: 0..4294967295, set at published-information, default-value=0  # Number of erase cycles specified for the flash device (usually given in the device data sheet).
      float FlsWriteTime: 0.0..INF, set at published-information, default-value=1000.0  # Maximum time to program one complete flash page.
      enumeration FlsDeviceVariant [0..1]: {AM263Px}, origin=Texas Instruments, set at published-information, default-value=AM263Px  # Select required Device Variant.
