AUTOSAR XML (schema 00044)
package /TI_AM263Px
  module definition Cdd_FsiTx [0..1]: post-build-variant-support=true, variants post-build/pre-compile  # Configuration of the Cdd Fsi Tx (Fast serial Interface -Transmitter) module.
    container CddFsiTxConfigSet  # This container contains the configuration parameters and sub containers of the AUTOSAR Cdd Fsi Tx module.
      function name CddFsiTxNotification [0..1]: multiplicity set at post-build in variant post-build / pre-compile in variant pre-compile, origin=Texas Instruments, post-build-variant-value=true, set at post-build in variant post-build / pre-compile in variant pre-compile, default-value=NULL_PTR  # Callback function for Transmission
      function name CddFsiTxOverRunNotification [0..1]: multiplicity set at post-build in variant post-build / pre-compile in variant pre-compile, origin=Texas Instruments, post-build-variant-value=true, set at post-build in variant post-build / pre-compile in variant pre-compile, default-value=NULL_PTR  # Callback function for Tx Buffer OverRun
      function name CddFsiTxUnderRunNotification [0..1]: multiplicity set at post-build in variant post-build / pre-compile in variant pre-compile, origin=Texas Instruments, post-build-variant-value=true, set at post-build in variant post-build / pre-compile in variant pre-compile, default-value=NULL_PTR  # Callback function for Tx Buffer UnderRun
      container CddFsiTxHwUnit [1..*]  # This container contains the Driver configuration (parameters) depending on which FSI Hw unit is get configured
        enumeration CddFsiTxHwUnitId: {CDD_FSI_TX_HWUNIT_0, CDD_FSI_TX_HWUNIT_1, CDD_FSI_TX_HWUNIT_2, CDD_FSI_TX_HWUNIT_3}, origin=Texas Instruments, post-build-variant-value=true, set at post-build in variant post-build / pre-compile in variant pre-compile, default-value=CDD_FSI_TX_HWUNIT_0  # Description: Numeric ID of the HW Unit. This symbolic name allows accessing Fsi Hw Unit data. Enumeration literals are defined vendor specific. Number of instances can vary depending on SOC variant.Corresponding error checks are added in template files
        enumeration CddFsiTxPrescale: {CDD_FSI_TX_CLK_DIV_1, CDD_FSI_TX_CLK_DIV_2, CDD_FSI_TX_CLK_DIV_3, CDD_FSI_TX_CLK_DIV_4, CDD_FSI_TX_CLK_DIV_5, CDD_FSI_TX_CLK_DIV_10, CDD_FSI_TX_CLK_DIV_20}, origin=Texas Instruments, post-build-variant-value=true, set at post-build in variant post-build / pre-compile in variant pre-compile, default-value=CDD_FSI_TX_CLK_DIV_2  # Selects the Prescale value .
        integer CddFsiTxPingTimerTimeout [0..1]: 0..4294967295, origin=Texas Instruments, post-build-variant-multiplicity=true, post-build-variant-value=true, set at post-build in variant post-build / pre-compile in variant pre-compile, default-value=20000  # Timeout value for CddFsiTx Ping Timer.
        enumeration CddFsiTxTriggerSrc: {CDD_FSI_TX_TRIGG_SRC_SW, CDD_FSI_TX_TRIGG_SRC_HW}, origin=Texas Instruments, post-build-variant-value=true, set at post-build in variant post-build / pre-compile in variant pre-compile, default-value=CDD_FSI_TX_TRIGG_SRC_SW  # Type of source event that starts a transmission.
        enumeration CddFsiTxTransmissionMethod [0..1]: {CDD_FSI_TX_INTERRUPT_MODE, CDD_FSI_TX_POLLING_MODE, CDD_FSI_TX_DMA_MODE}, origin=Texas Instruments, post-build-variant-multiplicity=true, post-build-variant-value=true, set at post-build in variant post-build / pre-compile in variant pre-compile, default-value=CDD_FSI_TX_INTERRUPT_MODE  # Selects the method of frame transmission.
        enumeration CddFsiTxExtHwTrigSrc [0..1]: {CDD_FSI_TX_TRIGGER_FSI_RX_PING_FRAME_TAG_MATCH, CDD_FSI_TX_TRIGGER_FSI_RX_ERROR_FRAME_TAG_MATCH, CDD_FSI_TX_TRIGGER_FSI_RX_DATA_FRAME_TAG_MATCH, CDD_FSI_TX_TRIGGER_FSI_RX_TRIG0, CDD_FSI_TX_TRIGGER_FSI_RX_TRIG1, CDD_FSI_TX_TRIGGER_FSI_RX_TRIG2, CDD_FSI_TX_TRIGGER_FSI_RX_TRIG3, CDD_FSI_TX_TRIGGER_EPWM0_SOCB, CDD_FSI_TX_TRIGGER_EPWM1_SOCB, CDD_FSI_TX_TRIGGER_EPWM2_SOCB, CDD_FSI_TX_TRIGGER_EPWM3_SOCB, CDD_FSI_TX_TRIGGER_EPWM4_SOCB, CDD_FSI_TX_TRIGGER_EPWM5_SOCB, CDD_FSI_TX_TRIGGER_EPWM6_SOCB, CDD_FSI_TX_TRIGGER_EPWM7_SOCB, CDD_FSI_TX_TRIGGER_EPWM8_SOCB, CDD_FSI_TX_TRIGGER_EPWM9_SOCB, CDD_FSI_TX_TRIGGER_EPWM10_SOCB, CDD_FSI_TX_TRIGGER_EPWM11_SOCB, CDD_FSI_TX_TRIGGER_EPWM12_SOCB, CDD_FSI_TX_TRIGGER_EPWM13_SOCB, CDD_FSI_TX_TRIGGER_EPWM14_SOCB, CDD_FSI_TX_TRIGGER_EPWM15_SOCB, CDD_FSI_TX_TRIGGER_EPWM16_SOCB, CDD_FSI_TX_TRIGGER_EPWM17_SOCB, CDD_FSI_TX_TRIGGER_EPWM18_SOCB, CDD_FSI_TX_TRIGGER_EPWM19_SOCB, CDD_FSI_TX_TRIGGER_EPWM20_SOCB, CDD_FSI_TX_TRIGGER_EPWM21_SOCB, CDD_FSI_TX_TRIGGER_EPWM22_SOCB, CDD_FSI_TX_TRIGGER_EPWM23_SOCB, CDD_FSI_TX_TRIGGER_ICSM_PORT0_16, CDD_FSI_TX_TRIGGER_ICSM_PORT0_17, CDD_FSI_TX_TRIGGER_ICSM_PORT0_18, CDD_FSI_TX_TRIGGER_ICSM_PORT0_19, CDD_FSI_TX_TRIGGER_ICSM_PORT1_16, CDD_FSI_TX_TRIGGER_ICSM_PORT1_17, CDD_FSI_TX_TRIGGER_ICSM_PORT1_18, CDD_FSI_TX_TRIGGER_ICSM_PORT1_19, CDD_FSI_TX_TRIGGER_OUTPUTXBAR_OUT0, CDD_FSI_TX_TRIGGER_OUTPUTXBAR_OUT1, CDD_FSI_TX_TRIGGER_OUTPUTXBAR_OUT2, CDD_FSI_TX_TRIGGER_OUTPUTXBAR_OUT3, CDD_FSI_TX_TRIGGER_OUTPUTXBAR_OUT4, CDD_FSI_TX_TRIGGER_OUTPUTXBAR_OUT5, CDD_FSI_TX_TRIGGER_OUTPUTXBAR_OUT6, CDD_FSI_TX_TRIGGER_OUTPUTXBAR_OUT7, CDD_FSI_TX_TRIGGER_OUTPUTXBAR_OUT8, CDD_FSI_TX_TRIGGER_OUTPUTXBAR_OUT9, CDD_FSI_TX_TRIGGER_OUTPUTXBAR_OUT10, CDD_FSI_TX_TRIGGER_OUTPUTXBAR_OUT11, CDD_FSI_TX_TRIGGER_OUTPUTXBAR_OUT12, CDD_FSI_TX_TRIGGER_OUTPUTXBAR_OUT13, CDD_FSI_TX_TRIGGER_OUTPUTXBAR_OUT14, CDD_FSI_TX_TRIGGER_OUTPUTXBAR_OUT15}, origin=Texas Instruments, post-build-variant-value=true, set at post-build in variant post-build / pre-compile in variant pre-compile, default-value=CDD_FSI_TX_TRIGGER_FSI_RX_TRIG0  # Configure the external trigger source for data frame and data frame
        enumeration CddFsiTxExtPingTrigSrc [0..1]: {CDD_FSI_TX_TRIGGER_FSI_RX_PING_FRAME_TAG_MATCH, CDD_FSI_TX_TRIGGER_FSI_RX_ERROR_FRAME_TAG_MATCH, CDD_FSI_TX_TRIGGER_FSI_RX_DATA_FRAME_TAG_MATCH, CDD_FSI_TX_TRIGGER_FSI_RX_TRIG0, CDD_FSI_TX_TRIGGER_FSI_RX_TRIG1, CDD_FSI_TX_TRIGGER_FSI_RX_TRIG2, CDD_FSI_TX_TRIGGER_FSI_RX_TRIG3, CDD_FSI_TX_TRIGGER_EPWM0_SOCB, CDD_FSI_TX_TRIGGER_EPWM1_SOCB, CDD_FSI_TX_TRIGGER_EPWM2_SOCB, CDD_FSI_TX_TRIGGER_EPWM3_SOCB, CDD_FSI_TX_TRIGGER_EPWM4_SOCB, CDD_FSI_TX_TRIGGER_EPWM5_SOCB, CDD_FSI_TX_TRIGGER_EPWM6_SOCB, CDD_FSI_TX_TRIGGER_EPWM7_SOCB, CDD_FSI_TX_TRIGGER_EPWM8_SOCB, CDD_FSI_TX_TRIGGER_EPWM9_SOCB, CDD_FSI_TX_TRIGGER_EPWM10_SOCB, CDD_FSI_TX_TRIGGER_EPWM11_SOCB, CDD_FSI_TX_TRIGGER_EPWM12_SOCB, CDD_FSI_TX_TRIGGER_EPWM13_SOCB, CDD_FSI_TX_TRIGGER_EPWM14_SOCB, CDD_FSI_TX_TRIGGER_EPWM15_SOCB, CDD_FSI_TX_TRIGGER_EPWM16_SOCB, CDD_FSI_TX_TRIGGER_EPWM17_SOCB, CDD_FSI_TX_TRIGGER_EPWM18_SOCB, CDD_FSI_TX_TRIGGER_EPWM19_SOCB, CDD_FSI_TX_TRIGGER_EPWM20_SOCB, CDD_FSI_TX_TRIGGER_EPWM21_SOCB, CDD_FSI_TX_TRIGGER_EPWM22_SOCB, CDD_FSI_TX_TRIGGER_EPWM23_SOCB, CDD_FSI_TX_TRIGGER_ICSM_PORT0_16, CDD_FSI_TX_TRIGGER_ICSM_PORT0_17, CDD_FSI_TX_TRIGGER_ICSM_PORT0_18, CDD_FSI_TX_TRIGGER_ICSM_PORT0_19, CDD_FSI_TX_TRIGGER_ICSM_PORT1_16, CDD_FSI_TX_TRIGGER_ICSM_PORT1_17, CDD_FSI_TX_TRIGGER_ICSM_PORT1_18, CDD_FSI_TX_TRIGGER_ICSM_PORT1_19, CDD_FSI_TX_TRIGGER_OUTPUTXBAR_OUT0, CDD_FSI_TX_TRIGGER_OUTPUTXBAR_OUT1, CDD_FSI_TX_TRIGGER_OUTPUTXBAR_OUT2, CDD_FSI_TX_TRIGGER_OUTPUTXBAR_OUT3, CDD_FSI_TX_TRIGGER_OUTPUTXBAR_OUT4, CDD_FSI_TX_TRIGGER_OUTPUTXBAR_OUT5, CDD_FSI_TX_TRIGGER_OUTPUTXBAR_OUT6, CDD_FSI_TX_TRIGGER_OUTPUTXBAR_OUT7, CDD_FSI_TX_TRIGGER_OUTPUTXBAR_OUT8, CDD_FSI_TX_TRIGGER_OUTPUTXBAR_OUT9, CDD_FSI_TX_TRIGGER_OUTPUTXBAR_OUT10, CDD_FSI_TX_TRIGGER_OUTPUTXBAR_OUT11, CDD_FSI_TX_TRIGGER_OUTPUTXBAR_OUT12, CDD_FSI_TX_TRIGGER_OUTPUTXBAR_OUT13, CDD_FSI_TX_TRIGGER_OUTPUTXBAR_OUT14, CDD_FSI_TX_TRIGGER_OUTPUTXBAR_OUT15}, origin=Texas Instruments, post-build-variant-value=true, set at post-build in variant post-build / pre-compile in variant pre-compile, default-value=CDD_FSI_TX_TRIGGER_FSI_RX_TRIG0  # Configure the external trigger source for ping frame and data frame
        reference CddFsiTxDmaReference [0..1]: multiplicity set at post-build in variant post-build / pre-compile in variant pre-compile, origin=Texas Instruments, set at post-build in variant post-build / pre-compile in variant pre-compile, destination=CddDmaDriverHandler  # Reference to the DMA Group Channel
    container CddFsiTxGeneral  # General configuration (parameters) of the Cdd Fsi Tx Driver software module.
      boolean CddFsiTxDeInitApi: origin=Texas Instruments, set at pre-compile, default-value=true  # Adds / removes the service CddFsiTx_DeInit() from the code.
      boolean CddFsiTxTransmitApi: origin=Texas Instruments, set at pre-compile, default-value=false  # Enable/disable the service CddFsiTx_Transmit() from the code.
      boolean CddFsiTxEnableRegisterReadbackApi: origin=Texas Instruments, set at pre-compile, default-value=true  # Switch to indicate that the CddFsiTx_RegisterReadBack is supported
      boolean CddFsiTxDevErrorDetectApi: origin=Texas Instruments, set at pre-compile, default-value=true  # Switches the development error detection and notification on or off.
      boolean CddFsiTxPingApi: origin=Texas Instruments, set at pre-compile, default-value=false  # Enable/disable the service CddFsiTx_Ping() from the code.
      boolean CddFsiTxExtTriggerEnable: origin=Texas Instruments, set at pre-compile, default-value=false  # Enable/disable the service CddFsiTx_Ping() from the code..
      boolean CddFsiTxBuffLoadApi: origin=Texas Instruments, set at pre-compile, default-value=true  # Adds / removes the services CddFsiTx_BuffLoad() from the code.
      boolean CddFsiTxResetDriver: origin=Texas Instruments, set at pre-compile, default-value=true  # Adds / removes the service Cdd_FsiTx_ResetDriver() and from the code.
      enumeration CddFsiTxTypeofInterruptFunction: {CDD_FSI_TX_ISR_VOID, CDD_FSI_TX_ISR_CAT1, CDD_FSI_TX_ISR_CAT2}, origin=Texas Instruments, set at pre-compile, default-value=CDD_FSI_TX_ISR_CAT1  # Type of ISR function
      enumeration CddFsiTxInterruptVector: {CDD_FSI_TX_INT1, CDD_FSI_TX_INT2}, origin=Texas Instruments, set at pre-compile, default-value=CDD_FSI_TX_INT1  # Type of ISR function
      enumeration CddFsiTxDeviceVariant: {AM263Px}, origin=Texas Instruments, set at pre-compile, default-value=AM263Px  # Select SOC variant .This parameter shall be used by driver to impose device specific constraints. The user guide shall detail the device specific constraints
      integer CddFsiTxMaxHwUnitCount: 1..4, origin=Texas Instruments, set at pre-compile, default-value=1  # Maximum hw count across all hwunits configured
      boolean CddFsiTxNotifyCapability: origin=Texas Instruments, set at pre-compile, default-value=true  # Determines, if the notification mechanism (the functions to enable and disable the notifications) is available at runtime.
      boolean CddFsiTxBufferOverRunInterrupt: origin=Texas Instruments, set at pre-compile, default-value=true  # Enable/disable the Interrupt service for Tx Buffer OverRun.
      boolean CddFsiTxBufferUnderRunInterrupt: origin=Texas Instruments, set at pre-compile, default-value=true  # Enable/disable the Interrupt service for Tx Buffer UnderRun.
      boolean CddFsiTxPingTimeOutInterrupt: origin=Texas Instruments, set at pre-compile, default-value=true  # Enable/disable the Interrupt service for Ping Timeout.
      boolean CddFsiTxFrameDoneInterrupt: origin=Texas Instruments, set at pre-compile, default-value=true  # Enable/disable the Interrupt service for Tx Frame Done.
      boolean CddFsiTxMainApi: origin=Texas Instruments, set at pre-compile, default-value=true  # Adds / removes the service CddFsiTx_Main() and from the code.
      boolean CddFsiTxGetVersionInfoApi: origin=Texas Instruments, set at pre-compile, default-value=true  # Adds / removes the service CddFsiTx_GetVersionInfo() from the code.
      boolean CddFsiTxDMAEnable: origin=Texas Instruments, set at pre-compile, default-value=false  # Enables DMA Access method for CddFsiTx Transmission.
      boolean CddFsiTxMultiLaneEnable: origin=Texas Instruments, set at pre-compile, default-value=false  # Enables MultiLane Transmission for CddFsiTx.
      integer CddFsiTxMaxDmaChannelId: origin=Texas Instruments, set at published-information, default-value=63  # Number of actual DMA channels. This is of type published information and not editable
      integer CddFsiTxDefaultOSCounterId: 0..16, origin=Texas Instruments, set at pre-compile, default-value=0  # Default Os Counter Id if node reference to OsCounter ref CddFsiTxOsCounterRef is not set
      reference CddFsiTxOsCounterRef [0..1]: origin=Texas Instruments, set at pre-compile, destination=OsCounter  # This parameter contains a reference to the OsCounter, which is used by the CddFsiTx driver.
    container CddFsiTxDemEventParameterRefs [0..1]  # Container for the references to DemEventParameter elements which shall be invoked using the API Dem_ReportErrorStatus API in case the corresponding error occurs. The EventId is taken from the referenced DemEventParameter's DemEventId value. The standardized errors are provided in the container and can be extended by vendor specific error references
      symbolic name reference CDD_FSI_TX_E_BUFFER_UNDERRUN [0..1]: multiplicity set at pre-compile, origin=Texas Instruments, set at pre-compile, destination=DemEventParameter  # Reference to configured DEM event to report "Tx buffer underrun".
      symbolic name reference CDD_FSI_TX_E_BUFFER_OVERRUN [0..1]: multiplicity set at pre-compile, origin=Texas Instruments, set at pre-compile, destination=DemEventParameter  # Reference to configured DEM event to report "Tx buffer overrun".
    container CddFsiTxPublishedInformation  # Additional published parameters not covered by "Common" Published Information. Note that these parameters have "PUBLISHED-INFORMATION" configuration class setting, since they are published information.
      integer CddFsiTxMinPrescaleValue: origin=Texas Instruments, set at published-information, default-value=1  # Minimum value of Prescalar value that can be selected for Cdd Fsi. This is of type published information and not editable.
      integer CddFsiTxMaxPrescaleValue: origin=Texas Instruments, set at published-information, default-value=255  # Minimum value of Prescalar value that can be selected for Cdd Fsi. This is of type published information and not editable.
      integer CddFsiTxMaxNumTxModules: origin=Texas Instruments, set at published-information, default-value=4  # Number of Transmission modules in a FSI hw unit.This is a fixed value and can't be changed. This is of type published information and not editable
      integer CddFsiTxMaxHwChannelId: origin=Texas Instruments, set at published-information, default-value=2  # Number of actual HW channels for each Tx module. This is of type published information and not editable
      integer CddFsiTxMinHwChannelId: origin=Texas Instruments, set at published-information, default-value=1  # Number of actual HW channels for each Tx module. This is of type published information and not editable
