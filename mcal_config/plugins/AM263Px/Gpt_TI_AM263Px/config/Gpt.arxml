AUTOSAR XML (schema 00044)
package /TI_AM263Px
  module definition Gpt: refined-module-def=Gpt, variants post-build/pre-compile  # Configuration of the Gpt (General Purpose Timer) module.
    container GptChannelConfigSet: requires-index=true  # This container is the base of a Configuration Set which contains the configured GPT channels. This way, different configuration sets can be defined for post-build process.
      container GptChannelConfiguration [1..32]: requires-index=true  # Configuration of an individual GPT channel.
        integer GptChannelId: 0..31, scope=ECU, set at post-build in variant post-build / pre-compile in variant pre-compile, symbolic-name-value=true, default-value=0  # Channel Id of the GPT channel. This value will be assigned to the symbolic name derived of the GptChannelConfiguration container short name. Channel 0 -Channel 3 are associated with RTI Module 0, Channel 4 -Channel 7 are associated with RTI Module 1, Channel 8 -Channel 11 are associated with RTI Module 2, Channel 12 -Channel 15 are associated with RTI Module 3, Channel 16 -Channel 19 are associated with RTI Module 4, Channel 20 -Channel 23 are associated with RTI Module 5, Channel 24 -Channel 27 are associated with RTI Module 6, Channel 28 -Channel 31 are associated with RTI Module 7
        enumeration GptChannelMode: {GPT_CH_MODE_CONTINUOUS, GPT_CH_MODE_ONESHOT}, scope=ECU, set at post-build in variant post-build / pre-compile in variant pre-compile, default-value=GPT_CH_MODE_CONTINUOUS  # Specifies the behavior of the timer channel after the target time is reached.
        enumeration GptCounterBlkId: {GPT_RTI_COUNTER0, GPT_RTI_COUNTER1}, scope=ECU, origin=Texas Instruments, set at post-build in variant post-build / pre-compile in variant pre-compile, default-value=GPT_RTI_COUNTER1  # This is the Counter block ID for the RTI modules. Each RTI module has 2 counter blocks that are defined in this configuration parameter.
        float GptChannelTickFrequency [0..0]: 0.0..INF, scope=ECU, set at post-build in variant post-build / pre-compile in variant pre-compile, default-value=1.0  # Specifies the tick frequency of the timer channel in Hz.
        integer GptChannelTickValueMax [0..0]: 0..2147483647, scope=ECU, set at post-build in variant post-build / pre-compile in variant pre-compile, default-value=0  # Maximum value in ticks, the timer channel is able to count. With the next tick, the timer rolls over to zero.
        boolean GptEnableWakeup: set at post-build in variant post-build / pre-compile in variant pre-compile, default-value=false  # Enables wakeup capability of MCU for a channel.
        function name GptNotification [0..1]: multiplicity set at post-build in variant post-build / pre-compile in variant pre-compile, set at post-build in variant post-build / pre-compile in variant pre-compile, default-value=NULL_PTR  # Function pointer to callback function (for non-wakeup notification)
        reference GptChannelClkSrcRef [0..0]: set at post-build in variant post-build / pre-compile in variant pre-compile, destination=GptClockReferencePoint  # Reference to the GptClockReferencePoint from which the channel
        container GptWakeupConfiguration [0..1]  # Function pointer to callback function (for wakeup notification).
          symbolic name reference GptWakeupSourceRef: set at post-build in variant post-build / pre-compile in variant pre-compile, destination=EcuMWakeupSource  # In case the wakeup-capability is true this value is transmitted to the Ecu State Manager.
    container GptConfigurationOfOptApiServices  # This container contains all configuration switches for configuring optional API services of the GPT driver.
      boolean GptDeinitApi: set at pre-compile, default-value=true  # Adds / removes the service Gpt_DeInit() from the code.
      boolean GptEnableDisableNotificationApi: set at pre-compile, default-value=true  # Adds / removes the services Gpt_EnableNotification() and Gpt_DisableNotification from the code.
      boolean GptTimeElapsedApi: set at pre-compile, default-value=true  # Adds / removes the service Gpt_GetTimeElapsed() from the code
      boolean GptTimeRemainingApi: set at pre-compile, default-value=true  # Adds / removes the service Gpt_GetTimeRemaining() from the code.
      boolean GptVersionInfoApi: set at pre-compile, default-value=true  # Adds / removes the service Gpt_GetVersionInfo() from the code.
      boolean GptRegisterReadback: origin=Texas Instruments, set at pre-compile, default-value=false  # Adds / removes the service Gpt_ConfigRegReadBack() from the code.
      boolean GptWakeupFunctionalityApi: set at pre-compile, default-value=false  # Adds / removes the services Gpt_SetMode(), Gpt_EnableWakeup() Gpt_DisableWakeup() and Gpt_CheckWakeup() from the code.
    container GptDriverConfiguration  # This container contains the module-wide configuration (parameters) of the GPT Driver
      boolean GptDevErrorDetect: set at pre-compile, default-value=true  # Enables/Disables development error detection.
      boolean GptPredefTimer100us32bitEnable: scope=ECU, set at pre-compile, default-value=false  # Enables/disables the GPT Predef Timer 100us32bit.
      enumeration GptPredefTimer1usEnablingGrade: {GPT_PREDEF_UNDEFINED}, scope=ECU, set at pre-compile, default-value=GPT_PREDEF_UNDEFINED  # Specifies the grade of enabling the GPT Predef Timers with 1us tick duration.
      boolean GptReportWakeupSource: set at pre-compile, default-value=true  # Enables/Disables wakeup source reporting.
      enumeration GptTypeofInterruptFunction: {GPT_ISR_VOID, GPT_ISR_CAT1, GPT_ISR_CAT2}, origin=Texas Instruments, set at pre-compile, default-value=GPT_ISR_CAT1  # Type of ISR function
      integer GptPrescaler: 0..2147483647, origin=Texas Instruments, set at pre-compile, default-value=0  # Prescaler value defined to get the desired frequency.
      integer GptModule0CounterBlk0Frequency: 0..2147483647, scope=ECU, origin=Texas Instruments, set at post-build in variant post-build / pre-compile in variant pre-compile, default-value=0  # Specifies the tick frequency of the timer channel in Hz.
      integer GptModule0CounterBlk1Frequency: 0..2147483647, scope=ECU, origin=Texas Instruments, set at post-build in variant post-build / pre-compile in variant pre-compile, default-value=0  # Specifies the tick frequency of the timer channel in Hz.
      integer GptModule1CounterBlk0Frequency: 0..2147483647, scope=ECU, origin=Texas Instruments, set at post-build in variant post-build / pre-compile in variant pre-compile, default-value=0  # Specifies the tick frequency of the timer channel in Hz.
      integer GptModule1CounterBlk1Frequency: 0..2147483647, scope=ECU, origin=Texas Instruments, set at post-build in variant post-build / pre-compile in variant pre-compile, default-value=0  # Specifies the tick frequency of the timer channel in Hz.
      integer GptModule2CounterBlk0Frequency: 0..2147483647, scope=ECU, origin=Texas Instruments, set at post-build in variant post-build / pre-compile in variant pre-compile, default-value=0  # Specifies the tick frequency of the timer channel in Hz.
      integer GptModule2CounterBlk1Frequency: 0..2147483647, scope=ECU, origin=Texas Instruments, set at post-build in variant post-build / pre-compile in variant pre-compile, default-value=0  # Specifies the tick frequency of the timer channel in Hz.
      integer GptModule3CounterBlk0Frequency: 0..2147483647, scope=ECU, origin=Texas Instruments, set at post-build in variant post-build / pre-compile in variant pre-compile, default-value=0  # Specifies the tick frequency of the timer channel in Hz.
      integer GptModule3CounterBlk1Frequency: 0..2147483647, scope=ECU, origin=Texas Instruments, set at post-build in variant post-build / pre-compile in variant pre-compile, default-value=0  # Specifies the tick frequency of the timer channel in Hz.
      integer GptModule4CounterBlk0Frequency: 0..2147483647, scope=ECU, origin=Texas Instruments, set at post-build in variant post-build / pre-compile in variant pre-compile, default-value=0  # Specifies the tick frequency of the timer channel in Hz.
      integer GptModule4CounterBlk1Frequency: 0..2147483647, scope=ECU, origin=Texas Instruments, set at post-build in variant post-build / pre-compile in variant pre-compile, default-value=0  # Specifies the tick frequency of the timer channel in Hz.
      integer GptModule5CounterBlk0Frequency: 0..2147483647, scope=ECU, origin=Texas Instruments, set at post-build in variant post-build / pre-compile in variant pre-compile, default-value=0  # Specifies the tick frequency of the timer channel in Hz.
      integer GptModule5CounterBlk1Frequency: 0..2147483647, scope=ECU, origin=Texas Instruments, set at post-build in variant post-build / pre-compile in variant pre-compile, default-value=0  # Specifies the tick frequency of the timer channel in Hz.
      integer GptModule6CounterBlk0Frequency: 0..2147483647, scope=ECU, origin=Texas Instruments, set at post-build in variant post-build / pre-compile in variant pre-compile, default-value=0  # Specifies the tick frequency of the timer channel in Hz.
      integer GptModule6CounterBlk1Frequency: 0..2147483647, scope=ECU, origin=Texas Instruments, set at post-build in variant post-build / pre-compile in variant pre-compile, default-value=0  # Specifies the tick frequency of the timer channel in Hz.
      integer GptModule7CounterBlk0Frequency: 0..2147483647, scope=ECU, origin=Texas Instruments, set at post-build in variant post-build / pre-compile in variant pre-compile, default-value=0  # Specifies the tick frequency of the timer channel in Hz.
      integer GptModule7CounterBlk1Frequency: 0..2147483647, scope=ECU, origin=Texas Instruments, set at post-build in variant post-build / pre-compile in variant pre-compile, default-value=0  # Specifies the tick frequency of the timer channel in Hz.
      integer GptDefaultOSCounterId [0..1]: 0..32, multiplicity set at pre-compile, origin=Texas Instruments, set at pre-compile, default-value=0  # Default Os Counter Id if node reference to OsCounter ref GptOsCounterRef is not set
      integer GptTimeoutDuration: 1..4294967295, origin=Texas Instruments, set at pre-compile, default-value=32000  # GPT timeout - used in GPT busy wait
      reference GptOsCounterRef [0..1]: multiplicity set at pre-compile, origin=Texas Instruments, set at pre-compile, destination=OsCounter  # This parameter contains a reference to the OsCounter, which is used by the GPT driver.
      container GptClockReferencePoint [1..*]  # This container contains a parameter, which represents a reference to a container of the type McuClockReferencePoint (defined in module MCU).
        reference GptClockReference: set at pre-compile, destination=McuClockReferencePoint  # Reference to a container of the type McuClockReferencePoint, to select an input clock.
    container GptPublishedInformation  # Additional published parameters not covered by "Common" Published Information. Note that these parameters have "PUBLISHED-INFORMATION" configuration class setting, since they are published information.
      enumeration GptDeviceVariant [0..1]: {AM263Px}, multiplicity set at published-information, origin=Texas Instruments, set at published-information, default-value=AM263Px  # Select SOC AM263Px variant
