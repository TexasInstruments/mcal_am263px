AUTOSAR XML (schema 00044)
package /TI_AM263Px
  module definition Port: refined-module-def=Port, variants post-build/pre-compile  # Configuration of the Port module.
    container PortConfigSet: requires-index=true  # This container contains the multiple configuration set and sub containers of the AUTOSAR Port module
      container PortContainer [1..*]: requires-index=true  # Container collecting the PortPins.
        integer PortNumberOfPortPins: 1..65535, set at pre-compile, default-value=147  # The number of specified PortPins in this PortContainer.
        container PortPin [1..*]: requires-index=true  # Configuration of the individual port pins.
          enumeration PortPinPeripheral: {CPTS0, EPWM0, EPWM1, EPWM2, EPWM3, EPWM4, EPWM5, EPWM6, EPWM7, EPWM8, EPWM9, EPWM10, EPWM11, EPWM12, EPWM13, EPWM14, EPWM15, EPWM16, EPWM17, EPWM18, EPWM19, EPWM20, EPWM21, EPWM22, EPWM23, EPWM24, EPWM25, EPWM26, EPWM27, EPWM28, EPWM29, EPWM30, EPWM31, EQEP0, EQEP1, EQEP2, FSIRX0, FSIRX1, FSIRX2, FSIRX3, FSITX0, FSITX1, FSITX2, FSITX3, GPIOAB, GPIOCD, GPIOEF, GPIOGH, GPIOI, I2C0, I2C1, I2C2, I2C3, JTAG, LIN0, LIN1, LIN2, LIN3, LIN4, MCAN0, MCAN1, MCAN2, MCAN3, MCAN4, MCAN5, MCAN6, MCAN7, MDIO, MII, MMC, OSPI0, OUTPUTXBAR, PRU_ICSS, PRU_ICSS_IEP, PRU_ICSS_MDIO, PRU_ICSS_UART, RESOLVER, RGMII1, RGMII2, RMII1, RMII2, SDFM0, SDFM1, SPI0, SPI1, SPI2, SPI3, SPI4, SPI5, SPI6, SPI7, SYSTEM, TRACE, UART0, UART1, UART2, UART3, UART4, UART5, XTAL}, origin=Texas Instruments, set at post-build in variant post-build / pre-compile in variant pre-compile  # Select peripheral of interest to narron down list of pins of interest
          enumeration PortPinPeripheralSignal: {CHANNEL0, CHANNEL1, CHANNEL2, CHANNEL3, CHANNEL4, CHANNEL5, CHANNEL6, CHANNEL7, CHANNEL8, CHANNEL9, CPTS0_TS_SYNC, DAC_OUT, DAC_VREF0, DAC_VREF1, EPWM0_A, EPWM0_B, EPWM1_A, EPWM1_B, EPWM2_A, EPWM2_B, EPWM3_A, EPWM3_B, EPWM4_A, EPWM4_B, EPWM5_A, EPWM5_B, EPWM6_A, EPWM6_B, EPWM7_A, EPWM7_B, EPWM8_A, EPWM8_B, EPWM9_A, EPWM9_B, EPWM10_A, EPWM10_B, EPWM11_A, EPWM11_B, EPWM12_A, EPWM12_B, EPWM13_A, EPWM13_B, EPWM14_A, EPWM14_B, EPWM15_A, EPWM15_B, EPWM16_A, EPWM16_B, EPWM17_A, EPWM17_B, EPWM18_A, EPWM18_B, EPWM19_A, EPWM19_B, EPWM20_A, EPWM20_B, EPWM21_A, EPWM21_B, EPWM22_A, EPWM22_B, EPWM23_A, EPWM23_B, EPWM24_A, EPWM24_B, EPWM25_A, EPWM25_B, EPWM26_A, EPWM26_B, EPWM27_A, EPWM27_B, EPWM28_A, EPWM28_B, EPWM29_A, EPWM29_B, EPWM30_A, EPWM30_B, EPWM31_A, EPWM31_B, EQEP0_A, EQEP0_B, EQEP0_INDEX, EQEP0_STROBE, EQEP1_A, EQEP1_B, EQEP1_INDEX, EQEP1_STROBE, EQEP2_A, EQEP2_B, EQEP2_INDEX, EQEP2_STROBE, FSIRX0_CLK, FSIRX0_D0, FSIRX0_D1, FSIRX1_CLK, FSIRX1_D0, FSIRX1_D1, FSIRX2_CLK, FSIRX2_D0, FSIRX2_D1, FSIRX3_CLK, FSIRX3_D0, FSIRX3_D1, FSITX0_CLK, FSITX0_D0, FSITX0_D1, FSITX1_CLK, FSITX1_D0, FSITX1_D1, FSITX2_CLK, FSITX2_D0, FSITX2_D1, FSITX3_CLK, FSITX3_D0, FSITX3_D1, GPIO0, GPIO1, GPIO10, GPIO100, GPIO101, GPIO102, GPIO103, GPIO104, GPIO105, GPIO106, GPIO107, GPIO108, GPIO109, GPIO11, GPIO110, GPIO111, GPIO112, GPIO113, GPIO114, GPIO115, GPIO116, GPIO117, GPIO118, GPIO119, GPIO12, GPIO120, GPIO121, GPIO122, GPIO123, GPIO124, GPIO125, GPIO126, GPIO127, GPIO128, GPIO129, GPIO13, GPIO130, GPIO131, GPIO132, GPIO133, GPIO134, GPIO135, GPIO136, GPIO137, GPIO138, GPIO14, GPIO15, GPIO16, GPIO17, GPIO18, GPIO19, GPIO2, GPIO20, GPIO21, GPIO22, GPIO23, GPIO24, GPIO25, GPIO26, GPIO27, GPIO28, GPIO29, GPIO3, GPIO30, GPIO31, GPIO32, GPIO33, GPIO34, GPIO35, GPIO36, GPIO37, GPIO38, GPIO39, GPIO4, GPIO40, GPIO41, GPIO42, GPIO43, GPIO44, GPIO45, GPIO46, GPIO47, GPIO48, GPIO49, GPIO5, GPIO50, GPIO51, GPIO52, GPIO53, GPIO54, GPIO55, GPIO56, GPIO57, GPIO58, GPIO59, GPIO6, GPIO60, GPIO61, GPIO62, GPIO63, GPIO64, GPIO65, GPIO66, GPIO67, GPIO68, GPIO69, GPIO7, GPIO70, GPIO71, GPIO72, GPIO73, GPIO74, GPIO75, GPIO76, GPIO77, GPIO78, GPIO79, GPIO8, GPIO80, GPIO81, GPIO82, GPIO83, GPIO84, GPIO85, GPIO86, GPIO87, GPIO88, GPIO89, GPIO9, GPIO90, GPIO91, GPIO92, GPIO93, GPIO94, GPIO95, GPIO96, GPIO97, GPIO98, GPIO99, I2C0_SCL, I2C0_SDA, I2C1_SCL, I2C1_SDA, I2C2_SCL, I2C2_SDA, I2C3_SCL, I2C3_SDA, TCK, TDI, TDO, TMS, LIN0_RXD, LIN0_TXD, LIN1_RXD, LIN1_TXD, LIN2_RXD, LIN2_TXD, LIN3_RXD, LIN3_TXD, LIN4_RXD, LIN4_TXD, MCAN0_RX, MCAN0_TX, MCAN1_RX, MCAN1_TX, MCAN2_RX, MCAN2_TX, MCAN3_RX, MCAN3_TX, MCAN4_RX, MCAN4_TX, MCAN5_RX, MCAN5_TX, MCAN6_RX, MCAN6_TX, MCAN7_RX, MCAN7_TX, MDIO_MDC, MDIO_MDIO, MII1_COL, MII1_CRS, MII1_RX_ER, MII1_RXCLK, MII1_RXD0, MII1_RXD1, MII1_RXD2, MII1_RXD3, MII1_RXDV, MII1_TX_EN, MII1_TXCLK, MII1_TXD0, MII1_TXD1, MII1_TXD2, MII1_TXD3, MII2_COL, MII2_CRS, MII2_RX_ER, MII2_RXCLK, MII2_RXD0, MII2_RXD1, MII2_RXD2, MII2_RXD3, MII2_RXDV, MII2_TX_EN, MII2_TXCLK, MII2_TXD0, MII2_TXD1, MII2_TXD2, MII2_TXD3, MMC_CLK, MMC_CMD, MMC_DAT0, MMC_DAT1, MMC_DAT2, MMC_DAT3, MMC_SDCD, MMC_SDWP, OSPI0_CLK, OSPI0_CSn0, OSPI0_CSn1, OSPI0_D0, OSPI0_D1, OSPI0_D2, OSPI0_D3, OSPI0_D4, OSPI0_D5, OSPI0_D6, OSPI0_D7, OSPI0_DQS, OSPI0_ECC_FAIL, OSPI0_LBCLKO, OSPI0_RESET_OUT0, OSPI0_RESET_OUT1, XBAROUT0, XBAROUT1, XBAROUT10, XBAROUT11, XBAROUT12, XBAROUT13, XBAROUT14, XBAROUT15, XBAROUT2, XBAROUT3, XBAROUT4, XBAROUT5, XBAROUT6, XBAROUT7, XBAROUT8, XBAROUT9, PR0_ECAP0_APWM_OUT, PR0_PRU0_GPIO0, PR0_PRU0_GPIO1, PR0_PRU0_GPIO10, PR0_PRU0_GPIO11, PR0_PRU0_GPIO12, PR0_PRU0_GPIO13, PR0_PRU0_GPIO14, PR0_PRU0_GPIO15, PR0_PRU0_GPIO16, PR0_PRU0_GPIO2, PR0_PRU0_GPIO3, PR0_PRU0_GPIO4, PR0_PRU0_GPIO5, PR0_PRU0_GPIO6, PR0_PRU0_GPIO8, PR0_PRU0_GPIO9, PR0_PRU1_GPIO0, PR0_PRU1_GPIO1, PR0_PRU1_GPIO10, PR0_PRU1_GPIO11, PR0_PRU1_GPIO12, PR0_PRU1_GPIO13, PR0_PRU1_GPIO14, PR0_PRU1_GPIO15, PR0_PRU1_GPIO16, PR0_PRU1_GPIO17, PR0_PRU1_GPIO18, PR0_PRU1_GPIO19, PR0_PRU1_GPIO2, PR0_PRU1_GPIO3, PR0_PRU1_GPIO4, PR0_PRU1_GPIO5, PR0_PRU1_GPIO6, PR0_PRU1_GPIO7, PR0_PRU1_GPIO8, PR0_PRU1_GPIO9, PR0_IEP0_EDC_SYNC_OUT0, PR0_IEP0_EDC_SYNC_OUT1, PR0_IEP0_EDIO_DATA_IN_OUT30, PR0_IEP0_EDIO_DATA_IN_OUT31, PR0_MDIO_MDC, PR0_MDIO_MDIO, PR0_UART0_CTSn, PR0_UART0_RTSn, PR0_UART0_RXD, PR0_UART0_TXD, RES0_PWMOUT0, RES0_PWMOUT1, RGMII1_RD0, RGMII1_RD1, RGMII1_RD2, RGMII1_RD3, RGMII1_RX_CTL, RGMII1_RXC, RGMII1_TD0, RGMII1_TD1, RGMII1_TD2, RGMII1_TD3, RGMII1_TX_CTL, RGMII1_TXC, RGMII2_RD0, RGMII2_RD1, RGMII2_RD2, RGMII2_RD3, RGMII2_RX_CTL, RGMII2_RXC, RGMII2_TD0, RGMII2_TD1, RGMII2_TD2, RGMII2_TD3, RGMII2_TX_CTL, RGMII2_TXC, RMII1_CRS_DV, RMII1_REF_CLK, RMII1_RX_ER, RMII1_RXD0, RMII1_RXD1, RMII1_TX_EN, RMII1_TXD0, RMII1_TXD1, RMII2_CRS_DV, RMII2_REF_CLK, RMII2_RX_ER, RMII2_RXD0, RMII2_RXD1, RMII2_TX_EN, RMII2_TXD0, RMII2_TXD1, SDFM0_CLK0, SDFM0_CLK1, SDFM0_CLK2, SDFM0_CLK3, SDFM0_D0, SDFM0_D1, SDFM0_D2, SDFM0_D3, SDFM1_CLK0, SDFM1_CLK1, SDFM1_CLK2, SDFM1_CLK3, SDFM1_D0, SDFM1_D1, SDFM1_D2, SDFM1_D3, SPI0_CLK, SPI0_CS0, SPI0_CS1, SPI0_D0, SPI0_D1, SPI1_CLK, SPI1_CS0, SPI1_D0, SPI1_D1, SPI2_CLK, SPI2_CS0, SPI2_D0, SPI2_D1, SPI3_CLK, SPI3_CS0, SPI3_D0, SPI3_D1, SPI4_CLK, SPI4_CS0, SPI4_CS1, SPI4_D0, SPI4_D1, SPI5_CLK, SPI5_CS0, SPI5_D0, SPI5_D1, SPI6_CLK, SPI6_CS0, SPI6_D0, SPI6_D1, SPI7_CLK, SPI7_CS0, SPI7_D0, SPI7_D1, CLKOUT0, CLKOUT1, EXT_REFCLK0, PORz, SAFETY_ERRORn, VSYS_MON, WARMRSTn, TRC_CLK, TRC_CTL, TRC_DATA0, TRC_DATA1, TRC_DATA10, TRC_DATA11, TRC_DATA12, TRC_DATA13, TRC_DATA14, TRC_DATA15, TRC_DATA2, TRC_DATA3, TRC_DATA4, TRC_DATA5, TRC_DATA6, TRC_DATA7, TRC_DATA8, TRC_DATA9, UART0_CTSn, UART0_RTSn, UART0_RXD, UART0_TXD, UART1_CTSn, UART1_DCDn, UART1_DSRn, UART1_DTRn, UART1_RIn, UART1_RTSn, UART1_RXD, UART1_TXD, UART2_CTSn, UART2_RTSn, UART2_RXD, UART2_TXD, UART3_CTSn, UART3_RTSn, UART3_RXD, UART3_TXD, UART4_CTSn, UART4_RTSn, UART4_RXD, UART4_TXD, UART5_CTSn, UART5_RTSn, UART5_RXD, UART5_TXD, XTAL_XI, XTAL_XO}, origin=Texas Instruments, set at post-build in variant post-build / pre-compile in variant pre-compile  # Select specific peripheral signal pin of interest
          enumeration PortPinName: {PIN_P1, PIN_R3, PIN_N2, PIN_N1, PIN_N4, PIN_M4, PIN_P3, PIN_M1, PIN_L1, PIN_L2, PIN_K1, PIN_C11, PIN_A11, PIN_C10, PIN_B11, PIN_C9, PIN_A10, PIN_B10, PIN_D9, PIN_A9, PIN_B9, PIN_B8, PIN_A8, PIN_D7, PIN_C8, PIN_C7, PIN_B7, PIN_A7, PIN_A6, PIN_R17, PIN_R18, PIN_U17, PIN_T17, PIN_U18, PIN_T18, PIN_N18, PIN_M18, PIN_P16, PIN_P17, PIN_P18, PIN_N17, PIN_N16, PIN_M17, PIN_B2, PIN_B1, PIN_D3, PIN_D2, PIN_C2, PIN_C1, PIN_E2, PIN_E3, PIN_D1, PIN_E4, PIN_F2, PIN_G2, PIN_E1, PIN_F3, PIN_F4, PIN_F1, PIN_G3, PIN_H2, PIN_G1, PIN_J2, PIN_G4, PIN_J3, PIN_H1, PIN_J1, PIN_K2, PIN_J4, PIN_K4, PIN_K3, PIN_V17, PIN_T16, PIN_P15, PIN_R16, PIN_L3, PIN_M3, PIN_B6, PIN_A4, PIN_B5, PIN_B4, PIN_A3, PIN_A2, PIN_C6, PIN_A5, PIN_L17, PIN_L18, PIN_G17, PIN_F17, PIN_G18, PIN_G15, PIN_K15, PIN_K16, PIN_K17, PIN_K18, PIN_J18, PIN_J17, PIN_H18, PIN_L16, PIN_M16, PIN_M15, PIN_H17, PIN_H16, PIN_F15, PIN_C18, PIN_D17, PIN_D18, PIN_E16, PIN_F16, PIN_F18, PIN_G16, PIN_E17, PIN_E18, PIN_C16, PIN_A17, PIN_B18, PIN_B17, PIN_D16, PIN_C17, PIN_D15, PIN_C15, PIN_P2, PIN_B16, PIN_D14, PIN_A16, PIN_D13, PIN_B15, PIN_C13, PIN_A15, PIN_C14, PIN_B14, PIN_A14, PIN_C12, PIN_D11, PIN_B13, PIN_A13, PIN_B12, PIN_A12, PIN_M2, PIN_C3, PIN_D4, PIN_C5, PIN_C4, PIN_D5, PIN_B3, PIN_R2, PIN_T1, PIN_R1, PIN_V15, PIN_U15, PIN_T14, PIN_U14, PIN_U13, PIN_R14, PIN_T11, PIN_U11, PIN_T12, PIN_V12, PIN_U12, PIN_R12, PIN_R10, PIN_T10, PIN_U10, PIN_T9, PIN_V9, PIN_T8, PIN_U7, PIN_U8, PIN_T7, PIN_R7, PIN_V8, PIN_U9, PIN_U6, PIN_V5, PIN_V4, PIN_U5, PIN_V3, PIN_U4, PIN_V14, PIN_V13, PIN_V10, PIN_V11, PIN_V6, PIN_V7, PIN_U16, PIN_T15, PIN_T13, PIN_T6, PIN_T5, PIN_U1, PIN_U2, PIN_U3, PIN_V2, PIN_J16, PIN_N3, PIN_R6, PIN_A1, PIN_T2, PIN_P5, PIN_M5, PIN_L5, PIN_J5, PIN_H5, PIN_F5, PIN_E5, PIN_M6, PIN_L6, PIN_J6, PIN_H6, PIN_F6, PIN_E6, PIN_N7, PIN_M7, PIN_L7, PIN_K7, PIN_J7, PIN_H7, PIN_G7, PIN_F7, PIN_E7, PIN_N8, PIN_M8, PIN_L8, PIN_K8, PIN_J8, PIN_H8, PIN_G8, PIN_F8, PIN_E8, PIN_N9, PIN_M9, PIN_L9, PIN_K9, PIN_J9, PIN_H9, PIN_G9, PIN_N10, PIN_M10, PIN_L10, PIN_K10, PIN_J10, PIN_H10, PIN_G10, PIN_F10, PIN_E10, PIN_N11, PIN_M11, PIN_L11, PIN_K11, PIN_J11, PIN_H11, PIN_G11, PIN_N12, PIN_M12, PIN_L12, PIN_K12, PIN_J12, PIN_H12, PIN_G12, PIN_F12, PIN_E12, PIN_P13, PIN_M13, PIN_L13, PIN_J13, PIN_H13, PIN_F13, PIN_E13, PIN_P14, PIN_M14, PIN_L14, PIN_J14, PIN_H14, PIN_F14, PIN_E14, PIN_V18, PIN_A18, PIN_V1, PIN_R5, PIN_P6, PIN_P8, PIN_P10, PIN_P12, PIN_R13, PIN_V16, PIN_N5, PIN_K5, PIN_G5, PIN_N6, PIN_K6, PIN_G6, PIN_F9, PIN_E9, PIN_F11, PIN_E11, PIN_N13, PIN_K13, PIN_G13, PIN_N14, PIN_K14, PIN_G14, PIN_R8, PIN_R11, PIN_R9, PIN_R4, PIN_T4, PIN_P7, PIN_P9, PIN_P11, PIN_J15, PIN_D10, PIN_H3, PIN_L4, PIN_D6, PIN_N15, PIN_E15, PIN_T3, PIN_P4, PIN_H4, PIN_D8, PIN_D12, PIN_R15, PIN_L15, PIN_H15}, origin=Texas Instruments, set at pre-compile  # PAD IO name of the selected pin
          integer PortPinId: set at pre-compile, symbolic-name-value=true, default-value=1  # Pin Id of the port pin. This value will be assigned to the symbolic name derived from the port pin container short name.
          string PortPinIdAddr: origin=Texas Instruments, set at pre-compile, default-value=1  # Pin Id of the port pin. This value will be assigned to the symbolic name derived from the port pin container short name.
          enumeration PortPinDirection: {PORT_PIN_IN, PORT_PIN_OUT, PORT_PIN_DEFAULT}, set at post-build in variant post-build / pre-compile in variant pre-compile, default-value=PORT_PIN_DEFAULT  # The initial direction of the pin (IN or OUT). If the direction is not changeable, the value configured here is fixed.
          boolean PortPinDirectionChangeable: set at post-build in variant post-build / pre-compile in variant pre-compile, default-value=false  # Parameter to indicate if the direction is changeable on a port pin during runtime.
          enumeration PortPinInitialMode: {CPTS0, EPWM0, EPWM1, EPWM2, EPWM3, EPWM4, EPWM5, EPWM6, EPWM7, EPWM8, EPWM9, EPWM10, EPWM11, EPWM12, EPWM13, EPWM14, EPWM15, EPWM16, EPWM17, EPWM18, EPWM19, EPWM20, EPWM21, EPWM22, EPWM23, EPWM24, EPWM25, EPWM26, EPWM27, EPWM28, EPWM29, EPWM30, EPWM31, EQEP0, EQEP1, EQEP2, FSIRX0, FSIRX1, FSIRX2, FSIRX3, FSITX0, FSITX1, FSITX2, FSITX3, GPIOAB, GPIOCD, GPIOEF, GPIOGH, GPIOI, I2C0, I2C1, I2C2, I2C3, JTAG, LIN0, LIN1, LIN2, LIN3, LIN4, MCAN0, MCAN1, MCAN2, MCAN3, MCAN4, MCAN5, MCAN6, MCAN7, MDIO, MII, MMC, OSPI0, OUTPUTXBAR, PRU_ICSS, PRU_ICSS_IEP, PRU_ICSS_MDIO, PRU_ICSS_UART, RESOLVER, RGMII1, RGMII2, RMII1, RMII2, SDFM0, SDFM1, SPI0, SPI1, SPI2, SPI3, SPI4, SPI5, SPI6, SPI7, SYSTEM, TRACE, UART0, UART1, UART2, UART3, UART4, UART5, XTAL}, set at post-build in variant post-build / pre-compile in variant pre-compile, default-value=CPTS0  # Port pin mode from mode list for use with Port_Init() function.
          enumeration PortPinInitialGpioMuxmode: {OSPI0_CSn0_MUXMODE_0, OSPI0_D0_MUXMODE_6, GPIO0_MUXMODE_7, OSPI0_CSn1_MUXMODE_0, MCAN5_TX_MUXMODE_2, SPI4_CS1_MUXMODE_4, XBAROUT0_MUXMODE_5, UART2_RTSn_MUXMODE_6, GPIO1_MUXMODE_7, FSIRX2_D1_MUXMODE_8, EPWM10_B_MUXMODE_10, OSPI0_CLK_MUXMODE_0, MCAN7_RX_MUXMODE_2, SPI7_CS0_MUXMODE_4, UART3_CTSn_MUXMODE_6, GPIO2_MUXMODE_7, EPWM12_A_MUXMODE_10, OSPI0_D0_MUXMODE_0, MCAN7_TX_MUXMODE_2, SPI7_CLK_MUXMODE_4, UART1_DCDn_MUXMODE_6, GPIO3_MUXMODE_7, EPWM12_B_MUXMODE_10, OSPI0_D1_MUXMODE_0, SPI7_D0_MUXMODE_4, UART1_RIn_MUXMODE_6, GPIO4_MUXMODE_7, EPWM13_A_MUXMODE_10, OSPI0_D2_MUXMODE_0, OSPI0_D6_MUXMODE_6, GPIO5_MUXMODE_7, OSPI0_D3_MUXMODE_0, OSPI0_D4_MUXMODE_6, GPIO6_MUXMODE_7, MCAN0_RX_MUXMODE_0, SPI4_CS0_MUXMODE_1, OSPI0_D4_MUXMODE_2, OSPI0_DQS_MUXMODE_6, GPIO7_MUXMODE_7, MCAN0_TX_MUXMODE_0, SPI4_CLK_MUXMODE_1, OSPI0_D5_MUXMODE_2, OSPI0_D2_MUXMODE_6, GPIO8_MUXMODE_7, MCAN1_RX_MUXMODE_0, SPI4_D0_MUXMODE_1, OSPI0_D6_MUXMODE_2, OSPI0_CLK_MUXMODE_6, GPIO9_MUXMODE_7, MCAN1_TX_MUXMODE_0, SPI4_D1_MUXMODE_1, OSPI0_D7_MUXMODE_2, SPI7_D1_MUXMODE_4, UART1_DTRn_MUXMODE_6, GPIO10_MUXMODE_7, EPWM13_B_MUXMODE_10, SPI0_CS0_MUXMODE_0, UART3_RXD_MUXMODE_1, LIN3_RXD_MUXMODE_2, GPIO11_MUXMODE_7, CHANNEL0_MUXMODE_9, SPI0_CLK_MUXMODE_0, UART3_TXD_MUXMODE_1, LIN3_TXD_MUXMODE_2, FSITX0_CLK_MUXMODE_6, GPIO12_MUXMODE_7, CHANNEL1_MUXMODE_9, SPI0_D0_MUXMODE_0, FSITX0_D0_MUXMODE_6, GPIO13_MUXMODE_7, CHANNEL2_MUXMODE_9, SPI0_D1_MUXMODE_0, FSITX0_D1_MUXMODE_6, GPIO14_MUXMODE_7, CHANNEL3_MUXMODE_9, SPI1_CS0_MUXMODE_0, UART4_TXD_MUXMODE_1, LIN4_TXD_MUXMODE_2, XBAROUT1_MUXMODE_5, GPIO15_MUXMODE_7, CHANNEL4_MUXMODE_9, SPI1_CLK_MUXMODE_0, UART4_RXD_MUXMODE_1, LIN4_RXD_MUXMODE_2, XBAROUT2_MUXMODE_5, FSIRX0_CLK_MUXMODE_6, GPIO16_MUXMODE_7, CHANNEL5_MUXMODE_9, SPI1_D0_MUXMODE_0, UART5_TXD_MUXMODE_1, XBAROUT3_MUXMODE_5, FSIRX0_D0_MUXMODE_6, GPIO17_MUXMODE_7, CHANNEL6_MUXMODE_9, SPI1_D1_MUXMODE_0, UART5_RXD_MUXMODE_1, XBAROUT4_MUXMODE_5, FSIRX0_D1_MUXMODE_6, GPIO18_MUXMODE_7, CHANNEL7_MUXMODE_9, LIN1_RXD_MUXMODE_0, UART1_RXD_MUXMODE_1, SPI2_CS0_MUXMODE_2, OSPI0_ECC_FAIL_MUXMODE_3, XBAROUT5_MUXMODE_5, GPIO19_MUXMODE_7, OSPI0_RESET_OUT1_MUXMODE_8, LIN1_TXD_MUXMODE_0, UART1_TXD_MUXMODE_1, SPI2_CLK_MUXMODE_2, OSPI0_RESET_OUT0_MUXMODE_3, XBAROUT6_MUXMODE_5, GPIO20_MUXMODE_7, LIN2_RXD_MUXMODE_0, UART2_RXD_MUXMODE_1, SPI2_D0_MUXMODE_2, GPIO21_MUXMODE_7, LIN2_TXD_MUXMODE_0, UART2_TXD_MUXMODE_1, SPI2_D1_MUXMODE_2, GPIO22_MUXMODE_7, I2C1_SCL_MUXMODE_0, SPI3_CS0_MUXMODE_2, XBAROUT7_MUXMODE_5, GPIO23_MUXMODE_7, I2C1_SDA_MUXMODE_0, SPI3_CLK_MUXMODE_2, XBAROUT8_MUXMODE_5, GPIO24_MUXMODE_7, UART0_RTSn_MUXMODE_0, I2C2_SCL_MUXMODE_1, SPI3_D0_MUXMODE_2, MCAN3_TX_MUXMODE_3, XBAROUT9_MUXMODE_5, GPIO25_MUXMODE_7, UART0_CTSn_MUXMODE_0, I2C2_SDA_MUXMODE_1, SPI3_D1_MUXMODE_2, MCAN3_RX_MUXMODE_3, SPI0_CS1_MUXMODE_4, XBAROUT10_MUXMODE_5, GPIO26_MUXMODE_7, UART0_RXD_MUXMODE_0, LIN0_RXD_MUXMODE_1, GPIO27_MUXMODE_7, UART0_TXD_MUXMODE_0, LIN0_TXD_MUXMODE_1, GPIO28_MUXMODE_7, RGMII1_RXC_MUXMODE_0, RMII1_REF_CLK_MUXMODE_1, MII1_RXCLK_MUXMODE_2, GPIO29_MUXMODE_7, EQEP2_A_MUXMODE_8, EPWM14_A_MUXMODE_10, RGMII1_RX_CTL_MUXMODE_0, RMII1_RX_ER_MUXMODE_1, MII1_RXDV_MUXMODE_2, GPIO30_MUXMODE_7, EQEP2_B_MUXMODE_8, RGMII1_RD0_MUXMODE_0, RMII1_RXD0_MUXMODE_1, MII1_RXD0_MUXMODE_2, GPIO31_MUXMODE_7, EQEP2_STROBE_MUXMODE_8, RGMII1_RD1_MUXMODE_0, RMII1_RXD1_MUXMODE_1, MII1_RXD1_MUXMODE_2, GPIO32_MUXMODE_7, EQEP2_INDEX_MUXMODE_8, RGMII1_RD2_MUXMODE_0, MII1_RXD2_MUXMODE_2, GPIO33_MUXMODE_7, EQEP0_A_MUXMODE_8, RGMII1_RD3_MUXMODE_0, MII1_RXD3_MUXMODE_2, GPIO34_MUXMODE_7, EQEP0_B_MUXMODE_8, RGMII1_TXC_MUXMODE_0, MII1_TXCLK_MUXMODE_2, FSITX1_CLK_MUXMODE_6, GPIO35_MUXMODE_7, EQEP0_INDEX_MUXMODE_8, EPWM14_B_MUXMODE_10, RGMII1_TX_CTL_MUXMODE_0, RMII1_TX_EN_MUXMODE_1, MII1_TX_EN_MUXMODE_2, FSITX1_D0_MUXMODE_6, GPIO36_MUXMODE_7, EQEP0_STROBE_MUXMODE_8, EPWM15_B_MUXMODE_10, RGMII1_TD0_MUXMODE_0, RMII1_TXD0_MUXMODE_1, MII1_TXD0_MUXMODE_2, FSITX1_D1_MUXMODE_6, GPIO37_MUXMODE_7, EQEP1_A_MUXMODE_8, EPWM15_A_MUXMODE_9, RGMII1_TD1_MUXMODE_0, RMII1_TXD1_MUXMODE_1, MII1_TXD1_MUXMODE_2, FSIRX1_CLK_MUXMODE_6, GPIO38_MUXMODE_7, EQEP1_B_MUXMODE_8, RGMII1_TD2_MUXMODE_0, RMII1_CRS_DV_MUXMODE_1, MII1_TXD2_MUXMODE_2, FSIRX1_D0_MUXMODE_6, GPIO39_MUXMODE_7, EQEP1_STROBE_MUXMODE_8, RGMII1_TD3_MUXMODE_0, MII1_TXD3_MUXMODE_2, FSIRX1_D1_MUXMODE_6, GPIO40_MUXMODE_7, EQEP1_INDEX_MUXMODE_8, MDIO_MDIO_MUXMODE_0, GPIO41_MUXMODE_7, MDIO_MDC_MUXMODE_0, GPIO42_MUXMODE_7, EPWM0_A_MUXMODE_0, GPIO43_MUXMODE_7, EPWM0_A_MUXMODE_10, EPWM0_B_MUXMODE_0, GPIO44_MUXMODE_7, EPWM0_B_MUXMODE_10, EPWM1_A_MUXMODE_0, GPIO45_MUXMODE_7, EPWM1_A_MUXMODE_10, EPWM1_B_MUXMODE_0, GPIO46_MUXMODE_7, EPWM4_B_MUXMODE_10, EPWM2_A_MUXMODE_0, GPIO47_MUXMODE_7, EPWM2_A_MUXMODE_10, EPWM2_B_MUXMODE_0, GPIO48_MUXMODE_7, EPWM2_B_MUXMODE_10, EPWM3_A_MUXMODE_0, GPIO49_MUXMODE_7, EPWM3_A_MUXMODE_10, EPWM3_B_MUXMODE_0, GPIO50_MUXMODE_7, EPWM6_A_MUXMODE_10, EPWM4_A_MUXMODE_0, GPIO51_MUXMODE_7, EPWM4_A_MUXMODE_10, EPWM4_B_MUXMODE_0, GPIO52_MUXMODE_7, EPWM1_B_MUXMODE_10, EPWM5_A_MUXMODE_0, SPI5_CS0_MUXMODE_3, GPIO53_MUXMODE_7, EPWM5_A_MUXMODE_10, EPWM5_B_MUXMODE_0, SPI5_CLK_MUXMODE_3, GPIO54_MUXMODE_7, EPWM8_B_MUXMODE_10, EPWM6_A_MUXMODE_0, SPI5_D0_MUXMODE_3, GPIO55_MUXMODE_7, EPWM3_B_MUXMODE_10, EPWM6_B_MUXMODE_0, SPI5_D1_MUXMODE_3, GPIO56_MUXMODE_7, EPWM6_B_MUXMODE_10, EPWM7_A_MUXMODE_0, SPI6_CS0_MUXMODE_3, GPIO57_MUXMODE_7, EPWM7_A_MUXMODE_10, EPWM7_B_MUXMODE_0, SPI6_CLK_MUXMODE_3, GPIO58_MUXMODE_7, EPWM5_B_MUXMODE_10, EPWM8_A_MUXMODE_0, I2C3_SDA_MUXMODE_2, SPI6_D0_MUXMODE_3, FSITX2_CLK_MUXMODE_6, GPIO59_MUXMODE_7, EPWM8_A_MUXMODE_10, EPWM8_B_MUXMODE_0, I2C3_SCL_MUXMODE_2, SPI6_D1_MUXMODE_3, FSITX2_D0_MUXMODE_6, GPIO60_MUXMODE_7, EPWM9_B_MUXMODE_10, EPWM9_A_MUXMODE_0, SPI7_CS0_MUXMODE_3, MCAN4_RX_MUXMODE_4, FSITX2_D1_MUXMODE_6, GPIO61_MUXMODE_7, EPWM9_A_MUXMODE_10, EPWM9_B_MUXMODE_0, UART1_RTSn_MUXMODE_1, SPI7_CLK_MUXMODE_3, MCAN4_TX_MUXMODE_4, FSIRX2_CLK_MUXMODE_6, GPIO62_MUXMODE_7, EPWM11_B_MUXMODE_10, EPWM10_A_MUXMODE_0, UART1_CTSn_MUXMODE_1, SPI7_D0_MUXMODE_3, MCAN5_RX_MUXMODE_4, FSIRX2_D0_MUXMODE_6, GPIO63_MUXMODE_7, EPWM7_B_MUXMODE_10, EPWM10_B_MUXMODE_0, UART2_RTSn_MUXMODE_1, SPI7_D1_MUXMODE_3, MCAN5_TX_MUXMODE_4, OSPI0_RESET_OUT0_MUXMODE_5, FSIRX2_D1_MUXMODE_6, GPIO64_MUXMODE_7, EPWM11_A_MUXMODE_0, UART2_CTSn_MUXMODE_1, OSPI0_ECC_FAIL_MUXMODE_2, MCAN6_RX_MUXMODE_4, OSPI0_RESET_OUT1_MUXMODE_5, OSPI0_CSn0_MUXMODE_6, GPIO65_MUXMODE_7, EPWM11_A_MUXMODE_10, EPWM11_B_MUXMODE_0, UART3_RTSn_MUXMODE_1, OSPI0_RESET_OUT0_MUXMODE_2, MCAN6_TX_MUXMODE_4, OSPI0_D1_MUXMODE_6, GPIO66_MUXMODE_7, EPWM12_A_MUXMODE_0, UART3_CTSn_MUXMODE_1, SPI4_CS1_MUXMODE_2, MCAN7_RX_MUXMODE_4, OSPI0_D5_MUXMODE_6, GPIO67_MUXMODE_7, EPWM12_B_MUXMODE_0, UART1_DCDn_MUXMODE_1, SPI7_CS0_MUXMODE_2, MCAN7_TX_MUXMODE_4, OSPI0_D7_MUXMODE_6, GPIO68_MUXMODE_7, EPWM10_A_MUXMODE_10, EPWM13_A_MUXMODE_0, UART1_RIn_MUXMODE_1, SPI7_CLK_MUXMODE_2, OSPI0_D3_MUXMODE_6, GPIO69_MUXMODE_7, EPWM13_B_MUXMODE_0, UART1_DTRn_MUXMODE_1, SPI7_D0_MUXMODE_2, OSPI0_ECC_FAIL_MUXMODE_6, GPIO70_MUXMODE_7, EPWM14_A_MUXMODE_0, UART1_DSRn_MUXMODE_1, SPI7_D1_MUXMODE_2, MCAN6_RX_MUXMODE_3, GPIO71_MUXMODE_7, EPWM14_B_MUXMODE_0, MII1_RX_ER_MUXMODE_2, MCAN6_TX_MUXMODE_3, GPIO72_MUXMODE_7, EPWM15_A_MUXMODE_0, MII1_COL_MUXMODE_2, MCAN7_RX_MUXMODE_3, GPIO73_MUXMODE_7, EPWM15_A_MUXMODE_10, EPWM15_B_MUXMODE_0, MII1_CRS_MUXMODE_2, MCAN7_TX_MUXMODE_3, GPIO74_MUXMODE_7, UART1_RXD_MUXMODE_0, LIN1_RXD_MUXMODE_1, OSPI0_LBCLKO_MUXMODE_2, EPWM16_A_MUXMODE_5, GPIO75_MUXMODE_7, EPWM16_A_MUXMODE_10, EPWM10_A_MUXMODE_11, UART1_TXD_MUXMODE_0, LIN1_TXD_MUXMODE_1, OSPI0_DQS_MUXMODE_2, EPWM16_B_MUXMODE_5, GPIO76_MUXMODE_7, EPWM16_B_MUXMODE_10, MMC_CLK_MUXMODE_0, UART0_RXD_MUXMODE_1, LIN0_RXD_MUXMODE_2, MCAN0_RX_MUXMODE_3, EPWM17_A_MUXMODE_5, GPIO77_MUXMODE_7, SDFM1_CLK0_MUXMODE_8, EPWM17_A_MUXMODE_10, MMC_CMD_MUXMODE_0, UART0_TXD_MUXMODE_1, LIN0_TXD_MUXMODE_2, MCAN0_TX_MUXMODE_3, EPWM17_B_MUXMODE_5, GPIO78_MUXMODE_7, SDFM1_D0_MUXMODE_8, EPWM17_B_MUXMODE_10, MMC_DAT0_MUXMODE_0, I2C1_SCL_MUXMODE_2, MCAN1_RX_MUXMODE_3, EPWM18_A_MUXMODE_5, GPIO79_MUXMODE_7, SDFM1_CLK1_MUXMODE_8, EPWM18_A_MUXMODE_10, MMC_DAT1_MUXMODE_0, MCAN1_TX_MUXMODE_3, EPWM18_B_MUXMODE_5, GPIO80_MUXMODE_7, SDFM1_D1_MUXMODE_8, EPWM18_B_MUXMODE_10, MMC_DAT2_MUXMODE_0, I2C1_SDA_MUXMODE_2, MCAN4_RX_MUXMODE_3, EPWM19_A_MUXMODE_5, GPIO81_MUXMODE_7, SDFM1_CLK2_MUXMODE_8, EPWM19_A_MUXMODE_10, MMC_DAT3_MUXMODE_0, MCAN4_TX_MUXMODE_3, EPWM19_B_MUXMODE_5, GPIO82_MUXMODE_7, SDFM1_D2_MUXMODE_8, EPWM19_B_MUXMODE_10, MMC_SDWP_MUXMODE_0, UART0_RTSn_MUXMODE_1, I2C2_SCL_MUXMODE_2, MCAN5_RX_MUXMODE_3, EPWM20_A_MUXMODE_5, GPIO83_MUXMODE_7, SDFM1_CLK3_MUXMODE_8, EPWM20_A_MUXMODE_10, MMC_SDCD_MUXMODE_0, UART0_CTSn_MUXMODE_1, I2C2_SDA_MUXMODE_2, MCAN5_TX_MUXMODE_3, EPWM20_B_MUXMODE_5, GPIO84_MUXMODE_7, SDFM1_D3_MUXMODE_8, EPWM20_B_MUXMODE_10, PR0_MDIO_MDIO_MUXMODE_0, EPWM21_A_MUXMODE_5, GPIO85_MUXMODE_7, EPWM21_A_MUXMODE_10, PR0_MDIO_MDC_MUXMODE_0, EPWM21_B_MUXMODE_5, GPIO86_MUXMODE_7, EPWM21_B_MUXMODE_10, PR0_PRU0_GPIO5_MUXMODE_0, RMII2_RX_ER_MUXMODE_2, MII2_RX_ER_MUXMODE_4, EPWM22_A_MUXMODE_5, GPIO87_MUXMODE_7, EPWM22_A_MUXMODE_10, PR0_PRU0_GPIO9_MUXMODE_0, PR0_UART0_CTSn_MUXMODE_3, MII2_COL_MUXMODE_4, EPWM22_B_MUXMODE_5, GPIO88_MUXMODE_7, PR0_PRU0_GPIO10_MUXMODE_0, RMII2_CRS_DV_MUXMODE_2, PR0_UART0_RTSn_MUXMODE_3, MII2_CRS_MUXMODE_4, EPWM23_A_MUXMODE_5, GPIO89_MUXMODE_7, EPWM22_B_MUXMODE_10, PR0_PRU0_GPIO8_MUXMODE_0, EPWM23_B_MUXMODE_5, GPIO90_MUXMODE_7, EPWM29_A_MUXMODE_10, PR0_PRU0_GPIO6_MUXMODE_0, RMII2_REF_CLK_MUXMODE_2, RGMII2_RXC_MUXMODE_3, MII2_RXCLK_MUXMODE_4, EPWM24_A_MUXMODE_5, GPIO91_MUXMODE_7, EPWM24_A_MUXMODE_10, PR0_PRU0_GPIO4_MUXMODE_0, RGMII2_RX_CTL_MUXMODE_3, MII2_RXDV_MUXMODE_4, EPWM24_B_MUXMODE_5, GPIO92_MUXMODE_7, EPWM24_B_MUXMODE_10, PR0_PRU0_GPIO0_MUXMODE_0, RMII2_RXD0_MUXMODE_2, RGMII2_RD0_MUXMODE_3, MII2_RXD0_MUXMODE_4, EPWM25_A_MUXMODE_5, GPIO93_MUXMODE_7, EPWM25_A_MUXMODE_10, PR0_PRU0_GPIO1_MUXMODE_0, RMII2_RXD1_MUXMODE_2, RGMII2_RD1_MUXMODE_3, MII2_RXD1_MUXMODE_4, EPWM25_B_MUXMODE_5, GPIO94_MUXMODE_7, EPWM25_B_MUXMODE_10, PR0_PRU0_GPIO2_MUXMODE_0, RGMII2_RD2_MUXMODE_3, MII2_RXD2_MUXMODE_4, EPWM26_A_MUXMODE_5, GPIO95_MUXMODE_7, EPWM26_A_MUXMODE_10, PR0_PRU0_GPIO3_MUXMODE_0, RGMII2_RD3_MUXMODE_3, MII2_RXD3_MUXMODE_4, EPWM26_B_MUXMODE_5, GPIO96_MUXMODE_7, EPWM26_B_MUXMODE_10, PR0_PRU0_GPIO16_MUXMODE_0, RGMII2_TXC_MUXMODE_3, MII2_TXCLK_MUXMODE_4, EPWM27_A_MUXMODE_5, GPIO97_MUXMODE_7, EPWM27_A_MUXMODE_10, PR0_PRU0_GPIO15_MUXMODE_0, RMII2_TX_EN_MUXMODE_2, RGMII2_TX_CTL_MUXMODE_3, MII2_TX_EN_MUXMODE_4, EPWM27_B_MUXMODE_5, GPIO98_MUXMODE_7, PR0_PRU0_GPIO11_MUXMODE_0, RMII2_TXD0_MUXMODE_2, RGMII2_TD0_MUXMODE_3, MII2_TXD0_MUXMODE_4, EPWM28_A_MUXMODE_5, GPIO99_MUXMODE_7, EPWM28_A_MUXMODE_10, PR0_PRU0_GPIO12_MUXMODE_0, RMII2_TXD1_MUXMODE_2, RGMII2_TD1_MUXMODE_3, MII2_TXD1_MUXMODE_4, EPWM28_B_MUXMODE_5, GPIO100_MUXMODE_7, EPWM28_B_MUXMODE_10, PR0_PRU0_GPIO13_MUXMODE_0, RGMII2_TD2_MUXMODE_3, MII2_TXD2_MUXMODE_4, EPWM29_A_MUXMODE_5, GPIO101_MUXMODE_7, EPWM27_B_MUXMODE_10, PR0_PRU0_GPIO14_MUXMODE_0, RGMII2_TD3_MUXMODE_3, MII2_TXD3_MUXMODE_4, EPWM29_B_MUXMODE_5, GPIO102_MUXMODE_7, EPWM29_B_MUXMODE_10, PR0_PRU1_GPIO5_MUXMODE_0, SPI5_CS0_MUXMODE_2, TRC_DATA0_MUXMODE_4, EPWM30_A_MUXMODE_5, GPIO103_MUXMODE_7, EPWM30_A_MUXMODE_10, PR0_PRU1_GPIO9_MUXMODE_0, SPI5_CLK_MUXMODE_2, PR0_UART0_RXD_MUXMODE_3, TRC_DATA1_MUXMODE_4, EPWM30_B_MUXMODE_5, GPIO104_MUXMODE_7, PR0_PRU1_GPIO10_MUXMODE_0, SPI5_D0_MUXMODE_2, PR0_UART0_TXD_MUXMODE_3, TRC_DATA2_MUXMODE_4, EPWM31_A_MUXMODE_5, GPIO105_MUXMODE_7, RES0_PWMOUT0_MUXMODE_8, EPWM31_A_MUXMODE_10, PR0_PRU1_GPIO8_MUXMODE_0, SPI5_D1_MUXMODE_2, TRC_DATA3_MUXMODE_4, EPWM31_B_MUXMODE_5, GPIO106_MUXMODE_7, RES0_PWMOUT1_MUXMODE_8, EPWM31_B_MUXMODE_10, PR0_PRU1_GPIO6_MUXMODE_0, MCAN0_RX_MUXMODE_1, FSITX2_CLK_MUXMODE_3, TRC_DATA4_MUXMODE_4, GPIO107_MUXMODE_7, PR0_PRU1_GPIO4_MUXMODE_0, MCAN0_TX_MUXMODE_1, FSITX2_D0_MUXMODE_3, TRC_DATA5_MUXMODE_4, GPIO108_MUXMODE_7, PR0_PRU1_GPIO0_MUXMODE_0, MCAN1_RX_MUXMODE_1, FSITX2_D1_MUXMODE_3, TRC_DATA6_MUXMODE_4, GPIO109_MUXMODE_7, EPWM23_A_MUXMODE_10, PR0_PRU1_GPIO1_MUXMODE_0, MCAN1_TX_MUXMODE_1, FSIRX2_CLK_MUXMODE_3, TRC_DATA7_MUXMODE_4, GPIO110_MUXMODE_7, PR0_PRU1_GPIO2_MUXMODE_0, MCAN4_RX_MUXMODE_1, FSIRX2_D0_MUXMODE_3, TRC_DATA8_MUXMODE_4, GPIO111_MUXMODE_7, PR0_PRU1_GPIO3_MUXMODE_0, MCAN4_TX_MUXMODE_1, FSIRX2_D1_MUXMODE_3, TRC_DATA9_MUXMODE_4, GPIO112_MUXMODE_7, EPWM23_B_MUXMODE_10, PR0_PRU1_GPIO16_MUXMODE_0, MCAN5_RX_MUXMODE_1, FSITX3_CLK_MUXMODE_3, TRC_DATA10_MUXMODE_4, GPIO113_MUXMODE_7, PR0_PRU1_GPIO15_MUXMODE_0, MCAN5_TX_MUXMODE_1, FSITX3_D0_MUXMODE_3, TRC_DATA11_MUXMODE_4, GPIO114_MUXMODE_7, PR0_PRU1_GPIO11_MUXMODE_0, MCAN6_RX_MUXMODE_1, SPI6_CS0_MUXMODE_2, FSITX3_D1_MUXMODE_3, TRC_DATA12_MUXMODE_4, GPIO115_MUXMODE_7, PR0_PRU1_GPIO12_MUXMODE_0, MCAN6_TX_MUXMODE_1, SPI6_CLK_MUXMODE_2, FSIRX3_CLK_MUXMODE_3, TRC_DATA13_MUXMODE_4, GPIO116_MUXMODE_7, PR0_PRU1_GPIO13_MUXMODE_0, MCAN7_RX_MUXMODE_1, SPI6_D0_MUXMODE_2, FSIRX3_D0_MUXMODE_3, TRC_DATA14_MUXMODE_4, XBAROUT11_MUXMODE_5, GPIO117_MUXMODE_7, PR0_PRU1_GPIO14_MUXMODE_0, MCAN7_TX_MUXMODE_1, SPI6_D1_MUXMODE_2, FSIRX3_D1_MUXMODE_3, TRC_DATA15_MUXMODE_4, XBAROUT12_MUXMODE_5, GPIO118_MUXMODE_7, PR0_PRU1_GPIO19_MUXMODE_0, UART3_RXD_MUXMODE_2, PR0_IEP0_EDC_SYNC_OUT0_MUXMODE_3, TRC_CLK_MUXMODE_4, XBAROUT13_MUXMODE_5, GPIO119_MUXMODE_7, EQEP1_A_MUXMODE_9, PR0_PRU1_GPIO18_MUXMODE_0, UART3_TXD_MUXMODE_2, PR0_IEP0_EDIO_DATA_IN_OUT31_MUXMODE_3, TRC_CTL_MUXMODE_4, XBAROUT14_MUXMODE_5, GPIO120_MUXMODE_7, EQEP1_B_MUXMODE_9, EXT_REFCLK0_MUXMODE_0, XBAROUT15_MUXMODE_5, GPIO121_MUXMODE_7, EQEP1_INDEX_MUXMODE_9, CLKOUT1_MUXMODE_0, GPIO122_MUXMODE_7, SDFM0_CLK0_MUXMODE_8, EQEP1_STROBE_MUXMODE_9, PR0_ECAP0_APWM_OUT_MUXMODE_0, GPIO123_MUXMODE_7, SDFM0_D0_MUXMODE_8, PR0_PRU1_GPIO7_MUXMODE_0, CPTS0_TS_SYNC_MUXMODE_1, UART5_RTSn_MUXMODE_2, PR0_IEP0_EDC_SYNC_OUT1_MUXMODE_3, I2C3_SDA_MUXMODE_5, GPIO124_MUXMODE_7, SDFM0_CLK1_MUXMODE_8, PR0_PRU1_GPIO17_MUXMODE_0, UART5_CTSn_MUXMODE_2, PR0_IEP0_EDIO_DATA_IN_OUT30_MUXMODE_3, GPIO125_MUXMODE_7, SDFM0_D1_MUXMODE_8, UART5_TXD_MUXMODE_0, I2C3_SCL_MUXMODE_5, GPIO126_MUXMODE_7, SDFM0_CLK2_MUXMODE_8, CHANNEL8_MUXMODE_9, UART5_RXD_MUXMODE_0, GPIO127_MUXMODE_7, SDFM0_D2_MUXMODE_8, MCAN3_TX_MUXMODE_0, GPIO128_MUXMODE_7, SDFM0_CLK3_MUXMODE_8, CHANNEL9_MUXMODE_9, MCAN3_RX_MUXMODE_0, GPIO129_MUXMODE_7, SDFM0_D3_MUXMODE_8, UART4_RTSn_MUXMODE_0, SPI4_CLK_MUXMODE_3, GPIO130_MUXMODE_7, SDFM1_CLK0_MUXMODE_9, UART4_CTSn_MUXMODE_0, SPI4_CS0_MUXMODE_3, GPIO131_MUXMODE_7, SDFM1_D0_MUXMODE_9, UART4_TXD_MUXMODE_0, LIN4_TXD_MUXMODE_1, SPI4_D0_MUXMODE_3, GPIO132_MUXMODE_7, SDFM1_CLK1_MUXMODE_9, CHANNEL2_MUXMODE_10, UART4_RXD_MUXMODE_0, LIN4_RXD_MUXMODE_1, SPI4_D1_MUXMODE_3, GPIO133_MUXMODE_7, SDFM1_D1_MUXMODE_9, CHANNEL3_MUXMODE_10, I2C0_SDA_MUXMODE_0, GPIO134_MUXMODE_7, SDFM1_CLK2_MUXMODE_9, I2C0_SCL_MUXMODE_0, GPIO135_MUXMODE_7, SDFM1_CLK3_MUXMODE_9, MCAN2_TX_MUXMODE_0, GPIO136_MUXMODE_7, SDFM1_D2_MUXMODE_9, MCAN2_RX_MUXMODE_0, GPIO137_MUXMODE_7, SDFM1_D3_MUXMODE_9, CLKOUT0_MUXMODE_0, GPIO138_MUXMODE_7, WARMRSTn_MUXMODE_0, SAFETY_ERRORn_MUXMODE_0, TDI_MUXMODE_0, TDO_MUXMODE_0, TMS_MUXMODE_0, TCK_MUXMODE_0, PORz_MUXMODE_0, XTAL_XI_MUXMODE_0, XTAL_XO_MUXMODE_0, DAC_VREF0_MUXMODE_0, DAC_VREF1_MUXMODE_0, DAC_OUT_MUXMODE_0, VSYS_MON_MUXMODE_0, NULL}, origin=Texas Instruments, set at post-build in variant post-build / pre-compile in variant pre-compile, default-value=TCK_MUXMODE_0  # Port pin gpio muxmode from mode list for use with Port_Init() function.
          enumeration PortPinLevelValue: {PORT_PIN_LEVEL_HIGH, PORT_PIN_LEVEL_LOW}, set at post-build in variant post-build / pre-compile in variant pre-compile, default-value=PORT_PIN_LEVEL_HIGH  # Port Pin Level value from Port pin list.
          enumeration PortPinMode [1..*]: {OSPI0_CSn0_MUXMODE_0, OSPI0_D0_MUXMODE_6, GPIO0_MUXMODE_7, OSPI0_CSn1_MUXMODE_0, MCAN5_TX_MUXMODE_2, SPI4_CS1_MUXMODE_4, XBAROUT0_MUXMODE_5, UART2_RTSn_MUXMODE_6, GPIO1_MUXMODE_7, FSIRX2_D1_MUXMODE_8, EPWM10_B_MUXMODE_10, OSPI0_CLK_MUXMODE_0, MCAN7_RX_MUXMODE_2, SPI7_CS0_MUXMODE_4, UART3_CTSn_MUXMODE_6, GPIO2_MUXMODE_7, EPWM12_A_MUXMODE_10, OSPI0_D0_MUXMODE_0, MCAN7_TX_MUXMODE_2, SPI7_CLK_MUXMODE_4, UART1_DCDn_MUXMODE_6, GPIO3_MUXMODE_7, EPWM12_B_MUXMODE_10, OSPI0_D1_MUXMODE_0, SPI7_D0_MUXMODE_4, UART1_RIn_MUXMODE_6, GPIO4_MUXMODE_7, EPWM13_A_MUXMODE_10, OSPI0_D2_MUXMODE_0, OSPI0_D6_MUXMODE_6, GPIO5_MUXMODE_7, OSPI0_D3_MUXMODE_0, OSPI0_D4_MUXMODE_6, GPIO6_MUXMODE_7, MCAN0_RX_MUXMODE_0, SPI4_CS0_MUXMODE_1, OSPI0_D4_MUXMODE_2, OSPI0_DQS_MUXMODE_6, GPIO7_MUXMODE_7, MCAN0_TX_MUXMODE_0, SPI4_CLK_MUXMODE_1, OSPI0_D5_MUXMODE_2, OSPI0_D2_MUXMODE_6, GPIO8_MUXMODE_7, MCAN1_RX_MUXMODE_0, SPI4_D0_MUXMODE_1, OSPI0_D6_MUXMODE_2, OSPI0_CLK_MUXMODE_6, GPIO9_MUXMODE_7, MCAN1_TX_MUXMODE_0, SPI4_D1_MUXMODE_1, OSPI0_D7_MUXMODE_2, SPI7_D1_MUXMODE_4, UART1_DTRn_MUXMODE_6, GPIO10_MUXMODE_7, EPWM13_B_MUXMODE_10, SPI0_CS0_MUXMODE_0, UART3_RXD_MUXMODE_1, LIN3_RXD_MUXMODE_2, GPIO11_MUXMODE_7, CHANNEL0_MUXMODE_9, SPI0_CLK_MUXMODE_0, UART3_TXD_MUXMODE_1, LIN3_TXD_MUXMODE_2, FSITX0_CLK_MUXMODE_6, GPIO12_MUXMODE_7, CHANNEL1_MUXMODE_9, SPI0_D0_MUXMODE_0, FSITX0_D0_MUXMODE_6, GPIO13_MUXMODE_7, CHANNEL2_MUXMODE_9, SPI0_D1_MUXMODE_0, FSITX0_D1_MUXMODE_6, GPIO14_MUXMODE_7, CHANNEL3_MUXMODE_9, SPI1_CS0_MUXMODE_0, UART4_TXD_MUXMODE_1, LIN4_TXD_MUXMODE_2, XBAROUT1_MUXMODE_5, GPIO15_MUXMODE_7, CHANNEL4_MUXMODE_9, SPI1_CLK_MUXMODE_0, UART4_RXD_MUXMODE_1, LIN4_RXD_MUXMODE_2, XBAROUT2_MUXMODE_5, FSIRX0_CLK_MUXMODE_6, GPIO16_MUXMODE_7, CHANNEL5_MUXMODE_9, SPI1_D0_MUXMODE_0, UART5_TXD_MUXMODE_1, XBAROUT3_MUXMODE_5, FSIRX0_D0_MUXMODE_6, GPIO17_MUXMODE_7, CHANNEL6_MUXMODE_9, SPI1_D1_MUXMODE_0, UART5_RXD_MUXMODE_1, XBAROUT4_MUXMODE_5, FSIRX0_D1_MUXMODE_6, GPIO18_MUXMODE_7, CHANNEL7_MUXMODE_9, LIN1_RXD_MUXMODE_0, UART1_RXD_MUXMODE_1, SPI2_CS0_MUXMODE_2, OSPI0_ECC_FAIL_MUXMODE_3, XBAROUT5_MUXMODE_5, GPIO19_MUXMODE_7, OSPI0_RESET_OUT1_MUXMODE_8, LIN1_TXD_MUXMODE_0, UART1_TXD_MUXMODE_1, SPI2_CLK_MUXMODE_2, OSPI0_RESET_OUT0_MUXMODE_3, XBAROUT6_MUXMODE_5, GPIO20_MUXMODE_7, LIN2_RXD_MUXMODE_0, UART2_RXD_MUXMODE_1, SPI2_D0_MUXMODE_2, GPIO21_MUXMODE_7, LIN2_TXD_MUXMODE_0, UART2_TXD_MUXMODE_1, SPI2_D1_MUXMODE_2, GPIO22_MUXMODE_7, I2C1_SCL_MUXMODE_0, SPI3_CS0_MUXMODE_2, XBAROUT7_MUXMODE_5, GPIO23_MUXMODE_7, I2C1_SDA_MUXMODE_0, SPI3_CLK_MUXMODE_2, XBAROUT8_MUXMODE_5, GPIO24_MUXMODE_7, UART0_RTSn_MUXMODE_0, I2C2_SCL_MUXMODE_1, SPI3_D0_MUXMODE_2, MCAN3_TX_MUXMODE_3, XBAROUT9_MUXMODE_5, GPIO25_MUXMODE_7, UART0_CTSn_MUXMODE_0, I2C2_SDA_MUXMODE_1, SPI3_D1_MUXMODE_2, MCAN3_RX_MUXMODE_3, SPI0_CS1_MUXMODE_4, XBAROUT10_MUXMODE_5, GPIO26_MUXMODE_7, UART0_RXD_MUXMODE_0, LIN0_RXD_MUXMODE_1, GPIO27_MUXMODE_7, UART0_TXD_MUXMODE_0, LIN0_TXD_MUXMODE_1, GPIO28_MUXMODE_7, RGMII1_RXC_MUXMODE_0, RMII1_REF_CLK_MUXMODE_1, MII1_RXCLK_MUXMODE_2, GPIO29_MUXMODE_7, EQEP2_A_MUXMODE_8, EPWM14_A_MUXMODE_10, RGMII1_RX_CTL_MUXMODE_0, RMII1_RX_ER_MUXMODE_1, MII1_RXDV_MUXMODE_2, GPIO30_MUXMODE_7, EQEP2_B_MUXMODE_8, RGMII1_RD0_MUXMODE_0, RMII1_RXD0_MUXMODE_1, MII1_RXD0_MUXMODE_2, GPIO31_MUXMODE_7, EQEP2_STROBE_MUXMODE_8, RGMII1_RD1_MUXMODE_0, RMII1_RXD1_MUXMODE_1, MII1_RXD1_MUXMODE_2, GPIO32_MUXMODE_7, EQEP2_INDEX_MUXMODE_8, RGMII1_RD2_MUXMODE_0, MII1_RXD2_MUXMODE_2, GPIO33_MUXMODE_7, EQEP0_A_MUXMODE_8, RGMII1_RD3_MUXMODE_0, MII1_RXD3_MUXMODE_2, GPIO34_MUXMODE_7, EQEP0_B_MUXMODE_8, RGMII1_TXC_MUXMODE_0, MII1_TXCLK_MUXMODE_2, FSITX1_CLK_MUXMODE_6, GPIO35_MUXMODE_7, EQEP0_INDEX_MUXMODE_8, EPWM14_B_MUXMODE_10, RGMII1_TX_CTL_MUXMODE_0, RMII1_TX_EN_MUXMODE_1, MII1_TX_EN_MUXMODE_2, FSITX1_D0_MUXMODE_6, GPIO36_MUXMODE_7, EQEP0_STROBE_MUXMODE_8, EPWM15_B_MUXMODE_10, RGMII1_TD0_MUXMODE_0, RMII1_TXD0_MUXMODE_1, MII1_TXD0_MUXMODE_2, FSITX1_D1_MUXMODE_6, GPIO37_MUXMODE_7, EQEP1_A_MUXMODE_8, EPWM15_A_MUXMODE_9, RGMII1_TD1_MUXMODE_0, RMII1_TXD1_MUXMODE_1, MII1_TXD1_MUXMODE_2, FSIRX1_CLK_MUXMODE_6, GPIO38_MUXMODE_7, EQEP1_B_MUXMODE_8, RGMII1_TD2_MUXMODE_0, RMII1_CRS_DV_MUXMODE_1, MII1_TXD2_MUXMODE_2, FSIRX1_D0_MUXMODE_6, GPIO39_MUXMODE_7, EQEP1_STROBE_MUXMODE_8, RGMII1_TD3_MUXMODE_0, MII1_TXD3_MUXMODE_2, FSIRX1_D1_MUXMODE_6, GPIO40_MUXMODE_7, EQEP1_INDEX_MUXMODE_8, MDIO_MDIO_MUXMODE_0, GPIO41_MUXMODE_7, MDIO_MDC_MUXMODE_0, GPIO42_MUXMODE_7, EPWM0_A_MUXMODE_0, GPIO43_MUXMODE_7, EPWM0_A_MUXMODE_10, EPWM0_B_MUXMODE_0, GPIO44_MUXMODE_7, EPWM0_B_MUXMODE_10, EPWM1_A_MUXMODE_0, GPIO45_MUXMODE_7, EPWM1_A_MUXMODE_10, EPWM1_B_MUXMODE_0, GPIO46_MUXMODE_7, EPWM4_B_MUXMODE_10, EPWM2_A_MUXMODE_0, GPIO47_MUXMODE_7, EPWM2_A_MUXMODE_10, EPWM2_B_MUXMODE_0, GPIO48_MUXMODE_7, EPWM2_B_MUXMODE_10, EPWM3_A_MUXMODE_0, GPIO49_MUXMODE_7, EPWM3_A_MUXMODE_10, EPWM3_B_MUXMODE_0, GPIO50_MUXMODE_7, EPWM6_A_MUXMODE_10, EPWM4_A_MUXMODE_0, GPIO51_MUXMODE_7, EPWM4_A_MUXMODE_10, EPWM4_B_MUXMODE_0, GPIO52_MUXMODE_7, EPWM1_B_MUXMODE_10, EPWM5_A_MUXMODE_0, SPI5_CS0_MUXMODE_3, GPIO53_MUXMODE_7, EPWM5_A_MUXMODE_10, EPWM5_B_MUXMODE_0, SPI5_CLK_MUXMODE_3, GPIO54_MUXMODE_7, EPWM8_B_MUXMODE_10, EPWM6_A_MUXMODE_0, SPI5_D0_MUXMODE_3, GPIO55_MUXMODE_7, EPWM3_B_MUXMODE_10, EPWM6_B_MUXMODE_0, SPI5_D1_MUXMODE_3, GPIO56_MUXMODE_7, EPWM6_B_MUXMODE_10, EPWM7_A_MUXMODE_0, SPI6_CS0_MUXMODE_3, GPIO57_MUXMODE_7, EPWM7_A_MUXMODE_10, EPWM7_B_MUXMODE_0, SPI6_CLK_MUXMODE_3, GPIO58_MUXMODE_7, EPWM5_B_MUXMODE_10, EPWM8_A_MUXMODE_0, I2C3_SDA_MUXMODE_2, SPI6_D0_MUXMODE_3, FSITX2_CLK_MUXMODE_6, GPIO59_MUXMODE_7, EPWM8_A_MUXMODE_10, EPWM8_B_MUXMODE_0, I2C3_SCL_MUXMODE_2, SPI6_D1_MUXMODE_3, FSITX2_D0_MUXMODE_6, GPIO60_MUXMODE_7, EPWM9_B_MUXMODE_10, EPWM9_A_MUXMODE_0, SPI7_CS0_MUXMODE_3, MCAN4_RX_MUXMODE_4, FSITX2_D1_MUXMODE_6, GPIO61_MUXMODE_7, EPWM9_A_MUXMODE_10, EPWM9_B_MUXMODE_0, UART1_RTSn_MUXMODE_1, SPI7_CLK_MUXMODE_3, MCAN4_TX_MUXMODE_4, FSIRX2_CLK_MUXMODE_6, GPIO62_MUXMODE_7, EPWM11_B_MUXMODE_10, EPWM10_A_MUXMODE_0, UART1_CTSn_MUXMODE_1, SPI7_D0_MUXMODE_3, MCAN5_RX_MUXMODE_4, FSIRX2_D0_MUXMODE_6, GPIO63_MUXMODE_7, EPWM7_B_MUXMODE_10, EPWM10_B_MUXMODE_0, UART2_RTSn_MUXMODE_1, SPI7_D1_MUXMODE_3, MCAN5_TX_MUXMODE_4, OSPI0_RESET_OUT0_MUXMODE_5, FSIRX2_D1_MUXMODE_6, GPIO64_MUXMODE_7, EPWM11_A_MUXMODE_0, UART2_CTSn_MUXMODE_1, OSPI0_ECC_FAIL_MUXMODE_2, MCAN6_RX_MUXMODE_4, OSPI0_RESET_OUT1_MUXMODE_5, OSPI0_CSn0_MUXMODE_6, GPIO65_MUXMODE_7, EPWM11_A_MUXMODE_10, EPWM11_B_MUXMODE_0, UART3_RTSn_MUXMODE_1, OSPI0_RESET_OUT0_MUXMODE_2, MCAN6_TX_MUXMODE_4, OSPI0_D1_MUXMODE_6, GPIO66_MUXMODE_7, EPWM12_A_MUXMODE_0, UART3_CTSn_MUXMODE_1, SPI4_CS1_MUXMODE_2, MCAN7_RX_MUXMODE_4, OSPI0_D5_MUXMODE_6, GPIO67_MUXMODE_7, EPWM12_B_MUXMODE_0, UART1_DCDn_MUXMODE_1, SPI7_CS0_MUXMODE_2, MCAN7_TX_MUXMODE_4, OSPI0_D7_MUXMODE_6, GPIO68_MUXMODE_7, EPWM10_A_MUXMODE_10, EPWM13_A_MUXMODE_0, UART1_RIn_MUXMODE_1, SPI7_CLK_MUXMODE_2, OSPI0_D3_MUXMODE_6, GPIO69_MUXMODE_7, EPWM13_B_MUXMODE_0, UART1_DTRn_MUXMODE_1, SPI7_D0_MUXMODE_2, OSPI0_ECC_FAIL_MUXMODE_6, GPIO70_MUXMODE_7, EPWM14_A_MUXMODE_0, UART1_DSRn_MUXMODE_1, SPI7_D1_MUXMODE_2, MCAN6_RX_MUXMODE_3, GPIO71_MUXMODE_7, EPWM14_B_MUXMODE_0, MII1_RX_ER_MUXMODE_2, MCAN6_TX_MUXMODE_3, GPIO72_MUXMODE_7, EPWM15_A_MUXMODE_0, MII1_COL_MUXMODE_2, MCAN7_RX_MUXMODE_3, GPIO73_MUXMODE_7, EPWM15_A_MUXMODE_10, EPWM15_B_MUXMODE_0, MII1_CRS_MUXMODE_2, MCAN7_TX_MUXMODE_3, GPIO74_MUXMODE_7, UART1_RXD_MUXMODE_0, LIN1_RXD_MUXMODE_1, OSPI0_LBCLKO_MUXMODE_2, EPWM16_A_MUXMODE_5, GPIO75_MUXMODE_7, EPWM16_A_MUXMODE_10, EPWM10_A_MUXMODE_11, UART1_TXD_MUXMODE_0, LIN1_TXD_MUXMODE_1, OSPI0_DQS_MUXMODE_2, EPWM16_B_MUXMODE_5, GPIO76_MUXMODE_7, EPWM16_B_MUXMODE_10, MMC_CLK_MUXMODE_0, UART0_RXD_MUXMODE_1, LIN0_RXD_MUXMODE_2, MCAN0_RX_MUXMODE_3, EPWM17_A_MUXMODE_5, GPIO77_MUXMODE_7, SDFM1_CLK0_MUXMODE_8, EPWM17_A_MUXMODE_10, MMC_CMD_MUXMODE_0, UART0_TXD_MUXMODE_1, LIN0_TXD_MUXMODE_2, MCAN0_TX_MUXMODE_3, EPWM17_B_MUXMODE_5, GPIO78_MUXMODE_7, SDFM1_D0_MUXMODE_8, EPWM17_B_MUXMODE_10, MMC_DAT0_MUXMODE_0, I2C1_SCL_MUXMODE_2, MCAN1_RX_MUXMODE_3, EPWM18_A_MUXMODE_5, GPIO79_MUXMODE_7, SDFM1_CLK1_MUXMODE_8, EPWM18_A_MUXMODE_10, MMC_DAT1_MUXMODE_0, MCAN1_TX_MUXMODE_3, EPWM18_B_MUXMODE_5, GPIO80_MUXMODE_7, SDFM1_D1_MUXMODE_8, EPWM18_B_MUXMODE_10, MMC_DAT2_MUXMODE_0, I2C1_SDA_MUXMODE_2, MCAN4_RX_MUXMODE_3, EPWM19_A_MUXMODE_5, GPIO81_MUXMODE_7, SDFM1_CLK2_MUXMODE_8, EPWM19_A_MUXMODE_10, MMC_DAT3_MUXMODE_0, MCAN4_TX_MUXMODE_3, EPWM19_B_MUXMODE_5, GPIO82_MUXMODE_7, SDFM1_D2_MUXMODE_8, EPWM19_B_MUXMODE_10, MMC_SDWP_MUXMODE_0, UART0_RTSn_MUXMODE_1, I2C2_SCL_MUXMODE_2, MCAN5_RX_MUXMODE_3, EPWM20_A_MUXMODE_5, GPIO83_MUXMODE_7, SDFM1_CLK3_MUXMODE_8, EPWM20_A_MUXMODE_10, MMC_SDCD_MUXMODE_0, UART0_CTSn_MUXMODE_1, I2C2_SDA_MUXMODE_2, MCAN5_TX_MUXMODE_3, EPWM20_B_MUXMODE_5, GPIO84_MUXMODE_7, SDFM1_D3_MUXMODE_8, EPWM20_B_MUXMODE_10, PR0_MDIO_MDIO_MUXMODE_0, EPWM21_A_MUXMODE_5, GPIO85_MUXMODE_7, EPWM21_A_MUXMODE_10, PR0_MDIO_MDC_MUXMODE_0, EPWM21_B_MUXMODE_5, GPIO86_MUXMODE_7, EPWM21_B_MUXMODE_10, PR0_PRU0_GPIO5_MUXMODE_0, RMII2_RX_ER_MUXMODE_2, MII2_RX_ER_MUXMODE_4, EPWM22_A_MUXMODE_5, GPIO87_MUXMODE_7, EPWM22_A_MUXMODE_10, PR0_PRU0_GPIO9_MUXMODE_0, PR0_UART0_CTSn_MUXMODE_3, MII2_COL_MUXMODE_4, EPWM22_B_MUXMODE_5, GPIO88_MUXMODE_7, PR0_PRU0_GPIO10_MUXMODE_0, RMII2_CRS_DV_MUXMODE_2, PR0_UART0_RTSn_MUXMODE_3, MII2_CRS_MUXMODE_4, EPWM23_A_MUXMODE_5, GPIO89_MUXMODE_7, EPWM22_B_MUXMODE_10, PR0_PRU0_GPIO8_MUXMODE_0, EPWM23_B_MUXMODE_5, GPIO90_MUXMODE_7, EPWM29_A_MUXMODE_10, PR0_PRU0_GPIO6_MUXMODE_0, RMII2_REF_CLK_MUXMODE_2, RGMII2_RXC_MUXMODE_3, MII2_RXCLK_MUXMODE_4, EPWM24_A_MUXMODE_5, GPIO91_MUXMODE_7, EPWM24_A_MUXMODE_10, PR0_PRU0_GPIO4_MUXMODE_0, RGMII2_RX_CTL_MUXMODE_3, MII2_RXDV_MUXMODE_4, EPWM24_B_MUXMODE_5, GPIO92_MUXMODE_7, EPWM24_B_MUXMODE_10, PR0_PRU0_GPIO0_MUXMODE_0, RMII2_RXD0_MUXMODE_2, RGMII2_RD0_MUXMODE_3, MII2_RXD0_MUXMODE_4, EPWM25_A_MUXMODE_5, GPIO93_MUXMODE_7, EPWM25_A_MUXMODE_10, PR0_PRU0_GPIO1_MUXMODE_0, RMII2_RXD1_MUXMODE_2, RGMII2_RD1_MUXMODE_3, MII2_RXD1_MUXMODE_4, EPWM25_B_MUXMODE_5, GPIO94_MUXMODE_7, EPWM25_B_MUXMODE_10, PR0_PRU0_GPIO2_MUXMODE_0, RGMII2_RD2_MUXMODE_3, MII2_RXD2_MUXMODE_4, EPWM26_A_MUXMODE_5, GPIO95_MUXMODE_7, EPWM26_A_MUXMODE_10, PR0_PRU0_GPIO3_MUXMODE_0, RGMII2_RD3_MUXMODE_3, MII2_RXD3_MUXMODE_4, EPWM26_B_MUXMODE_5, GPIO96_MUXMODE_7, EPWM26_B_MUXMODE_10, PR0_PRU0_GPIO16_MUXMODE_0, RGMII2_TXC_MUXMODE_3, MII2_TXCLK_MUXMODE_4, EPWM27_A_MUXMODE_5, GPIO97_MUXMODE_7, EPWM27_A_MUXMODE_10, PR0_PRU0_GPIO15_MUXMODE_0, RMII2_TX_EN_MUXMODE_2, RGMII2_TX_CTL_MUXMODE_3, MII2_TX_EN_MUXMODE_4, EPWM27_B_MUXMODE_5, GPIO98_MUXMODE_7, PR0_PRU0_GPIO11_MUXMODE_0, RMII2_TXD0_MUXMODE_2, RGMII2_TD0_MUXMODE_3, MII2_TXD0_MUXMODE_4, EPWM28_A_MUXMODE_5, GPIO99_MUXMODE_7, EPWM28_A_MUXMODE_10, PR0_PRU0_GPIO12_MUXMODE_0, RMII2_TXD1_MUXMODE_2, RGMII2_TD1_MUXMODE_3, MII2_TXD1_MUXMODE_4, EPWM28_B_MUXMODE_5, GPIO100_MUXMODE_7, EPWM28_B_MUXMODE_10, PR0_PRU0_GPIO13_MUXMODE_0, RGMII2_TD2_MUXMODE_3, MII2_TXD2_MUXMODE_4, EPWM29_A_MUXMODE_5, GPIO101_MUXMODE_7, EPWM27_B_MUXMODE_10, PR0_PRU0_GPIO14_MUXMODE_0, RGMII2_TD3_MUXMODE_3, MII2_TXD3_MUXMODE_4, EPWM29_B_MUXMODE_5, GPIO102_MUXMODE_7, EPWM29_B_MUXMODE_10, PR0_PRU1_GPIO5_MUXMODE_0, SPI5_CS0_MUXMODE_2, TRC_DATA0_MUXMODE_4, EPWM30_A_MUXMODE_5, GPIO103_MUXMODE_7, EPWM30_A_MUXMODE_10, PR0_PRU1_GPIO9_MUXMODE_0, SPI5_CLK_MUXMODE_2, PR0_UART0_RXD_MUXMODE_3, TRC_DATA1_MUXMODE_4, EPWM30_B_MUXMODE_5, GPIO104_MUXMODE_7, PR0_PRU1_GPIO10_MUXMODE_0, SPI5_D0_MUXMODE_2, PR0_UART0_TXD_MUXMODE_3, TRC_DATA2_MUXMODE_4, EPWM31_A_MUXMODE_5, GPIO105_MUXMODE_7, RES0_PWMOUT0_MUXMODE_8, EPWM31_A_MUXMODE_10, PR0_PRU1_GPIO8_MUXMODE_0, SPI5_D1_MUXMODE_2, TRC_DATA3_MUXMODE_4, EPWM31_B_MUXMODE_5, GPIO106_MUXMODE_7, RES0_PWMOUT1_MUXMODE_8, EPWM31_B_MUXMODE_10, PR0_PRU1_GPIO6_MUXMODE_0, MCAN0_RX_MUXMODE_1, FSITX2_CLK_MUXMODE_3, TRC_DATA4_MUXMODE_4, GPIO107_MUXMODE_7, PR0_PRU1_GPIO4_MUXMODE_0, MCAN0_TX_MUXMODE_1, FSITX2_D0_MUXMODE_3, TRC_DATA5_MUXMODE_4, GPIO108_MUXMODE_7, PR0_PRU1_GPIO0_MUXMODE_0, MCAN1_RX_MUXMODE_1, FSITX2_D1_MUXMODE_3, TRC_DATA6_MUXMODE_4, GPIO109_MUXMODE_7, EPWM23_A_MUXMODE_10, PR0_PRU1_GPIO1_MUXMODE_0, MCAN1_TX_MUXMODE_1, FSIRX2_CLK_MUXMODE_3, TRC_DATA7_MUXMODE_4, GPIO110_MUXMODE_7, PR0_PRU1_GPIO2_MUXMODE_0, MCAN4_RX_MUXMODE_1, FSIRX2_D0_MUXMODE_3, TRC_DATA8_MUXMODE_4, GPIO111_MUXMODE_7, PR0_PRU1_GPIO3_MUXMODE_0, MCAN4_TX_MUXMODE_1, FSIRX2_D1_MUXMODE_3, TRC_DATA9_MUXMODE_4, GPIO112_MUXMODE_7, EPWM23_B_MUXMODE_10, PR0_PRU1_GPIO16_MUXMODE_0, MCAN5_RX_MUXMODE_1, FSITX3_CLK_MUXMODE_3, TRC_DATA10_MUXMODE_4, GPIO113_MUXMODE_7, PR0_PRU1_GPIO15_MUXMODE_0, MCAN5_TX_MUXMODE_1, FSITX3_D0_MUXMODE_3, TRC_DATA11_MUXMODE_4, GPIO114_MUXMODE_7, PR0_PRU1_GPIO11_MUXMODE_0, MCAN6_RX_MUXMODE_1, SPI6_CS0_MUXMODE_2, FSITX3_D1_MUXMODE_3, TRC_DATA12_MUXMODE_4, GPIO115_MUXMODE_7, PR0_PRU1_GPIO12_MUXMODE_0, MCAN6_TX_MUXMODE_1, SPI6_CLK_MUXMODE_2, FSIRX3_CLK_MUXMODE_3, TRC_DATA13_MUXMODE_4, GPIO116_MUXMODE_7, PR0_PRU1_GPIO13_MUXMODE_0, MCAN7_RX_MUXMODE_1, SPI6_D0_MUXMODE_2, FSIRX3_D0_MUXMODE_3, TRC_DATA14_MUXMODE_4, XBAROUT11_MUXMODE_5, GPIO117_MUXMODE_7, PR0_PRU1_GPIO14_MUXMODE_0, MCAN7_TX_MUXMODE_1, SPI6_D1_MUXMODE_2, FSIRX3_D1_MUXMODE_3, TRC_DATA15_MUXMODE_4, XBAROUT12_MUXMODE_5, GPIO118_MUXMODE_7, PR0_PRU1_GPIO19_MUXMODE_0, UART3_RXD_MUXMODE_2, PR0_IEP0_EDC_SYNC_OUT0_MUXMODE_3, TRC_CLK_MUXMODE_4, XBAROUT13_MUXMODE_5, GPIO119_MUXMODE_7, EQEP1_A_MUXMODE_9, PR0_PRU1_GPIO18_MUXMODE_0, UART3_TXD_MUXMODE_2, PR0_IEP0_EDIO_DATA_IN_OUT31_MUXMODE_3, TRC_CTL_MUXMODE_4, XBAROUT14_MUXMODE_5, GPIO120_MUXMODE_7, EQEP1_B_MUXMODE_9, EXT_REFCLK0_MUXMODE_0, XBAROUT15_MUXMODE_5, GPIO121_MUXMODE_7, EQEP1_INDEX_MUXMODE_9, CLKOUT1_MUXMODE_0, GPIO122_MUXMODE_7, SDFM0_CLK0_MUXMODE_8, EQEP1_STROBE_MUXMODE_9, PR0_ECAP0_APWM_OUT_MUXMODE_0, GPIO123_MUXMODE_7, SDFM0_D0_MUXMODE_8, PR0_PRU1_GPIO7_MUXMODE_0, CPTS0_TS_SYNC_MUXMODE_1, UART5_RTSn_MUXMODE_2, PR0_IEP0_EDC_SYNC_OUT1_MUXMODE_3, I2C3_SDA_MUXMODE_5, GPIO124_MUXMODE_7, SDFM0_CLK1_MUXMODE_8, PR0_PRU1_GPIO17_MUXMODE_0, UART5_CTSn_MUXMODE_2, PR0_IEP0_EDIO_DATA_IN_OUT30_MUXMODE_3, GPIO125_MUXMODE_7, SDFM0_D1_MUXMODE_8, UART5_TXD_MUXMODE_0, I2C3_SCL_MUXMODE_5, GPIO126_MUXMODE_7, SDFM0_CLK2_MUXMODE_8, CHANNEL8_MUXMODE_9, UART5_RXD_MUXMODE_0, GPIO127_MUXMODE_7, SDFM0_D2_MUXMODE_8, MCAN3_TX_MUXMODE_0, GPIO128_MUXMODE_7, SDFM0_CLK3_MUXMODE_8, CHANNEL9_MUXMODE_9, MCAN3_RX_MUXMODE_0, GPIO129_MUXMODE_7, SDFM0_D3_MUXMODE_8, UART4_RTSn_MUXMODE_0, SPI4_CLK_MUXMODE_3, GPIO130_MUXMODE_7, SDFM1_CLK0_MUXMODE_9, UART4_CTSn_MUXMODE_0, SPI4_CS0_MUXMODE_3, GPIO131_MUXMODE_7, SDFM1_D0_MUXMODE_9, UART4_TXD_MUXMODE_0, LIN4_TXD_MUXMODE_1, SPI4_D0_MUXMODE_3, GPIO132_MUXMODE_7, SDFM1_CLK1_MUXMODE_9, CHANNEL2_MUXMODE_10, UART4_RXD_MUXMODE_0, LIN4_RXD_MUXMODE_1, SPI4_D1_MUXMODE_3, GPIO133_MUXMODE_7, SDFM1_D1_MUXMODE_9, CHANNEL3_MUXMODE_10, I2C0_SDA_MUXMODE_0, GPIO134_MUXMODE_7, SDFM1_CLK2_MUXMODE_9, I2C0_SCL_MUXMODE_0, GPIO135_MUXMODE_7, SDFM1_CLK3_MUXMODE_9, MCAN2_TX_MUXMODE_0, GPIO136_MUXMODE_7, SDFM1_D2_MUXMODE_9, MCAN2_RX_MUXMODE_0, GPIO137_MUXMODE_7, SDFM1_D3_MUXMODE_9, CLKOUT0_MUXMODE_0, GPIO138_MUXMODE_7, WARMRSTn_MUXMODE_0, SAFETY_ERRORn_MUXMODE_0, TDI_MUXMODE_0, TDO_MUXMODE_0, TMS_MUXMODE_0, TCK_MUXMODE_0, PORz_MUXMODE_0, XTAL_XI_MUXMODE_0, XTAL_XO_MUXMODE_0, DAC_VREF0_MUXMODE_0, DAC_VREF1_MUXMODE_0, DAC_OUT_MUXMODE_0, VSYS_MON_MUXMODE_0}, multiplicity set at post-build in variant post-build / pre-compile in variant pre-compile, set at post-build in variant post-build / pre-compile in variant pre-compile, default-value=TCK_MUXMODE_0  # Port pin mode from mode list.
          boolean PortPinModeChangeable: set at post-build in variant post-build / pre-compile in variant pre-compile, default-value=false  # Parameter to indicate if the mode is changeable on a port pin during runtime. True: Port Pin mode changeable allowed. False: Port Pin mode changeable not permitted.
          enumeration PortPinInhibitEnable: {PORT_PIN_PULL_INHIBIT_ENABLE, PORT_PIN_PULL_INHIBIT_DISABLE, PORT_PIN_PULL_INHIBIT_DEFAULT}, origin=Texas Instruments, set at post-build in variant post-build / pre-compile in variant pre-compile, default-value=PORT_PIN_PULL_INHIBIT_DISABLE  # The port pin inhibit enable.
          enumeration PortPullTypeSelect: {PORT_PIN_PULLTYPE_PULLDOWN, PORT_PIN_PULLTYPE_PULLUP, PORT_PIN_PULLTYPE_DEFAULT}, origin=Texas Instruments, set at post-build in variant post-build / pre-compile in variant pre-compile, default-value=PORT_PIN_PULLTYPE_PULLDOWN  # Type of PULL U/D selection
          boolean PortPinHSmasterEnable [0..0]: origin=Texas Instruments, set at post-build in variant post-build / pre-compile in variant pre-compile, default-value=false  # Parameter to enable HSMASTER
          boolean PortPinHSmodeEnable [0..0]: origin=Texas Instruments, set at post-build in variant post-build / pre-compile in variant pre-compile, default-value=false  # Parameter to enable HSMODE
          enumeration PortInputInversionSelect: {PORT_INV, PORT_NONINV, PORT_INVTYPE_DEFAULT}, origin=Texas Instruments, set at post-build in variant post-build / pre-compile in variant pre-compile, default-value=PORT_INVTYPE_DEFAULT  # Parameter to select port pin inversion (select value for chosing inverted version of PAD input for chip)
          enumeration PortQualifierTypeSelect: {PORT_SYNC_QUAL, PORT_THREE_SAMPLE_QUAL, PORT_SIX_SAMPLE_QUAL, PORT_ASYNC_QUAL, PORT_QUALTYPE_DEFAULT}, origin=Texas Instruments, set at post-build in variant post-build / pre-compile in variant pre-compile, default-value=PORT_QUALTYPE_DEFAULT  # Parameter to select port Qualifier Type (select value for chosing input qualifer type for PAD.)
          enumeration PortSlewControlSelect: {PORT_PIN_SLEWCONTROL_FAST_SLEW, PORT_PIN_SLEWCONTROL_SLOW_SLEW, PORT_PIN_SLEWCONTROL_DEFAULT}, origin=Texas Instruments, set at post-build in variant post-build / pre-compile in variant pre-compile, default-value=PORT_PIN_SLEWCONTROL_FAST_SLEW  # Slew control configuration
          enumeration PortInputOverrideCtrl: {PORT_PIN_DISABLE_INPUT_OVERRIDE, PORT_PIN_ENABLE_INPUT_OVERRIDE, PORT_PIN_INPUT_RETAIN_HW_CTRL}, origin=Texas Instruments, set at pre-compile in variant pre-compile / post-build in variant post-build, default-value=PORT_PIN_INPUT_RETAIN_HW_CTRL  # Port inputOverride control (Keep these value as PORT_PIN_DISABLE_INPUT_OVERRIDE while configuring pin as a GPIO)
          enumeration PortOutputOverrideCtrl: {PORT_PIN_DISABLE_OUTPUT_OVERRIDE, PORT_PIN_ENABLE_OUTPUT_OVERRIDE, PORT_PIN_OUTPUT_RETAIN_HW_CTRL}, origin=Texas Instruments, set at pre-compile in variant pre-compile / post-build in variant post-build, default-value=PORT_PIN_OUTPUT_RETAIN_HW_CTRL  # Port OutputOverride control (Keep these value as PORT_PIN_DISABLE_OUTPUT_OVERRIDE while configuring pin as a GPIO)
          integer PortGpioOwnerCore: 0..3, origin=Texas Instruments, set at pre-compile, default-value=0  # PIN ownership of GPIO. 0 - R5FSS0 Core0, 1 - R5FSS0 Core1, 2 - R5FSS1 Core0, 3 - R5FSS1 Core1
      container PortDioConfig [0..138]  # Structure for GPIO Interrupt configuration
        integer PortDioPinNumber: -9223372036854775808..9223372036854775807, origin=Texas Instruments, set at pre-compile in variant pre-compile / post-build in variant post-build, default-value=0  # Port GPIO Pin Numbers (0 to 138)
        enumeration PortPinSelectEdgeTrigger: {PORT_RISING_EDGE, PORT_FALLING_EDGE, PORT_BOTH_EDGE}, origin=Texas Instruments, set at post-build in variant post-build / pre-compile in variant pre-compile, default-value=PORT_RISING_EDGE  # Type of EdgeTrigger selection
        enumeration PortPinSelectInterruptType: {PORT_CHANNEL_INTR, PORT_BANK_INTR}, origin=Texas Instruments, set at post-build in variant post-build / pre-compile in variant pre-compile, default-value=PORT_BANK_INTR  # Select Interrupt type
        function name PortDioInterruptNotification: origin=Texas Instruments, set at post-build in variant post-build / pre-compile in variant pre-compile, default-value=NULL_PTR  # Definition of the Callback function.
        reference PortMcuGpioXbarReference: origin=Texas Instruments, set at post-build in variant post-build / pre-compile in variant pre-compile, destination=McuGpioXbarIntrConfiguration  # Reference to the McuGpioXbarIntrConfiguration container
    container PortGeneral  # Module wide configuration parameters of the PORT driver.
      boolean PortDevErrorDetect: set at pre-compile, default-value=true  # Switches the Development Error Detection and Notification on or off.
      enumeration PortDeviceVariant: {AM263Px}, origin=Texas Instruments, set at post-build in variant post-build / pre-compile in variant pre-compile, default-value=AM263Px  # Select SOC variant .This parameter shall be used by driver to impose device specific constraints. The user guide shall detail the device specific constraints
      boolean PortSetPinDirectionApi: set at pre-compile, default-value=true  # Pre-processor switch to enable / disable the use of the function Port_SetPinDirection().
      boolean PortSetPinModeApi: set at pre-compile, default-value=true  # Pre-processor switch to enable / disable the use of the function Port_SetPinMode().
      boolean PortVersionInfoApi: set at pre-compile, default-value=true  # Pre-processor switch to enable / disable the API to read out the modules version information.
      boolean PortRefreshPortDirectionApi: origin=Texas Instruments, set at pre-compile, default-value=true  # Pre-processor switch to enable / disable the API to refresh the port direction.
      integer PortDefaultOSCounterId [0..1]: 0..16, multiplicity set at pre-compile, origin=Texas Instruments, set at pre-compile, default-value=0  # Default Os Counter Id if node reference to OsCounter ref PortOsCounterRef is not set
      boolean PortSafeTIApi: origin=Texas Instruments, set at pre-compile, default-value=true  # Enable/Disable SAFETI Configuration register readback.
      boolean PortEnableIntrApi: origin=Texas Instruments, set at pre-compile, default-value=true  # Pre-processor switch to enable / disable the use of Interrupt Functionality
      boolean PortGetIntrStatusApi: origin=Texas Instruments, set at pre-compile, default-value=true  # Pre-processor switch to enable / disable the use of Port_GetInterruptStatus API
      boolean PortClearIntrStatusApi: origin=Texas Instruments, set at pre-compile, default-value=true  # Pre-processor switch to enable / disable the use of Port_ClearInterruptStatus API
      integer PortTimeoutDuration: 1..4294967295, origin=Texas Instruments, set at pre-compile, default-value=32000  # PORT timeout - used in PORT busy wait
      enumeration PortTypeofInterruptFunction: {PORT_ISR_VOID, PORT_ISR_CAT1, PORT_ISR_CAT2}, origin=Texas Instruments, set at pre-compile, default-value=PORT_ISR_CAT1  # Type of ISR function
      integer PortGpioHostCoreId: 0..3, origin=Texas Instruments, set at pre-compile, default-value=0  # R5F CPU ownership of GPIO. 0 - R5FSS0 Core0, 1 - R5FSS0 Core1, 2 - R5FSS1 Core0, 3 - R5FSS1 Core1
      reference PortOsCounterRef [0..1]: multiplicity set at pre-compile, origin=Texas Instruments, set at pre-compile, destination=OsCounter  # This parameter contains a reference to the OsCounter, which is used by the PORT driver.
    container PortDemEventParameterRefs [0..1]  # Container for the references to DemEventParameter elements which shall be invoked using the API Dem_ReportErrorStatus API in case the corresponding error occurs. The EventId is taken from the referenced DemEventParameter's DemEventId value. The standardized errors are provided in the container and can be extended by vendor specific error references.
      symbolic name reference PORT_E_HARDWARE_ERROR [0..1]: multiplicity set at pre-compile, origin=Texas Instruments, set at pre-compile, destination=DemEventParameter  # Reference to the DemEventParameter which shall be issued when the error "Timeout on blocking API call occurs " has occurred.
