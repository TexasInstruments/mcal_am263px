AUTOSAR XML (schema 00044)
package /TI_AM263Px
  module definition Cdd_FsiRx [0..1]: post-build-variant-support=true, variants post-build/pre-compile  # Configuration of the Cdd Fsi Rx (Fast serial Interface -Receiver) module.
    container CddFsiRxConfigSet  # This container contains the configuration parameters and sub containers of the AUTOSAR Cdd Fsi Rx module.
      function name CddFsiRxResetNotification [0..1]: origin=Texas Instruments, set at post-build in variant post-build / pre-compile in variant pre-compile, default-value=NULL_PTR  # Callback notification to Application to reset the driver
      function name CddFsiRxOverRunNotification [0..1]: origin=Texas Instruments, set at post-build in variant post-build / pre-compile in variant pre-compile, default-value=NULL_PTR  # Callback notification to Application that an over-run occured in Rx buffer
      function name CddFsiRxUnderRunNotification [0..1]: origin=Texas Instruments, set at post-build in variant post-build / pre-compile in variant pre-compile, default-value=NULL_PTR  # Callback notification to Application that an under-run occured in Rx buffer
      function name CddFsiRxPingFrameReceivedNotification [0..1]: origin=Texas Instruments, set at post-build in variant post-build / pre-compile in variant pre-compile, default-value=NULL_PTR  # Callback notification to Application that a ping frame has been received
      function name CddFsiRxDataFrameReceivedNotification [0..1]: origin=Texas Instruments, set at post-build in variant post-build / pre-compile in variant pre-compile, default-value=NULL_PTR  # Callback notification to Application that a data frame has been received
      container CddFsiRxHwUnit [1..*]  # This container contains the Driver configuration (parameters) depending on which FSI Rx Hw unit is get configured
        enumeration CddFsiRxHwUnitId: {CDD_FSI_RX_HWUNIT_0, CDD_FSI_RX_HWUNIT_1, CDD_FSI_RX_HWUNIT_2, CDD_FSI_RX_HWUNIT_3}, origin=Texas Instruments, post-build-variant-value=true, set at post-build in variant post-build / pre-compile in variant pre-compile, default-value=CDD_FSI_RX_HWUNIT_0  # Description: Numeric ID of the Rx HW Unit. For the ping treceived frame interrupt the rx hw baseadress is needed. for that listing out the id as well.
        integer CddFsiRxPingWdgTimerTimeout: 0..4294967295, origin=Texas Instruments, set at post-build in variant post-build / pre-compile in variant pre-compile, default-value=20010  # Timeout value for CddFsiRx Ping Wdg Timer.
        integer CddFsiRxFrameWdgTimerTimeout: 0..4294967295, origin=Texas Instruments, set at post-build in variant post-build / pre-compile in variant pre-compile, default-value=10010  # Timeout value for CddFsiRx Frame Wdg Timer.
        enumeration CddFsiRxReceptionMethod: {CDD_FSI_RX_INTERRUPT_MODE, CDD_FSI_RX_POLLING_MODE, CDD_FSI_RX_DMA_MODE}, origin=Texas Instruments, set at post-build in variant post-build / pre-compile in variant pre-compile, default-value=CDD_FSI_RX_INTERRUPT_MODE  # Selects the method of frame reception.
        reference CddFsiRxDmaReference [0..1]: multiplicity set at post-build in variant post-build / pre-compile in variant pre-compile, origin=Texas Instruments, set at post-build in variant post-build / pre-compile in variant pre-compile, destination=CddDmaDriverHandler  # Reference to the DMA Group Channel
    container CddFsiRxGeneral  # General configuration (parameters) of the Cdd Fsi Rx Driver software module.
      boolean CddFsiRxDeInitApi: origin=Texas Instruments, set at pre-compile, default-value=true  # Adds / removes the service CddFsiRx_DeInit() from the code.
      boolean CddFsiRxDevErrorDetectApi: origin=Texas Instruments, set at pre-compile, default-value=true  # Switches the development error detection and notification on or off.
      enumeration CddFsiRxTypeofInterruptFunction: {CDD_FSI_RX_ISR_VOID, CDD_FSI_RX_ISR_CAT1, CDD_FSI_RX_ISR_CAT2}, origin=Texas Instruments, set at pre-compile, default-value=CDD_FSI_RX_ISR_CAT1  # Type of ISR function
      enumeration CddFsiRxInterruptVector: {CDD_FSI_RX_INT1, CDD_FSI_RX_INT2}, origin=Texas Instruments, set at pre-compile, default-value=CDD_FSI_RX_INT1  # Type of ISR function
      enumeration CddFsiRxDeviceVariant: {AM263Px}, origin=Texas Instruments, set at pre-compile, default-value=AM263Px  # Select SOC variant .This parameter shall be used by driver to impose device specific constraints. The user guide shall detail the device specific constraints
      integer CddFsiRxMaxHwUnitCount: 1..4, origin=Texas Instruments, set at pre-compile, default-value=1  # Maximum hw count across all hwunits configured
      integer CddFsiRxMaxDmaChannelId: origin=Texas Instruments, set at published-information, default-value=63  # Number of actual DMA channels. This is of type published information and not editable
      boolean CddFsiRxNotifyCapability: origin=Texas Instruments, set at pre-compile, default-value=true  # Determines, if the notification mechanism (the functions to enable and disable the notifications) is available at runtime.
      boolean CddFsiRxPingWdgTimeoutInterruptEvent: origin=Texas Instruments, set at pre-compile, default-value=true  # Enables the interrupt Event for Ping Watch Dog Timer.
      boolean CddFsiRxFrameWdgTimeoutInterruptEvent: origin=Texas Instruments, set at pre-compile, default-value=true  # Enables the interrupt Event for Frame Watch Dog Timer.
      boolean CddFsiRxCRCErrorInterruptEvent: origin=Texas Instruments, set at pre-compile, default-value=true  # Enables the interrupt Event for CRC Error.
      boolean CddFsiRxBufferOverRunInterruptEvent: origin=Texas Instruments, set at pre-compile, default-value=true  # Enables the interrupt Event for Rx Buffer Over Run.
      boolean CddFsiRxUnderRunInterruptEvent: origin=Texas Instruments, set at pre-compile, default-value=true  # Enables the interrupt Event for Rx Buffer UnderRun.
      boolean CddFsiRxPingFrameReceivedInterruptEvent: origin=Texas Instruments, set at pre-compile, default-value=true  # Enables the interrupt Event for Ping Frame Reception.
      boolean CddFsiRxDataFrameReceivedInterruptEvent: origin=Texas Instruments, set at pre-compile, default-value=true  # Enables the interrupt Event for Data Frame Reception.
      boolean CddFsiRxEnableRegisterReadbackApi: origin=Texas Instruments, set at pre-compile, default-value=true  # Switch to indicate that the CddFsiRx_RegisterReadBack is supported
      boolean CddFsiRxMainApi: origin=Texas Instruments, set at pre-compile, default-value=true  # Adds / removes the service CddFsiRx_Main() and from the code.
      boolean CddFsiRxResetDriver: origin=Texas Instruments, set at pre-compile, default-value=true  # Adds / removes the service Cdd_FsiRx_ResetDriver() and from the code.
      boolean CddFsiRxGetVersionInfoApi: origin=Texas Instruments, set at pre-compile, default-value=true  # Adds / removes the service CddFsiRx_GetVersionInfo() from the code.
      boolean CddFsiRxDMAEnable: origin=Texas Instruments, set at pre-compile, default-value=false  # Enables DMA Access method for CddFsiRx Reception.
      boolean CddFsiRxMultiLaneEnable: origin=Texas Instruments, set at pre-compile, default-value=false  # Enables MultiLane Transmission for CddFsiRx.
      integer CddFsiRxDefaultOSCounterId: 0..16, origin=Texas Instruments, set at pre-compile, default-value=0  # Default Os Counter Id if node reference to OsCounter ref CddFsiRxOsCounterRef is not set
      reference CddFsiRxOsCounterRef [0..1]: origin=Texas Instruments, set at pre-compile, destination=OsCounter  # This parameter contains a reference to the OsCounter, which is used by the CddFsiRx driver.
    container CddFsiRxDemEventParameterRefs [0..1]  # Container for the references to DemEventParameter elements which shall be invoked using the API Dem_SetEventStatus API in case the corresponding error occurs. The EventId is taken from the referenced DemEventParameter's DemEventId value. The standardized errors are provided in the container and can be extended by vendor specific error references.
      symbolic name reference CDD_FSI_RX_E_BUFF_UNDERRUN [0..1]: multiplicity set at pre-compile, origin=Texas Instruments, set at pre-compile, destination=DemEventParameter  # Reference to the DemEventParameter which shall be issued when the error "Transmotter Buffer under-run occurs " has occurred.
      symbolic name reference CDD_FSI_RX_E_BUFF_OVERRUN [0..1]: multiplicity set at pre-compile, origin=Texas Instruments, set at pre-compile, destination=DemEventParameter  # Reference to the DemEventParameter which shall be issued when the error "Transmotter Buffer over-run occurs " has occurred.
      symbolic name reference CDD_FSI_RX_E_CRC_ERROR [0..1]: multiplicity set at pre-compile, origin=Texas Instruments, set at pre-compile, destination=DemEventParameter  # Reference to the DemEventParameter which shall be issued when the error "CRC error occurs " has occurred.
      symbolic name reference CDD_FSI_RX_E_TYPE_ERROR [0..1]: multiplicity set at pre-compile, origin=Texas Instruments, set at pre-compile, destination=DemEventParameter  # Reference to the DemEventParameter which shall be issued when the error "frame type error occurs " has occurred.
      symbolic name reference CDD_FSI_RX_E_EOF_ERROR [0..1]: multiplicity set at pre-compile, origin=Texas Instruments, set at pre-compile, destination=DemEventParameter  # Reference to the DemEventParameter which shall be issued when the error "END OF FRAME error occurs " has occurred.
    container CddFsiRxPublishedInformation  # Additional published parameters not covered by "Common" Published Information. Note that these parameters have "PUBLISHED-INFORMATION" configuration class setting, since they are published information.
      integer CddFsiRxMaxNumRxModules: origin=Texas Instruments, set at published-information, default-value=4  # Number of Reception modules in a FSI hw unit.This is a fixed value and can't be changed. This is of type published information and not editable
      integer CddFsiRxMaxHwChannelId: origin=Texas Instruments, set at published-information, default-value=2  # Number of actual HW channels for each Rx module. This is of type published information and not editable
      integer CddFsiRxMinHwChannelId: origin=Texas Instruments, set at published-information, default-value=1  # Number of actual HW channels for each Rx module. This is of type published information and not editable
