<?xml version="1.0" encoding="UTF-8"?>
[!AUTOSPACING!][!//
<AUTOSAR xmlns="http://autosar.org/schema/r4.0" xmlns:xsi="http://www.w3.org/2001/XMLSchema-instance" xsi:schemaLocation="http://autosar.org/schema/r4.0 AUTOSAR_00044.xsd">
  <AR-PACKAGES>
    <AR-PACKAGE UUID="0c030a0d-03cb-4177-8940-c8621e93499d">
      <SHORT-NAME>Cdd_FsiRx_TI_AM263Px</SHORT-NAME>
      <ELEMENTS>
        <BSW-MODULE-DESCRIPTION UUID="d5126efe-ec70-4d8f-b246-630f53ca8fbd">
          <SHORT-NAME>Cdd_FsiRx</SHORT-NAME>
          <CATEGORY>BSW_MODULE</CATEGORY>
          <IMPLEMENTED-ENTRYS>
          [!LOOP "as:modconf('Cdd_FsiRx')[1]/CddFsiRxConfigSet"!][!//
          [!LOOP "CddFsiRxHwUnit/*"!][!//
            [!IF "CddFsiRxHwUnitId = 'CDD_FSI_RX_HWUNIT_0'"!][!//
            <BSW-MODULE-ENTRY-REF-CONDITIONAL>
              <BSW-MODULE-ENTRY-REF DEST="BSW-MODULE-ENTRY">/Cdd_FsiRx_TI_AM263Px/Cdd_FsiRx_ModuleEntry/CddFsiRx_FSIINT1_IrqUnit0</BSW-MODULE-ENTRY-REF>
            </BSW-MODULE-ENTRY-REF-CONDITIONAL>
            [!ENDIF!][!//
            [!IF "CddFsiRxHwUnitId = 'CDD_FSI_RX_HWUNIT_1'"!][!//
            <BSW-MODULE-ENTRY-REF-CONDITIONAL>
              <BSW-MODULE-ENTRY-REF DEST="BSW-MODULE-ENTRY">/Cdd_FsiRx_TI_AM263Px/Cdd_FsiRx_ModuleEntry/CddFsiRx_FSIINT1_IrqUnit1</BSW-MODULE-ENTRY-REF>
            </BSW-MODULE-ENTRY-REF-CONDITIONAL>
            [!ENDIF!][!//
            [!IF "CddFsiRxHwUnitId = 'CDD_FSI_RX_HWUNIT_2'"!][!//
            <BSW-MODULE-ENTRY-REF-CONDITIONAL>
              <BSW-MODULE-ENTRY-REF DEST="BSW-MODULE-ENTRY">/Cdd_FsiRx_TI_AM263Px/Cdd_FsiRx_ModuleEntry/CddFsiRx_FSIINT1_IrqUnit2</BSW-MODULE-ENTRY-REF>
            </BSW-MODULE-ENTRY-REF-CONDITIONAL>
            [!ENDIF!][!//
            [!IF "CddFsiRxHwUnitId = 'CDD_FSI_RX_HWUNIT_3'"!][!//
            <BSW-MODULE-ENTRY-REF-CONDITIONAL>
              <BSW-MODULE-ENTRY-REF DEST="BSW-MODULE-ENTRY">/Cdd_FsiRx_TI_AM263Px/Cdd_FsiRx_ModuleEntry/CddFsiRx_FSIINT1_IrqUnit3</BSW-MODULE-ENTRY-REF>
            </BSW-MODULE-ENTRY-REF-CONDITIONAL>
            [!ENDIF!][!//
            [!IF "CddFsiRxHwUnitId = 'CDD_FSI_RX_HWUNIT_0'"!][!//
            <BSW-MODULE-ENTRY-REF-CONDITIONAL>
              <BSW-MODULE-ENTRY-REF DEST="BSW-MODULE-ENTRY">/Cdd_FsiRx_TI_AM263Px/Cdd_FsiRx_ModuleEntry/CddFsiRx_FSIINT2_IrqUnit0</BSW-MODULE-ENTRY-REF>
            </BSW-MODULE-ENTRY-REF-CONDITIONAL>
            [!ENDIF!][!//
            [!IF "CddFsiRxHwUnitId = 'CDD_FSI_RX_HWUNIT_1'"!][!//
            <BSW-MODULE-ENTRY-REF-CONDITIONAL>
              <BSW-MODULE-ENTRY-REF DEST="BSW-MODULE-ENTRY">/Cdd_FsiRx_TI_AM263Px/Cdd_FsiRx_ModuleEntry/CddFsiRx_FSIINT2_IrqUnit1</BSW-MODULE-ENTRY-REF>
            </BSW-MODULE-ENTRY-REF-CONDITIONAL>
            [!ENDIF!][!//
            [!IF "CddFsiRxHwUnitId = 'CDD_FSI_RX_HWUNIT_2'"!][!//
            <BSW-MODULE-ENTRY-REF-CONDITIONAL>
              <BSW-MODULE-ENTRY-REF DEST="BSW-MODULE-ENTRY">/Cdd_FsiRx_TI_AM263Px/Cdd_FsiRx_ModuleEntry/CddFsiRx_FSIINT2_IrqUnit2</BSW-MODULE-ENTRY-REF>
            </BSW-MODULE-ENTRY-REF-CONDITIONAL>
            [!ENDIF!][!//
            [!IF "CddFsiRxHwUnitId = 'CDD_FSI_RX_HWUNIT_3'"!][!//
            <BSW-MODULE-ENTRY-REF-CONDITIONAL>
              <BSW-MODULE-ENTRY-REF DEST="BSW-MODULE-ENTRY">/Cdd_FsiRx_TI_AM263Px/Cdd_FsiRx_ModuleEntry/CddFsiRx_FSIINT2_IrqUnit3</BSW-MODULE-ENTRY-REF>
            </BSW-MODULE-ENTRY-REF-CONDITIONAL>
            [!ENDIF!][!//
            [!ENDLOOP!][!//
            [!ENDLOOP!][!//
            <BSW-MODULE-ENTRY-REF-CONDITIONAL>
              <BSW-MODULE-ENTRY-REF DEST="BSW-MODULE-ENTRY">/Cdd_FsiRx_TI_AM263Px/Cdd_FsiRx_ModuleEntry/CddFsiRx_GetStatus</BSW-MODULE-ENTRY-REF>
            </BSW-MODULE-ENTRY-REF-CONDITIONAL>
            [!IF "as:modconf('Cdd_FsiRx')[1]/CddFsiRxGeneral/CddFsiRxDeInitApi = 'true'"!][!//
            <BSW-MODULE-ENTRY-REF-CONDITIONAL>
              <BSW-MODULE-ENTRY-REF DEST="BSW-MODULE-ENTRY">/Cdd_FsiRx_TI_AM263Px/Cdd_FsiRx_ModuleEntry/Cdd_FsiRx_DeInit</BSW-MODULE-ENTRY-REF>
            </BSW-MODULE-ENTRY-REF-CONDITIONAL>
            [!ENDIF!][!//
            [!IF "as:modconf('Cdd_FsiRx')[1]/CddFsiRxGeneral/CddFsiRxGetVersionInfoApi = 'true'"!][!//
            <BSW-MODULE-ENTRY-REF-CONDITIONAL>
              <BSW-MODULE-ENTRY-REF DEST="BSW-MODULE-ENTRY">/Cdd_FsiRx_TI_AM263Px/Cdd_FsiRx_ModuleEntry/Cdd_FsiRx_GetVersionInfo</BSW-MODULE-ENTRY-REF>
            </BSW-MODULE-ENTRY-REF-CONDITIONAL>
            [!ENDIF!][!//
            <BSW-MODULE-ENTRY-REF-CONDITIONAL>
              <BSW-MODULE-ENTRY-REF DEST="BSW-MODULE-ENTRY">/Cdd_FsiRx_TI_AM263Px/Cdd_FsiRx_ModuleEntry/Cdd_FsiRx_Init</BSW-MODULE-ENTRY-REF>
            </BSW-MODULE-ENTRY-REF-CONDITIONAL>
            [!IF "as:modconf('Cdd_FsiRx')[1]/CddFsiRxGeneral/CddFsiRxMainApi = 'true'"!][!//
            <BSW-MODULE-ENTRY-REF-CONDITIONAL>
              <BSW-MODULE-ENTRY-REF DEST="BSW-MODULE-ENTRY">/Cdd_FsiRx_TI_AM263Px/Cdd_FsiRx_ModuleEntry/Cdd_FsiRx_MainFunction</BSW-MODULE-ENTRY-REF>
            </BSW-MODULE-ENTRY-REF-CONDITIONAL>
            [!ENDIF!][!//
            [!IF "as:modconf('Cdd_FsiRx')[1]/CddFsiRxGeneral/CddFsiRxResetDriver = 'true'"!][!//
            <BSW-MODULE-ENTRY-REF-CONDITIONAL>
              <BSW-MODULE-ENTRY-REF DEST="BSW-MODULE-ENTRY">/Cdd_FsiRx_TI_AM263Px/Cdd_FsiRx_ModuleEntry/Cdd_FsiRx_Reset</BSW-MODULE-ENTRY-REF>
            </BSW-MODULE-ENTRY-REF-CONDITIONAL>
            [!ENDIF!][!//
          [!IF "as:modconf('Cdd_FsiRx')[1]/CddFsiRxGeneral/CddFsiRxEnableRegisterReadbackApi   = 'true'"!][!//
            <BSW-MODULE-ENTRY-REF-CONDITIONAL>
              <BSW-MODULE-ENTRY-REF DEST="BSW-MODULE-ENTRY">/Cdd_FsiRx_TI_AM263Px/Cdd_FsiRx_ModuleEntry/Cdd_FsiRx_RegisterReadback</BSW-MODULE-ENTRY-REF>
            </BSW-MODULE-ENTRY-REF-CONDITIONAL>
          [!ENDIF!][!//
            <BSW-MODULE-ENTRY-REF-CONDITIONAL>
              <BSW-MODULE-ENTRY-REF DEST="BSW-MODULE-ENTRY">/Cdd_FsiRx_TI_AM263Px/Cdd_FsiRx_ModuleEntry/Cdd_FsiRx_setUpBuffer</BSW-MODULE-ENTRY-REF>
            </BSW-MODULE-ENTRY-REF-CONDITIONAL>
          </IMPLEMENTED-ENTRYS>
          <MODULE-ID>255</MODULE-ID>
          <BSW-MODULE-DEPENDENCYS>
            <BSW-MODULE-DEPENDENCY UUID="f62dc947-db87-40eb-84fa-31ef1d4de3aa">
              <SHORT-NAME>Dem</SHORT-NAME>
              <TARGET-MODULE-ID>54</TARGET-MODULE-ID>
              <TARGET-MODULE-REFS>
                <BSW-MODULE-DESCRIPTION-REF-CONDITIONAL>
                  <BSW-MODULE-DESCRIPTION-REF DEST="BSW-MODULE-DESCRIPTION">/AUTOSAR_Dem/Dem</BSW-MODULE-DESCRIPTION-REF>
                </BSW-MODULE-DESCRIPTION-REF-CONDITIONAL>
              </TARGET-MODULE-REFS>
            </BSW-MODULE-DEPENDENCY>
            <BSW-MODULE-DEPENDENCY UUID="6f7893ce-3405-44c6-a6ea-17d88c7daac7">
              <SHORT-NAME>Det</SHORT-NAME>
              <TARGET-MODULE-ID>15</TARGET-MODULE-ID>
              <TARGET-MODULE-REFS>
                <BSW-MODULE-DESCRIPTION-REF-CONDITIONAL>
                  <BSW-MODULE-DESCRIPTION-REF DEST="BSW-MODULE-DESCRIPTION">/AUTOSAR_Det/Det</BSW-MODULE-DESCRIPTION-REF>
                </BSW-MODULE-DESCRIPTION-REF-CONDITIONAL>
              </TARGET-MODULE-REFS>
            </BSW-MODULE-DEPENDENCY>
            [!IF "as:modconf('Cdd_FsiRx')[1]/CddFsiRxGeneral/CddFsiRxDMAEnable = 'true'"!][!//
            <BSW-MODULE-DEPENDENCY UUID="1a01006d-c17e-4e8b-b96d-764786597b69">
              <SHORT-NAME>Cdd_Dma</SHORT-NAME>
              <TARGET-MODULE-ID>255</TARGET-MODULE-ID>
              <TARGET-MODULE-REFS>
              <BSW-MODULE-DESCRIPTION-REF-CONDITIONAL>
                <BSW-MODULE-DESCRIPTION-REF DEST="BSW-MODULE-DESCRIPTION">/Cdd_Dma_TI_AM263Px/Cdd_Dma_ModuleEntry</BSW-MODULE-DESCRIPTION-REF>
              </BSW-MODULE-DESCRIPTION-REF-CONDITIONAL>
              </TARGET-MODULE-REFS>
            </BSW-MODULE-DEPENDENCY>
            [!ENDIF!][!//
          </BSW-MODULE-DEPENDENCYS>
          <INTERNAL-BEHAVIORS>
            <BSW-INTERNAL-BEHAVIOR UUID="d9bf8191-d0a5-468a-9206-a130c8a9bf1a">
              <SHORT-NAME>Cdd_Fsi_Rx_Behavior</SHORT-NAME>
              <EXCLUSIVE-AREAS>
                <EXCLUSIVE-AREA UUID="48487462-2e8f-463b-84fe-b5034b11487e">
                  <SHORT-NAME>FSI_RX_EXCLUSIVE_AREA_0</SHORT-NAME>
                </EXCLUSIVE-AREA>
              </EXCLUSIVE-AREAS>
              <ENTITYS>
              [!LOOP "as:modconf('Cdd_FsiRx')[1]/CddFsiRxConfigSet"!][!//
              [!LOOP "CddFsiRxHwUnit/*"!][!//
              [!IF "CddFsiRxHwUnitId = 'CDD_FSI_RX_HWUNIT_0'"!][!//
                <BSW-INTERRUPT-ENTITY UUID="90879277-4599-4383-bec8-d350cb997ade">
                  <SHORT-NAME>CddFsiRx_FSIINT1_IrqUnit0</SHORT-NAME>
                  <MINIMUM-START-INTERVAL>0.0</MINIMUM-START-INTERVAL>
                  <REENTRANCY-LEVEL>NON-REENTRANT</REENTRANCY-LEVEL>
                  <CALL-POINTS>
                    [!IF "as:modconf('Cdd_FsiRx')[1]/CddFsiRxGeneral/CddFsiRxDMAEnable = 'true'"!][!//
                    <BSW-DIRECT-CALL-POINT>
                      <SHORT-NAME>Cdd_Dma_ChainChannel</SHORT-NAME>
                    </BSW-DIRECT-CALL-POINT>
                    <BSW-DIRECT-CALL-POINT>
                      <SHORT-NAME>Cdd_Dma_EnableTransferRegion</SHORT-NAME>
                    </BSW-DIRECT-CALL-POINT>
                    <BSW-DIRECT-CALL-POINT>
                      <SHORT-NAME>Cdd_Dma_GetInitStatus</SHORT-NAME>
                    </BSW-DIRECT-CALL-POINT>
                    <BSW-DIRECT-CALL-POINT>
                      <SHORT-NAME>Cdd_Dma_ParamSet</SHORT-NAME>
                    </BSW-DIRECT-CALL-POINT>
                    [!ENDIF!][!//
                    <BSW-DIRECT-CALL-POINT>
                      <SHORT-NAME>Dem</SHORT-NAME>
                      <CALLED-ENTRY-REF DEST="BSW-MODULE-ENTRY">/AUTOSAR_Dem/BSWModuleEntry/Dem_SetEventStatus</CALLED-ENTRY-REF>
                    </BSW-DIRECT-CALL-POINT>
                    <BSW-DIRECT-CALL-POINT>
                      <SHORT-NAME>Det_ReportRuntimeError</SHORT-NAME>
                      <CALLED-ENTRY-REF DEST="BSW-MODULE-ENTRY">/AUTOSAR_Det/BSWModuleEntry/Det_ReportRuntimeError</CALLED-ENTRY-REF>
                    </BSW-DIRECT-CALL-POINT>
                    [!IF "as:modconf('Cdd_FsiRx')[1]/CddFsiRxGeneral/CddFsiRxDevErrorDetectApi = 'true'"!][!//
                    <BSW-DIRECT-CALL-POINT>
                      <SHORT-NAME>Det_ReportError</SHORT-NAME>
                      <CALLED-ENTRY-REF DEST="BSW-MODULE-ENTRY">/AUTOSAR_Det/BSWModuleEntry/Det_ReportError</CALLED-ENTRY-REF>
                    </BSW-DIRECT-CALL-POINT>
                    [!ENDIF!][!//
                  </CALL-POINTS>
                  <IMPLEMENTED-ENTRY-REF DEST="BSW-MODULE-ENTRY">/Cdd_FsiRx_TI_AM263Px/Cdd_FsiRx_ModuleEntry/CddFsiRx_FSIINT1_IrqUnit0</IMPLEMENTED-ENTRY-REF>
                  [!IF "as:modconf('Cdd_FsiRx')[1]/CddFsiRxGeneral/CddFsiRxTypeofInterruptFunction = 'CDD_FSI_RX_ISR_CAT2'"!][!//
                  <INTERRUPT-CATEGORY>CAT-2</INTERRUPT-CATEGORY>
                  [!ELSE!]
                  <INTERRUPT-CATEGORY>CAT-1</INTERRUPT-CATEGORY>
                  [!ENDIF!][!//
                  <INTERRUPT-SOURCE>Hardware</INTERRUPT-SOURCE>
                </BSW-INTERRUPT-ENTITY>
                [!ENDIF!][!//
                [!IF "CddFsiRxHwUnitId = 'CDD_FSI_RX_HWUNIT_1'"!][!//
                <BSW-INTERRUPT-ENTITY UUID="43585e3c-0d7f-4f61-a05a-50d16e4a1c41">
                  <SHORT-NAME>CddFsiRx_FSIINT1_IrqUnit1</SHORT-NAME>
                  <MINIMUM-START-INTERVAL>0.0</MINIMUM-START-INTERVAL>
                  <REENTRANCY-LEVEL>NON-REENTRANT</REENTRANCY-LEVEL>
                  <CALL-POINTS>
                    [!IF "as:modconf('Cdd_FsiRx')[1]/CddFsiRxGeneral/CddFsiRxDMAEnable = 'true'"!][!//
                    <BSW-DIRECT-CALL-POINT>
                      <SHORT-NAME>Cdd_Dma_ChainChannel</SHORT-NAME>
                    </BSW-DIRECT-CALL-POINT>
                    <BSW-DIRECT-CALL-POINT>
                      <SHORT-NAME>Cdd_Dma_EnableTransferRegion</SHORT-NAME>
                    </BSW-DIRECT-CALL-POINT>
                    <BSW-DIRECT-CALL-POINT>
                      <SHORT-NAME>Cdd_Dma_GetInitStatus</SHORT-NAME>
                    </BSW-DIRECT-CALL-POINT>
                    <BSW-DIRECT-CALL-POINT>
                      <SHORT-NAME>Cdd_Dma_ParamSet</SHORT-NAME>
                    </BSW-DIRECT-CALL-POINT>
                    [!ENDIF!][!//
                    <BSW-DIRECT-CALL-POINT>
                      <SHORT-NAME>Dem</SHORT-NAME>
                      <CALLED-ENTRY-REF DEST="BSW-MODULE-ENTRY">/AUTOSAR_Dem/BSWModuleEntry/Dem_SetEventStatus</CALLED-ENTRY-REF>
                    </BSW-DIRECT-CALL-POINT>
                    <BSW-DIRECT-CALL-POINT>
                      <SHORT-NAME>Det_ReportRuntimeError</SHORT-NAME>
                      <CALLED-ENTRY-REF DEST="BSW-MODULE-ENTRY">/AUTOSAR_Det/BSWModuleEntry/Det_ReportRuntimeError</CALLED-ENTRY-REF>
                    </BSW-DIRECT-CALL-POINT>
                    [!IF "as:modconf('Cdd_FsiRx')[1]/CddFsiRxGeneral/CddFsiRxDevErrorDetectApi = 'true'"!][!//
                    <BSW-DIRECT-CALL-POINT>
                      <SHORT-NAME>Det_ReportError</SHORT-NAME>
                      <CALLED-ENTRY-REF DEST="BSW-MODULE-ENTRY">/AUTOSAR_Det/BSWModuleEntry/Det_ReportError</CALLED-ENTRY-REF>
                    </BSW-DIRECT-CALL-POINT>
                    [!ENDIF!][!//
                  </CALL-POINTS>
                  <IMPLEMENTED-ENTRY-REF DEST="BSW-MODULE-ENTRY">/Cdd_FsiRx_TI_AM263Px/Cdd_FsiRx_ModuleEntry/CddFsiRx_FSIINT1_IrqUnit1</IMPLEMENTED-ENTRY-REF>
                  [!IF "as:modconf('Cdd_FsiRx')[1]/CddFsiRxGeneral/CddFsiRxTypeofInterruptFunction = 'CDD_FSI_RX_ISR_CAT2'"!][!//
                  <INTERRUPT-CATEGORY>CAT-2</INTERRUPT-CATEGORY>
                  [!ELSE!]
                  <INTERRUPT-CATEGORY>CAT-1</INTERRUPT-CATEGORY>
                  [!ENDIF!][!//
                  <INTERRUPT-SOURCE>Hardware</INTERRUPT-SOURCE>
                </BSW-INTERRUPT-ENTITY>
                [!ENDIF!][!//
                [!IF "CddFsiRxHwUnitId = 'CDD_FSI_RX_HWUNIT_2'"!][!//
                <BSW-INTERRUPT-ENTITY UUID="1083a64c-3f09-4c6f-a828-f93baac1ef60">
                  <SHORT-NAME>CddFsiRx_FSIINT1_IrqUnit2</SHORT-NAME>
                  <MINIMUM-START-INTERVAL>0.0</MINIMUM-START-INTERVAL>
                  <REENTRANCY-LEVEL>NON-REENTRANT</REENTRANCY-LEVEL>
                  <CALL-POINTS>
                    [!IF "as:modconf('Cdd_FsiRx')[1]/CddFsiRxGeneral/CddFsiRxDMAEnable = 'true'"!][!//
                    <BSW-DIRECT-CALL-POINT>
                      <SHORT-NAME>Cdd_Dma_ChainChannel</SHORT-NAME>
                    </BSW-DIRECT-CALL-POINT>
                    <BSW-DIRECT-CALL-POINT>
                      <SHORT-NAME>Cdd_Dma_EnableTransferRegion</SHORT-NAME>
                    </BSW-DIRECT-CALL-POINT>
                    <BSW-DIRECT-CALL-POINT>
                      <SHORT-NAME>Cdd_Dma_GetInitStatus</SHORT-NAME>
                    </BSW-DIRECT-CALL-POINT>
                    <BSW-DIRECT-CALL-POINT>
                      <SHORT-NAME>Cdd_Dma_ParamSet</SHORT-NAME>
                    </BSW-DIRECT-CALL-POINT>
                    [!ENDIF!][!//
                    <BSW-DIRECT-CALL-POINT>
                      <SHORT-NAME>Dem</SHORT-NAME>
                      <CALLED-ENTRY-REF DEST="BSW-MODULE-ENTRY">/AUTOSAR_Dem/BSWModuleEntry/Dem_SetEventStatus</CALLED-ENTRY-REF>
                    </BSW-DIRECT-CALL-POINT>
                    <BSW-DIRECT-CALL-POINT>
                      <SHORT-NAME>Det_ReportRuntimeError</SHORT-NAME>
                      <CALLED-ENTRY-REF DEST="BSW-MODULE-ENTRY">/AUTOSAR_Det/BSWModuleEntry/Det_ReportRuntimeError</CALLED-ENTRY-REF>
                    </BSW-DIRECT-CALL-POINT>
                    [!IF "as:modconf('Cdd_FsiRx')[1]/CddFsiRxGeneral/CddFsiRxDevErrorDetectApi = 'true'"!][!//
                    <BSW-DIRECT-CALL-POINT>
                      <SHORT-NAME>Det_ReportError</SHORT-NAME>
                      <CALLED-ENTRY-REF DEST="BSW-MODULE-ENTRY">/AUTOSAR_Det/BSWModuleEntry/Det_ReportError</CALLED-ENTRY-REF>
                    </BSW-DIRECT-CALL-POINT>
                    [!ENDIF!][!//
                  </CALL-POINTS>
                  <IMPLEMENTED-ENTRY-REF DEST="BSW-MODULE-ENTRY">/Cdd_FsiRx_TI_AM263Px/Cdd_FsiRx_ModuleEntry/CddFsiRx_FSIINT1_IrqUnit2</IMPLEMENTED-ENTRY-REF>
                  [!IF "as:modconf('Cdd_FsiRx')[1]/CddFsiRxGeneral/CddFsiRxTypeofInterruptFunction = 'CDD_FSI_RX_ISR_CAT2'"!][!//
                  <INTERRUPT-CATEGORY>CAT-2</INTERRUPT-CATEGORY>
                  [!ELSE!]
                  <INTERRUPT-CATEGORY>CAT-1</INTERRUPT-CATEGORY>
                  [!ENDIF!][!//
                  <INTERRUPT-SOURCE>Hardware</INTERRUPT-SOURCE>
                </BSW-INTERRUPT-ENTITY>
                [!ENDIF!][!//
                [!IF "CddFsiRxHwUnitId = 'CDD_FSI_RX_HWUNIT_3'"!][!//
                <BSW-INTERRUPT-ENTITY UUID="de4656a4-d7ce-4443-ace8-b43c956825d5">
                  <SHORT-NAME>CddFsiRx_FSIINT1_IrqUnit3</SHORT-NAME>
                  <MINIMUM-START-INTERVAL>0.0</MINIMUM-START-INTERVAL>
                  <REENTRANCY-LEVEL>NON-REENTRANT</REENTRANCY-LEVEL>
                  <CALL-POINTS>
                    [!IF "as:modconf('Cdd_FsiRx')[1]/CddFsiRxGeneral/CddFsiRxDMAEnable = 'true'"!][!//
                    <BSW-DIRECT-CALL-POINT>
                      <SHORT-NAME>Cdd_Dma_ChainChannel</SHORT-NAME>
                    </BSW-DIRECT-CALL-POINT>
                    <BSW-DIRECT-CALL-POINT>
                      <SHORT-NAME>Cdd_Dma_EnableTransferRegion</SHORT-NAME>
                    </BSW-DIRECT-CALL-POINT>
                    <BSW-DIRECT-CALL-POINT>
                      <SHORT-NAME>Cdd_Dma_GetInitStatus</SHORT-NAME>
                    </BSW-DIRECT-CALL-POINT>
                    <BSW-DIRECT-CALL-POINT>
                      <SHORT-NAME>Cdd_Dma_ParamSet</SHORT-NAME>
                    </BSW-DIRECT-CALL-POINT>
                    [!ENDIF!][!//
                    <BSW-DIRECT-CALL-POINT>
                      <SHORT-NAME>Dem</SHORT-NAME>
                      <CALLED-ENTRY-REF DEST="BSW-MODULE-ENTRY">/AUTOSAR_Dem/BSWModuleEntry/Dem_SetEventStatus</CALLED-ENTRY-REF>
                    </BSW-DIRECT-CALL-POINT>
                    <BSW-DIRECT-CALL-POINT>
                      <SHORT-NAME>Det_ReportRuntimeError</SHORT-NAME>
                      <CALLED-ENTRY-REF DEST="BSW-MODULE-ENTRY">/AUTOSAR_Det/BSWModuleEntry/Det_ReportRuntimeError</CALLED-ENTRY-REF>
                    </BSW-DIRECT-CALL-POINT>
                    [!IF "as:modconf('Cdd_FsiRx')[1]/CddFsiRxGeneral/CddFsiRxDevErrorDetectApi = 'true'"!][!//
                    <BSW-DIRECT-CALL-POINT>
                      <SHORT-NAME>Det_ReportError</SHORT-NAME>
                      <CALLED-ENTRY-REF DEST="BSW-MODULE-ENTRY">/AUTOSAR_Det/BSWModuleEntry/Det_ReportError</CALLED-ENTRY-REF>
                    </BSW-DIRECT-CALL-POINT>
                    [!ENDIF!][!//
                  </CALL-POINTS>
                  <IMPLEMENTED-ENTRY-REF DEST="BSW-MODULE-ENTRY">/Cdd_FsiRx_TI_AM263Px/Cdd_FsiRx_ModuleEntry/CddFsiRx_FSIINT1_IrqUnit3</IMPLEMENTED-ENTRY-REF>
                  [!IF "as:modconf('Cdd_FsiRx')[1]/CddFsiRxGeneral/CddFsiRxTypeofInterruptFunction = 'CDD_FSI_RX_ISR_CAT2'"!][!//
                  <INTERRUPT-CATEGORY>CAT-2</INTERRUPT-CATEGORY>
                  [!ELSE!]
                  <INTERRUPT-CATEGORY>CAT-1</INTERRUPT-CATEGORY>
                  [!ENDIF!][!//
                  <INTERRUPT-SOURCE>Hardware</INTERRUPT-SOURCE>
                </BSW-INTERRUPT-ENTITY>
                [!ENDIF!][!//
                [!IF "CddFsiRxHwUnitId = 'CDD_FSI_RX_HWUNIT_0'"!][!//
                <BSW-INTERRUPT-ENTITY UUID="91855f97-f551-4e01-a127-72df3a63e136">
                  <SHORT-NAME>CddFsiRx_FSIINT2_IrqUnit0</SHORT-NAME>
                  <MINIMUM-START-INTERVAL>0.0</MINIMUM-START-INTERVAL>
                  <REENTRANCY-LEVEL>NON-REENTRANT</REENTRANCY-LEVEL>
                  <CALL-POINTS>
                    [!IF "as:modconf('Cdd_FsiRx')[1]/CddFsiRxGeneral/CddFsiRxDMAEnable = 'true'"!][!//
                    <BSW-DIRECT-CALL-POINT>
                      <SHORT-NAME>Cdd_Dma_ChainChannel</SHORT-NAME>
                    </BSW-DIRECT-CALL-POINT>
                    <BSW-DIRECT-CALL-POINT>
                      <SHORT-NAME>Cdd_Dma_EnableTransferRegion</SHORT-NAME>
                    </BSW-DIRECT-CALL-POINT>
                    <BSW-DIRECT-CALL-POINT>
                      <SHORT-NAME>Cdd_Dma_GetInitStatus</SHORT-NAME>
                    </BSW-DIRECT-CALL-POINT>
                    <BSW-DIRECT-CALL-POINT>
                      <SHORT-NAME>Cdd_Dma_ParamSet</SHORT-NAME>
                    </BSW-DIRECT-CALL-POINT>
                    [!ENDIF!][!//
                    <BSW-DIRECT-CALL-POINT>
                      <SHORT-NAME>Dem</SHORT-NAME>
                      <CALLED-ENTRY-REF DEST="BSW-MODULE-ENTRY">/AUTOSAR_Dem/BSWModuleEntry/Dem_SetEventStatus</CALLED-ENTRY-REF>
                    </BSW-DIRECT-CALL-POINT>
                    <BSW-DIRECT-CALL-POINT>
                      <SHORT-NAME>Det_ReportRuntimeError</SHORT-NAME>
                      <CALLED-ENTRY-REF DEST="BSW-MODULE-ENTRY">/AUTOSAR_Det/BSWModuleEntry/Det_ReportRuntimeError</CALLED-ENTRY-REF>
                    </BSW-DIRECT-CALL-POINT>
                    [!IF "as:modconf('Cdd_FsiRx')[1]/CddFsiRxGeneral/CddFsiRxDevErrorDetectApi = 'true'"!][!//
                    <BSW-DIRECT-CALL-POINT>
                      <SHORT-NAME>Det_ReportError</SHORT-NAME>
                      <CALLED-ENTRY-REF DEST="BSW-MODULE-ENTRY">/AUTOSAR_Det/BSWModuleEntry/Det_ReportError</CALLED-ENTRY-REF>
                    </BSW-DIRECT-CALL-POINT>
                    [!ENDIF!][!//
                  </CALL-POINTS>
                  <IMPLEMENTED-ENTRY-REF DEST="BSW-MODULE-ENTRY">/Cdd_FsiRx_TI_AM263Px/Cdd_FsiRx_ModuleEntry/CddFsiRx_FSIINT2_IrqUnit0</IMPLEMENTED-ENTRY-REF>
                  [!IF "as:modconf('Cdd_FsiRx')[1]/CddFsiRxGeneral/CddFsiRxTypeofInterruptFunction = 'CDD_FSI_RX_ISR_CAT2'"!][!//
                  <INTERRUPT-CATEGORY>CAT-2</INTERRUPT-CATEGORY>
                  [!ELSE!]
                  <INTERRUPT-CATEGORY>CAT-1</INTERRUPT-CATEGORY>
                  [!ENDIF!][!//
                  <INTERRUPT-SOURCE>Hardware</INTERRUPT-SOURCE>
                </BSW-INTERRUPT-ENTITY>
                [!ENDIF!][!//
                [!IF "CddFsiRxHwUnitId = 'CDD_FSI_RX_HWUNIT_1'"!][!//
                <BSW-INTERRUPT-ENTITY UUID="634c5c7d-7198-4bd4-8ccc-1792718d169e">
                  <SHORT-NAME>CddFsiRx_FSIINT2_IrqUnit1</SHORT-NAME>
                  <MINIMUM-START-INTERVAL>0.0</MINIMUM-START-INTERVAL>
                  <REENTRANCY-LEVEL>NON-REENTRANT</REENTRANCY-LEVEL>
                  <CALL-POINTS>
                    [!IF "as:modconf('Cdd_FsiRx')[1]/CddFsiRxGeneral/CddFsiRxDMAEnable = 'true'"!][!//
                    <BSW-DIRECT-CALL-POINT>
                      <SHORT-NAME>Cdd_Dma_ChainChannel</SHORT-NAME>
                    </BSW-DIRECT-CALL-POINT>
                    <BSW-DIRECT-CALL-POINT>
                      <SHORT-NAME>Cdd_Dma_EnableTransferRegion</SHORT-NAME>
                    </BSW-DIRECT-CALL-POINT>
                    <BSW-DIRECT-CALL-POINT>
                      <SHORT-NAME>Cdd_Dma_GetInitStatus</SHORT-NAME>
                    </BSW-DIRECT-CALL-POINT>
                    <BSW-DIRECT-CALL-POINT>
                      <SHORT-NAME>Cdd_Dma_ParamSet</SHORT-NAME>
                    </BSW-DIRECT-CALL-POINT>
                    [!ENDIF!][!//
                    <BSW-DIRECT-CALL-POINT>
                      <SHORT-NAME>Dem</SHORT-NAME>
                      <CALLED-ENTRY-REF DEST="BSW-MODULE-ENTRY">/AUTOSAR_Dem/BSWModuleEntry/Dem_SetEventStatus</CALLED-ENTRY-REF>
                    </BSW-DIRECT-CALL-POINT>
                    <BSW-DIRECT-CALL-POINT>
                      <SHORT-NAME>Det_ReportRuntimeError</SHORT-NAME>
                      <CALLED-ENTRY-REF DEST="BSW-MODULE-ENTRY">/AUTOSAR_Det/BSWModuleEntry/Det_ReportRuntimeError</CALLED-ENTRY-REF>
                    </BSW-DIRECT-CALL-POINT>
                    [!IF "as:modconf('Cdd_FsiRx')[1]/CddFsiRxGeneral/CddFsiRxDevErrorDetectApi = 'true'"!][!//
                    <BSW-DIRECT-CALL-POINT>
                      <SHORT-NAME>Det_ReportError</SHORT-NAME>
                      <CALLED-ENTRY-REF DEST="BSW-MODULE-ENTRY">/AUTOSAR_Det/BSWModuleEntry/Det_ReportError</CALLED-ENTRY-REF>
                    </BSW-DIRECT-CALL-POINT>
                    [!ENDIF!][!//
                  </CALL-POINTS>
                  <IMPLEMENTED-ENTRY-REF DEST="BSW-MODULE-ENTRY">/Cdd_FsiRx_TI_AM263Px/Cdd_FsiRx_ModuleEntry/CddFsiRx_FSIINT2_IrqUnit1</IMPLEMENTED-ENTRY-REF>
                  [!IF "as:modconf('Cdd_FsiRx')[1]/CddFsiRxGeneral/CddFsiRxTypeofInterruptFunction = 'CDD_FSI_RX_ISR_CAT2'"!][!//
                  <INTERRUPT-CATEGORY>CAT-2</INTERRUPT-CATEGORY>
                  [!ELSE!]
                  <INTERRUPT-CATEGORY>CAT-1</INTERRUPT-CATEGORY>
                  [!ENDIF!][!//
                  <INTERRUPT-SOURCE>Hardware</INTERRUPT-SOURCE>
                </BSW-INTERRUPT-ENTITY>
                [!ENDIF!][!//
                [!IF "CddFsiRxHwUnitId = 'CDD_FSI_RX_HWUNIT_2'"!][!//
                <BSW-INTERRUPT-ENTITY UUID="4fe35979-a68e-4e08-a3f9-f687d9a66edd">
                  <SHORT-NAME>CddFsiRx_FSIINT2_IrqUnit2</SHORT-NAME>
                  <MINIMUM-START-INTERVAL>0.0</MINIMUM-START-INTERVAL>
                  <REENTRANCY-LEVEL>NON-REENTRANT</REENTRANCY-LEVEL>
                  <CALL-POINTS>
                    [!IF "as:modconf('Cdd_FsiRx')[1]/CddFsiRxGeneral/CddFsiRxDMAEnable = 'true'"!][!//
                    <BSW-DIRECT-CALL-POINT>
                      <SHORT-NAME>Cdd_Dma_ChainChannel</SHORT-NAME>
                    </BSW-DIRECT-CALL-POINT>
                    <BSW-DIRECT-CALL-POINT>
                      <SHORT-NAME>Cdd_Dma_EnableTransferRegion</SHORT-NAME>
                    </BSW-DIRECT-CALL-POINT>
                    <BSW-DIRECT-CALL-POINT>
                      <SHORT-NAME>Cdd_Dma_GetInitStatus</SHORT-NAME>
                    </BSW-DIRECT-CALL-POINT>
                    <BSW-DIRECT-CALL-POINT>
                      <SHORT-NAME>Cdd_Dma_ParamSet</SHORT-NAME>
                    </BSW-DIRECT-CALL-POINT>
                    [!ENDIF!][!//
                    <BSW-DIRECT-CALL-POINT>
                      <SHORT-NAME>Dem</SHORT-NAME>
                      <CALLED-ENTRY-REF DEST="BSW-MODULE-ENTRY">/AUTOSAR_Dem/BSWModuleEntry/Dem_SetEventStatus</CALLED-ENTRY-REF>
                    </BSW-DIRECT-CALL-POINT>
                    <BSW-DIRECT-CALL-POINT>
                      <SHORT-NAME>Det_ReportRuntimeError</SHORT-NAME>
                      <CALLED-ENTRY-REF DEST="BSW-MODULE-ENTRY">/AUTOSAR_Det/BSWModuleEntry/Det_ReportRuntimeError</CALLED-ENTRY-REF>
                    </BSW-DIRECT-CALL-POINT>
                    [!IF "as:modconf('Cdd_FsiRx')[1]/CddFsiRxGeneral/CddFsiRxDevErrorDetectApi = 'true'"!][!//
                    <BSW-DIRECT-CALL-POINT>
                      <SHORT-NAME>Det_ReportError</SHORT-NAME>
                      <CALLED-ENTRY-REF DEST="BSW-MODULE-ENTRY">/AUTOSAR_Det/BSWModuleEntry/Det_ReportError</CALLED-ENTRY-REF>
                    </BSW-DIRECT-CALL-POINT>
                    [!ENDIF!][!//
                  </CALL-POINTS>
                  <IMPLEMENTED-ENTRY-REF DEST="BSW-MODULE-ENTRY">/Cdd_FsiRx_TI_AM263Px/Cdd_FsiRx_ModuleEntry/CddFsiRx_FSIINT2_IrqUnit2</IMPLEMENTED-ENTRY-REF>
                  [!IF "as:modconf('Cdd_FsiRx')[1]/CddFsiRxGeneral/CddFsiRxTypeofInterruptFunction = 'CDD_FSI_RX_ISR_CAT2'"!][!//
                  <INTERRUPT-CATEGORY>CAT-2</INTERRUPT-CATEGORY>
                  [!ELSE!]
                  <INTERRUPT-CATEGORY>CAT-1</INTERRUPT-CATEGORY>
                  [!ENDIF!][!//
                  <INTERRUPT-SOURCE>Hardware</INTERRUPT-SOURCE>
                </BSW-INTERRUPT-ENTITY>
                [!ENDIF!][!//
                [!IF "CddFsiRxHwUnitId = 'CDD_FSI_RX_HWUNIT_3'"!][!//
                <BSW-INTERRUPT-ENTITY UUID="da59c74a-a28e-47f7-b835-ed054a8b888f">
                  <SHORT-NAME>CddFsiRx_FSIINT2_IrqUnit3</SHORT-NAME>
                  <MINIMUM-START-INTERVAL>0.0</MINIMUM-START-INTERVAL>
                  <REENTRANCY-LEVEL>NON-REENTRANT</REENTRANCY-LEVEL>
                  <CALL-POINTS>
                    [!IF "as:modconf('Cdd_FsiRx')[1]/CddFsiRxGeneral/CddFsiRxDMAEnable = 'true'"!][!//
                    <BSW-DIRECT-CALL-POINT>
                      <SHORT-NAME>Cdd_Dma_ChainChannel</SHORT-NAME>
                    </BSW-DIRECT-CALL-POINT>
                    <BSW-DIRECT-CALL-POINT>
                      <SHORT-NAME>Cdd_Dma_EnableTransferRegion</SHORT-NAME>
                    </BSW-DIRECT-CALL-POINT>
                    <BSW-DIRECT-CALL-POINT>
                      <SHORT-NAME>Cdd_Dma_GetInitStatus</SHORT-NAME>
                    </BSW-DIRECT-CALL-POINT>
                    <BSW-DIRECT-CALL-POINT>
                      <SHORT-NAME>Cdd_Dma_ParamSet</SHORT-NAME>
                    </BSW-DIRECT-CALL-POINT>
                    [!ENDIF!][!//
                    <BSW-DIRECT-CALL-POINT>
                      <SHORT-NAME>Dem</SHORT-NAME>
                      <CALLED-ENTRY-REF DEST="BSW-MODULE-ENTRY">/AUTOSAR_Dem/BSWModuleEntry/Dem_SetEventStatus</CALLED-ENTRY-REF>
                    </BSW-DIRECT-CALL-POINT>
                    <BSW-DIRECT-CALL-POINT>
                      <SHORT-NAME>Det_ReportRuntimeError</SHORT-NAME>
                      <CALLED-ENTRY-REF DEST="BSW-MODULE-ENTRY">/AUTOSAR_Det/BSWModuleEntry/Det_ReportRuntimeError</CALLED-ENTRY-REF>
                    </BSW-DIRECT-CALL-POINT>
                    [!IF "as:modconf('Cdd_FsiRx')[1]/CddFsiRxGeneral/CddFsiRxDevErrorDetectApi = 'true'"!][!//
                    <BSW-DIRECT-CALL-POINT>
                      <SHORT-NAME>Det_ReportError</SHORT-NAME>
                      <CALLED-ENTRY-REF DEST="BSW-MODULE-ENTRY">/AUTOSAR_Det/BSWModuleEntry/Det_ReportError</CALLED-ENTRY-REF>
                    </BSW-DIRECT-CALL-POINT>
                    [!ENDIF!][!//
                  </CALL-POINTS>
                  <IMPLEMENTED-ENTRY-REF DEST="BSW-MODULE-ENTRY">/Cdd_FsiRx_TI_AM263Px/Cdd_FsiRx_ModuleEntry/CddFsiRx_FSIINT2_IrqUnit3</IMPLEMENTED-ENTRY-REF>
                  [!IF "as:modconf('Cdd_FsiRx')[1]/CddFsiRxGeneral/CddFsiRxTypeofInterruptFunction = 'CDD_FSI_RX_ISR_CAT2'"!][!//
                  <INTERRUPT-CATEGORY>CAT-2</INTERRUPT-CATEGORY>
                  [!ELSE!]
                  <INTERRUPT-CATEGORY>CAT-1</INTERRUPT-CATEGORY>
                  [!ENDIF!][!//
                  <INTERRUPT-SOURCE>Hardware</INTERRUPT-SOURCE>
                </BSW-INTERRUPT-ENTITY>
                [!ENDIF!][!//
                [!ENDLOOP!][!//
                [!ENDLOOP!][!//
                <BSW-CALLED-ENTITY UUID="b3c2a43b-a994-4b33-a515-dcc6c46ce3fb">
                  <SHORT-NAME>CddFsiRx_GetStatus</SHORT-NAME>
                  <MINIMUM-START-INTERVAL>0.0</MINIMUM-START-INTERVAL>
                  <REENTRANCY-LEVEL>NON-REENTRANT</REENTRANCY-LEVEL>
                  <IMPLEMENTED-ENTRY-REF DEST="BSW-MODULE-ENTRY">/Cdd_FsiRx_TI_AM263Px/Cdd_FsiRx_ModuleEntry/CddFsiRx_GetStatus</IMPLEMENTED-ENTRY-REF>
                </BSW-CALLED-ENTITY>
                [!IF "as:modconf('Cdd_FsiRx')[1]/CddFsiRxGeneral/CddFsiRxDeInitApi = 'true'"!][!//
                <BSW-CALLED-ENTITY UUID="5539ae74-899d-4486-b72c-efcbe1d7168b">
                  <SHORT-NAME>Cdd_FsiRx_DeInit</SHORT-NAME>
                  <MINIMUM-START-INTERVAL>0.0</MINIMUM-START-INTERVAL>
                  <REENTRANCY-LEVEL>NON-REENTRANT</REENTRANCY-LEVEL>
                  [!IF "as:modconf('Cdd_FsiRx')[1]/CddFsiRxGeneral/CddFsiRxDevErrorDetectApi = 'true'"!][!//
                  <CALL-POINTS>
                    <BSW-DIRECT-CALL-POINT>
                      <SHORT-NAME>Det_ReportError</SHORT-NAME>
                      <CALLED-ENTRY-REF DEST="BSW-MODULE-ENTRY">/AUTOSAR_Det/BSWModuleEntry/Det_ReportError</CALLED-ENTRY-REF>
                    </BSW-DIRECT-CALL-POINT>
                  </CALL-POINTS>
                  [!ENDIF!][!//
                  <IMPLEMENTED-ENTRY-REF DEST="BSW-MODULE-ENTRY">/Cdd_FsiRx_TI_AM263Px/Cdd_FsiRx_ModuleEntry/Cdd_FsiRx_DeInit</IMPLEMENTED-ENTRY-REF>
                </BSW-CALLED-ENTITY>
                [!ENDIF!][!//
                [!IF "as:modconf('Cdd_FsiRx')[1]/CddFsiRxGeneral/CddFsiRxGetVersionInfoApi = 'true'"!][!//
                <BSW-CALLED-ENTITY UUID="912751a4-91a7-4a4f-9abd-b9aeef85696a">
                  <SHORT-NAME>Cdd_FsiRx_GetVersionInfo</SHORT-NAME>
                  <MINIMUM-START-INTERVAL>0.0</MINIMUM-START-INTERVAL>
                  <REENTRANCY-LEVEL>SINGLE-CORE-REENTRANT</REENTRANCY-LEVEL>
                  [!IF "as:modconf('Cdd_FsiRx')[1]/CddFsiRxGeneral/CddFsiRxDevErrorDetectApi = 'true'"!][!//
                  <CALL-POINTS>
                    <BSW-DIRECT-CALL-POINT>
                      <SHORT-NAME>Det_ReportError</SHORT-NAME>
                      <CALLED-ENTRY-REF DEST="BSW-MODULE-ENTRY">/AUTOSAR_Det/BSWModuleEntry/Det_ReportError</CALLED-ENTRY-REF>
                    </BSW-DIRECT-CALL-POINT>
                  </CALL-POINTS>
                  [!ENDIF!][!//
                  <IMPLEMENTED-ENTRY-REF DEST="BSW-MODULE-ENTRY">/Cdd_FsiRx_TI_AM263Px/Cdd_FsiRx_ModuleEntry/Cdd_FsiRx_GetVersionInfo</IMPLEMENTED-ENTRY-REF>
                </BSW-CALLED-ENTITY>
                [!ENDIF!][!//
                <BSW-CALLED-ENTITY UUID="76e8839f-57cb-49c2-b691-31a13a66655f">
                  <SHORT-NAME>Cdd_FsiRx_Init</SHORT-NAME>
                  <MINIMUM-START-INTERVAL>0.0</MINIMUM-START-INTERVAL>
                  <REENTRANCY-LEVEL>NON-REENTRANT</REENTRANCY-LEVEL>
                  [!IF "as:modconf('Cdd_FsiRx')[1]/CddFsiRxGeneral/CddFsiRxDevErrorDetectApi = 'true'"!][!//
                  <CALL-POINTS>
                    [!IF "as:modconf('Cdd_FsiRx')[1]/CddFsiRxGeneral/CddFsiRxDMAEnable = 'true'"!][!//
                    <BSW-DIRECT-CALL-POINT>
                      <SHORT-NAME>Cdd_Dma_CbkRegister</SHORT-NAME>
                    </BSW-DIRECT-CALL-POINT>
                    [!ENDIF!][!//
                    <BSW-DIRECT-CALL-POINT>
                      <SHORT-NAME>Det_ReportError</SHORT-NAME>
                      <CALLED-ENTRY-REF DEST="BSW-MODULE-ENTRY">/AUTOSAR_Det/BSWModuleEntry/Det_ReportError</CALLED-ENTRY-REF>
                    </BSW-DIRECT-CALL-POINT>
                  </CALL-POINTS>
                  [!ENDIF!][!//
                  <IMPLEMENTED-ENTRY-REF DEST="BSW-MODULE-ENTRY">/Cdd_FsiRx_TI_AM263Px/Cdd_FsiRx_ModuleEntry/Cdd_FsiRx_Init</IMPLEMENTED-ENTRY-REF>
                </BSW-CALLED-ENTITY>
                [!IF "as:modconf('Cdd_FsiRx')[1]/CddFsiRxGeneral/CddFsiRxMainApi = 'true'"!][!//
                <BSW-CALLED-ENTITY UUID="68f42cad-4bf8-494e-ab20-f0f7f495932b">
                  <SHORT-NAME>Cdd_FsiRx_MainFunction</SHORT-NAME>
                  <CAN-ENTER-EXCLUSIVE-AREA-REFS>
                    <CAN-ENTER-EXCLUSIVE-AREA-REF DEST="EXCLUSIVE-AREA">/Cdd_FsiRx_TI_AM263Px/Cdd_FsiRx/Cdd_Fsi_Rx_Behavior/FSI_RX_EXCLUSIVE_AREA_0</CAN-ENTER-EXCLUSIVE-AREA-REF>
                  </CAN-ENTER-EXCLUSIVE-AREA-REFS>
                  <MINIMUM-START-INTERVAL>0.0</MINIMUM-START-INTERVAL>
                  <REENTRANCY-LEVEL>SINGLE-CORE-REENTRANT</REENTRANCY-LEVEL>
                  <CALL-POINTS>
                    [!IF "as:modconf('Cdd_FsiRx')[1]/CddFsiRxGeneral/CddFsiRxDMAEnable = 'true'"!][!//
                    <BSW-DIRECT-CALL-POINT>
                      <SHORT-NAME>Cdd_Dma_ChainChannel</SHORT-NAME>
                    </BSW-DIRECT-CALL-POINT>
                    <BSW-DIRECT-CALL-POINT>
                      <SHORT-NAME>Cdd_Dma_EnableTransferRegion</SHORT-NAME>
                    </BSW-DIRECT-CALL-POINT>
                    <BSW-DIRECT-CALL-POINT>
                      <SHORT-NAME>Cdd_Dma_GetInitStatus</SHORT-NAME>
                    </BSW-DIRECT-CALL-POINT>
                    <BSW-DIRECT-CALL-POINT>
                      <SHORT-NAME>Cdd_Dma_ParamSet</SHORT-NAME>
                    </BSW-DIRECT-CALL-POINT>
                    [!ENDIF!][!//
                    <BSW-DIRECT-CALL-POINT>
                      <SHORT-NAME>Det_ReportRuntimeError</SHORT-NAME>
                      <CALLED-ENTRY-REF DEST="BSW-MODULE-ENTRY">/AUTOSAR_Det/BSWModuleEntry/Det_ReportRuntimeError</CALLED-ENTRY-REF>
                    </BSW-DIRECT-CALL-POINT>
                    [!IF "as:modconf('Cdd_FsiRx')[1]/CddFsiRxGeneral/CddFsiRxDevErrorDetectApi = 'true'"!][!//
                    <BSW-DIRECT-CALL-POINT>
                      <SHORT-NAME>Det_ReportError</SHORT-NAME>
                      <CALLED-ENTRY-REF DEST="BSW-MODULE-ENTRY">/AUTOSAR_Det/BSWModuleEntry/Det_ReportError</CALLED-ENTRY-REF>
                    </BSW-DIRECT-CALL-POINT>
                    [!ENDIF!][!//
                  </CALL-POINTS>
                  <IMPLEMENTED-ENTRY-REF DEST="BSW-MODULE-ENTRY">/Cdd_FsiRx_TI_AM263Px/Cdd_FsiRx_ModuleEntry/Cdd_FsiRx_MainFunction</IMPLEMENTED-ENTRY-REF>
                </BSW-CALLED-ENTITY>
                [!ENDIF!][!//
                [!IF "as:modconf('Cdd_FsiRx')[1]/CddFsiRxGeneral/CddFsiRxResetDriver = 'true'"!][!//
                <BSW-CALLED-ENTITY UUID="96c84af5-c583-4fbc-a194-703f4f9d4665">
                  <SHORT-NAME>Cdd_FsiRx_Reset</SHORT-NAME>
                  <MINIMUM-START-INTERVAL>0.0</MINIMUM-START-INTERVAL>
                  <REENTRANCY-LEVEL>NON-REENTRANT</REENTRANCY-LEVEL>
                  [!IF "as:modconf('Cdd_FsiRx')[1]/CddFsiRxGeneral/CddFsiRxDevErrorDetectApi = 'true'"!][!//
                  <CALL-POINTS>
                    <BSW-DIRECT-CALL-POINT>
                      <SHORT-NAME>Det_ReportError</SHORT-NAME>
                      <CALLED-ENTRY-REF DEST="BSW-MODULE-ENTRY">/AUTOSAR_Det/BSWModuleEntry/Det_ReportError</CALLED-ENTRY-REF>
                    </BSW-DIRECT-CALL-POINT>
                  </CALL-POINTS>
                  [!ENDIF!][!//
                  <IMPLEMENTED-ENTRY-REF DEST="BSW-MODULE-ENTRY">/Cdd_FsiRx_TI_AM263Px/Cdd_FsiRx_ModuleEntry/Cdd_FsiRx_Reset</IMPLEMENTED-ENTRY-REF>
                </BSW-CALLED-ENTITY>
                [!ENDIF!][!//
                <BSW-CALLED-ENTITY UUID="6ba221e0-2bdf-42d0-9743-cce4afff14fc">
                  <SHORT-NAME>Cdd_FsiRx_setUpBuffer</SHORT-NAME>
                  <CAN-ENTER-EXCLUSIVE-AREA-REFS>
                    <CAN-ENTER-EXCLUSIVE-AREA-REF DEST="EXCLUSIVE-AREA">/Cdd_FsiRx_TI_AM263Px/Cdd_FsiRx/Cdd_Fsi_Rx_Behavior/FSI_RX_EXCLUSIVE_AREA_0</CAN-ENTER-EXCLUSIVE-AREA-REF>
                  </CAN-ENTER-EXCLUSIVE-AREA-REFS>
                  <MINIMUM-START-INTERVAL>0.0</MINIMUM-START-INTERVAL>
                  <REENTRANCY-LEVEL>SINGLE-CORE-REENTRANT</REENTRANCY-LEVEL>
                  [!IF "as:modconf('Cdd_FsiRx')[1]/CddFsiRxGeneral/CddFsiRxDevErrorDetectApi = 'true'"!][!//
                  <CALL-POINTS>
                    <BSW-DIRECT-CALL-POINT>
                      <SHORT-NAME>Det_ReportError</SHORT-NAME>
                      <CALLED-ENTRY-REF DEST="BSW-MODULE-ENTRY">/AUTOSAR_Det/BSWModuleEntry/Det_ReportError</CALLED-ENTRY-REF>
                    </BSW-DIRECT-CALL-POINT>
                  </CALL-POINTS>
                  [!ENDIF!][!//
                  <IMPLEMENTED-ENTRY-REF DEST="BSW-MODULE-ENTRY">/Cdd_FsiRx_TI_AM263Px/Cdd_FsiRx_ModuleEntry/Cdd_FsiRx_setUpBuffer</IMPLEMENTED-ENTRY-REF>
                </BSW-CALLED-ENTITY>
              [!IF "as:modconf('Cdd_FsiRx')[1]/CddFsiRxGeneral/CddFsiRxEnableRegisterReadbackApi   = 'true'"!][!//
                <BSW-CALLED-ENTITY UUID="3f655195-c038-4552-b913-69078cf1bb01">
                  <SHORT-NAME>Cdd_FsiRx_RegisterReadback</SHORT-NAME>
                  <MINIMUM-START-INTERVAL>0.0</MINIMUM-START-INTERVAL>
                  <REENTRANCY-LEVEL>NON-REENTRANT</REENTRANCY-LEVEL>
                  <CALL-POINTS>
                  [!IF "as:modconf('Cdd_FsiRx')[1]/CddFsiRxGeneral/CddFsiRxDevErrorDetectApi  = 'true'"!][!//
                    <BSW-DIRECT-CALL-POINT>
                      <SHORT-NAME>Det_ReportError</SHORT-NAME>
                      <CALLED-ENTRY-REF DEST="BSW-MODULE-ENTRY">/AUTOSAR_Det/BSWModuleEntry/Det_ReportError</CALLED-ENTRY-REF>
                    </BSW-DIRECT-CALL-POINT>
                  [!ENDIF!][!//
                  </CALL-POINTS>
                  <IMPLEMENTED-ENTRY-REF DEST="BSW-MODULE-ENTRY">/Cdd_FsiRx_TI_AM263Px/Cdd_FsiRx_ModuleEntry/Cdd_FsiRx_RegisterReadback</IMPLEMENTED-ENTRY-REF>
                </BSW-CALLED-ENTITY>
              [!ENDIF!][!//
              </ENTITYS>
            </BSW-INTERNAL-BEHAVIOR>
          </INTERNAL-BEHAVIORS>
        </BSW-MODULE-DESCRIPTION>
        <BSW-IMPLEMENTATION UUID="f8db81ec-af5f-40c6-b070-3c55e6104ef9">
          <SHORT-NAME>Cdd_FsiRx_Impl</SHORT-NAME>
          <CODE-DESCRIPTORS>
            <CODE UUID="c85abbdc-cda9-46fb-9867-420373613cc3">
              <SHORT-NAME>Files</SHORT-NAME>
              <ARTIFACT-DESCRIPTORS>
                <AUTOSAR-ENGINEERING-OBJECT>
                  <SHORT-LABEL>V0::Cdd_FsiRx_Irq.c</SHORT-LABEL>
                  <CATEGORY>SWSRC</CATEGORY>
                </AUTOSAR-ENGINEERING-OBJECT>
                <AUTOSAR-ENGINEERING-OBJECT>
                  <SHORT-LABEL>V0::Cdd_FsiRx_Irq.h</SHORT-LABEL>
                  <CATEGORY>SWHDR</CATEGORY>
                </AUTOSAR-ENGINEERING-OBJECT>
                <AUTOSAR-ENGINEERING-OBJECT>
                  <SHORT-LABEL>V0::Cdd_FsiRx_Platform.c</SHORT-LABEL>
                  <CATEGORY>SWSRC</CATEGORY>
                </AUTOSAR-ENGINEERING-OBJECT>
                <AUTOSAR-ENGINEERING-OBJECT>
                  <SHORT-LABEL>V0::Cdd_FsiRx_Platform.c</SHORT-LABEL>
                  <CATEGORY>SWSRC</CATEGORY>
                </AUTOSAR-ENGINEERING-OBJECT>
                <AUTOSAR-ENGINEERING-OBJECT>
                  <SHORT-LABEL>V0::Cdd_FsiRx_Priv.c</SHORT-LABEL>
                  <CATEGORY>SWSRC</CATEGORY>
                </AUTOSAR-ENGINEERING-OBJECT>
                <AUTOSAR-ENGINEERING-OBJECT>
                  <SHORT-LABEL>V0::Cdd_FsiRx_Priv.h</SHORT-LABEL>
                  <CATEGORY>SWHDR</CATEGORY>
                </AUTOSAR-ENGINEERING-OBJECT>
                <AUTOSAR-ENGINEERING-OBJECT>
                  <SHORT-LABEL>V0::Cdd_FsiRx_Reg.h</SHORT-LABEL>
                  <CATEGORY>SWHDR</CATEGORY>
                </AUTOSAR-ENGINEERING-OBJECT>
                <AUTOSAR-ENGINEERING-OBJECT>
                  <SHORT-LABEL>V0::Cdd_FsiRx_Types.h</SHORT-LABEL>
                  <CATEGORY>SWHDR</CATEGORY>
                </AUTOSAR-ENGINEERING-OBJECT>
                <AUTOSAR-ENGINEERING-OBJECT>
                  <SHORT-LABEL>generate::include::Cdd_FsiRx_Cfg.h</SHORT-LABEL>
                  <CATEGORY>SWHDR</CATEGORY>
                </AUTOSAR-ENGINEERING-OBJECT>
                <AUTOSAR-ENGINEERING-OBJECT>
                  <SHORT-LABEL>generate::src::Cdd_FsiRx_Cfg.c</SHORT-LABEL>
                  <CATEGORY>SWSRC</CATEGORY>
                </AUTOSAR-ENGINEERING-OBJECT>
                <AUTOSAR-ENGINEERING-OBJECT>
                  <SHORT-LABEL>generate::src::Cdd_FsiRx_PBcfg.c</SHORT-LABEL>
                  <CATEGORY>SWSRC</CATEGORY>
                </AUTOSAR-ENGINEERING-OBJECT>
                <AUTOSAR-ENGINEERING-OBJECT>
                  <SHORT-LABEL>include::Cdd_FsiRx.h</SHORT-LABEL>
                  <CATEGORY>SWHDR</CATEGORY>
                </AUTOSAR-ENGINEERING-OBJECT>
                <AUTOSAR-ENGINEERING-OBJECT>
                  <SHORT-LABEL>src::Cdd_FsiRx.c</SHORT-LABEL>
                  <CATEGORY>SWSRC</CATEGORY>
                </AUTOSAR-ENGINEERING-OBJECT>
              </ARTIFACT-DESCRIPTORS>
            </CODE>
          </CODE-DESCRIPTORS>
          <COMPILERS>
            <COMPILER UUID="1053bf9d-d5f3-41b4-9e37-bf4524e6b5f2">
              <SHORT-NAME>tiarmclang</SHORT-NAME>
              <NAME>TI ARM Clang</NAME>
              <OPTIONS>-mcpu=cortex-r5  -mfpu=vfpv3-d16  -mfloat-abi=hard  -c  -mlittle-endian  -ffunction-sections  -gdwarf-3  -Werror -Os  -x  -save-temps  -mthumb  -DAM263PX_SIP_PACKAGE  -DAM263PX_PLATFORM -DAM263PX_R_PACKAGE -DAM263PX_C_PACKAGE </OPTIONS>
              <VENDOR>Texas Instruments</VENDOR>
              <VERSION>4.0.0</VERSION>
            </COMPILER>
          </COMPILERS>
          <LINKERS>
            <LINKER UUID="5c0e5a1e-37f2-42b2-8144-fce7eca3400d">
              <SHORT-NAME>tiarmlnk</SHORT-NAME>
              <NAME>TI ARM Clang Linker</NAME>
              <OPTIONS>-mcpu=cortex-r5  -Wl,--ram_model  -Wl,--reread_libs  -Wl,--warn_sections  -qq -Wl,--emit_warnings_as_errors --diag_suppress=10068 --diag_suppress=10063 </OPTIONS>
              <VENDOR>Texas Instruments</VENDOR>
              <VERSION>4.0.0</VERSION>
            </LINKER>
          </LINKERS>
          <PROGRAMMING-LANGUAGE>C</PROGRAMMING-LANGUAGE>
          <RESOURCE-CONSUMPTION UUID="b005f32b-0522-4c6b-bf5c-0a94e89319ad">
            <SHORT-NAME>ResourceConsumption</SHORT-NAME>
            <MEMORY-SECTIONS>
              <MEMORY-SECTION UUID="ed8a9393-5d35-4912-8e08-4b08623f5f60">
                <SHORT-NAME>CDD_FSI_RX_CODE</SHORT-NAME>
                <ALIGNMENT>UNSPECIFIED</ALIGNMENT>
                <SW-ADDRMETHOD-REF DEST="SW-ADDR-METHOD">/AUTOSAR_MemMap/SwAddrMethods/CODE</SW-ADDRMETHOD-REF>
                <SYMBOL>CODE</SYMBOL>
              </MEMORY-SECTION>
              <MEMORY-SECTION UUID="27cfb226-6a1d-4fc4-8428-1a467f503553">
                <SHORT-NAME>CDD_FSI_RX_CONFIG_DATA</SHORT-NAME>
                <ALIGNMENT>UNSPECIFIED</ALIGNMENT>
                <SW-ADDRMETHOD-REF DEST="SW-ADDR-METHOD">/AUTOSAR_MemMap/SwAddrMethods/CONFIG_DATA</SW-ADDRMETHOD-REF>
                <SYMBOL>CONFIG_DATA</SYMBOL>
              </MEMORY-SECTION>
              <MEMORY-SECTION UUID="5f6ed4bf-90d5-4ded-89b7-9b239a951a97">
                <SHORT-NAME>CDD_FSI_RX_ISR_CODE</SHORT-NAME>
                <ALIGNMENT>UNSPECIFIED</ALIGNMENT>
                <SW-ADDRMETHOD-REF DEST="SW-ADDR-METHOD">/AUTOSAR_MemMap/SwAddrMethods/CODE</SW-ADDRMETHOD-REF>
                <SYMBOL>ISR_CODE</SYMBOL>
              </MEMORY-SECTION>
              <MEMORY-SECTION UUID="37554603-e554-423c-95e3-fcd53f1aa305">
                <SHORT-NAME>CDD_FSI_RX_VAR_INIT_16</SHORT-NAME>
                <ALIGNMENT>16</ALIGNMENT>
                <SW-ADDRMETHOD-REF DEST="SW-ADDR-METHOD">/AUTOSAR_MemMap/SwAddrMethods/VAR_INIT</SW-ADDRMETHOD-REF>
                <SYMBOL>VAR_INIT_16</SYMBOL>
              </MEMORY-SECTION>
              <MEMORY-SECTION UUID="a0676ccb-56d8-489a-90bb-1876d916310e">
                <SHORT-NAME>CDD_FSI_RX_VAR_NO_INIT_16</SHORT-NAME>
                <ALIGNMENT>16</ALIGNMENT>
                <SW-ADDRMETHOD-REF DEST="SW-ADDR-METHOD">/AUTOSAR_MemMap/SwAddrMethods/VAR_NO_INIT</SW-ADDRMETHOD-REF>
                <SYMBOL>VAR_NO_INIT_16</SYMBOL>
              </MEMORY-SECTION>
              <MEMORY-SECTION UUID="c880f604-ec17-4543-a216-a9d8e026f450">
                <SHORT-NAME>CDD_FSI_RX_VAR_NO_INIT_UNSPECIFIED</SHORT-NAME>
                <ALIGNMENT>UNSPECIFIED</ALIGNMENT>
                <SW-ADDRMETHOD-REF DEST="SW-ADDR-METHOD">/AUTOSAR_MemMap/SwAddrMethods/VAR_NO_INIT</SW-ADDRMETHOD-REF>
                <SYMBOL>VAR_NO_INIT_UNSPECIFIED</SYMBOL>
              </MEMORY-SECTION>
            </MEMORY-SECTIONS>
          </RESOURCE-CONSUMPTION>
          <SW-VERSION>10.01.00</SW-VERSION>
          <VENDOR-ID>44</VENDOR-ID>
          <AR-RELEASE-VERSION>4.3.1</AR-RELEASE-VERSION>
          <BEHAVIOR-REF DEST="BSW-INTERNAL-BEHAVIOR">/Cdd_FsiRx_TI_AM263Px/Cdd_FsiRx/Cdd_Fsi_Rx_Behavior</BEHAVIOR-REF>
          <VENDOR-SPECIFIC-MODULE-DEF-REFS>
            <VENDOR-SPECIFIC-MODULE-DEF-REF DEST="ECUC-MODULE-DEF">/TI_AM263Px/Cdd_FsiRx</VENDOR-SPECIFIC-MODULE-DEF-REF>
          </VENDOR-SPECIFIC-MODULE-DEF-REFS>
        </BSW-IMPLEMENTATION>
      </ELEMENTS>
      <AR-PACKAGES>
        <AR-PACKAGE UUID="b959e009-e6f6-4d0a-91e9-5b7dc9685dd3">
          <SHORT-NAME>Cdd_FsiRx_ModuleEntry</SHORT-NAME>
          <ELEMENTS>
            <BSW-MODULE-ENTRY UUID="806e54ad-44ee-4809-96b9-bc6d55453b13">
              <SHORT-NAME>CddFsiRx_FSIINT1_IrqUnit0</SHORT-NAME>
              <IS-REENTRANT>false</IS-REENTRANT>
              <IS-SYNCHRONOUS>true</IS-SYNCHRONOUS>
              <CALL-TYPE>INTERRUPT</CALL-TYPE>
              [!IF "as:modconf('Cdd_FsiRx')[1]/CddFsiRxGeneral/CddFsiRxTypeofInterruptFunction = 'CDD_FSI_RX_ISR_CAT2'"!][!//
              <EXECUTION-CONTEXT>INTERRUPT-CAT-2</EXECUTION-CONTEXT>
              [!ELSE!]
              <EXECUTION-CONTEXT>INTERRUPT-CAT-1</EXECUTION-CONTEXT>
              [!ENDIF!][!//
              <SW-SERVICE-IMPL-POLICY>STANDARD</SW-SERVICE-IMPL-POLICY>
              <BSW-ENTRY-KIND>CONCRETE</BSW-ENTRY-KIND>
            </BSW-MODULE-ENTRY>
            <BSW-MODULE-ENTRY UUID="beeafad7-1fe0-4f5e-a92c-297c5f1826df">
              <SHORT-NAME>CddFsiRx_FSIINT1_IrqUnit1</SHORT-NAME>
              <IS-REENTRANT>false</IS-REENTRANT>
              <IS-SYNCHRONOUS>true</IS-SYNCHRONOUS>
              <CALL-TYPE>INTERRUPT</CALL-TYPE>
              [!IF "as:modconf('Cdd_FsiRx')[1]/CddFsiRxGeneral/CddFsiRxTypeofInterruptFunction = 'CDD_FSI_RX_ISR_CAT2'"!][!//
              <EXECUTION-CONTEXT>INTERRUPT-CAT-2</EXECUTION-CONTEXT>
              [!ELSE!]
              <EXECUTION-CONTEXT>INTERRUPT-CAT-1</EXECUTION-CONTEXT>
              [!ENDIF!][!//
              <SW-SERVICE-IMPL-POLICY>STANDARD</SW-SERVICE-IMPL-POLICY>
              <BSW-ENTRY-KIND>CONCRETE</BSW-ENTRY-KIND>
            </BSW-MODULE-ENTRY>
            <BSW-MODULE-ENTRY UUID="f94aa75f-e6d0-44f0-844f-c852d1c8e75a">
              <SHORT-NAME>CddFsiRx_FSIINT1_IrqUnit2</SHORT-NAME>
              <IS-REENTRANT>false</IS-REENTRANT>
              <IS-SYNCHRONOUS>true</IS-SYNCHRONOUS>
              <CALL-TYPE>INTERRUPT</CALL-TYPE>
              [!IF "as:modconf('Cdd_FsiRx')[1]/CddFsiRxGeneral/CddFsiRxTypeofInterruptFunction = 'CDD_FSI_RX_ISR_CAT2'"!][!//
              <EXECUTION-CONTEXT>INTERRUPT-CAT-2</EXECUTION-CONTEXT>
              [!ELSE!]
              <EXECUTION-CONTEXT>INTERRUPT-CAT-1</EXECUTION-CONTEXT>
              [!ENDIF!][!//
              <SW-SERVICE-IMPL-POLICY>STANDARD</SW-SERVICE-IMPL-POLICY>
              <BSW-ENTRY-KIND>CONCRETE</BSW-ENTRY-KIND>
            </BSW-MODULE-ENTRY>
            <BSW-MODULE-ENTRY UUID="e7eafef3-4548-4c5b-87be-fe9d5a1da4fe">
              <SHORT-NAME>CddFsiRx_FSIINT1_IrqUnit3</SHORT-NAME>
              <IS-REENTRANT>false</IS-REENTRANT>
              <IS-SYNCHRONOUS>true</IS-SYNCHRONOUS>
              <CALL-TYPE>INTERRUPT</CALL-TYPE>
              [!IF "as:modconf('Cdd_FsiRx')[1]/CddFsiRxGeneral/CddFsiRxTypeofInterruptFunction = 'CDD_FSI_RX_ISR_CAT2'"!][!//
              <EXECUTION-CONTEXT>INTERRUPT-CAT-2</EXECUTION-CONTEXT>
              [!ELSE!]
              <EXECUTION-CONTEXT>INTERRUPT-CAT-1</EXECUTION-CONTEXT>
              [!ENDIF!][!//
              <SW-SERVICE-IMPL-POLICY>STANDARD</SW-SERVICE-IMPL-POLICY>
              <BSW-ENTRY-KIND>CONCRETE</BSW-ENTRY-KIND>
            </BSW-MODULE-ENTRY>
            <BSW-MODULE-ENTRY UUID="8210f6af-410e-4fc3-b2e1-1cff5fe3f866">
              <SHORT-NAME>CddFsiRx_FSIINT2_IrqUnit0</SHORT-NAME>
              <IS-REENTRANT>false</IS-REENTRANT>
              <IS-SYNCHRONOUS>true</IS-SYNCHRONOUS>
              <CALL-TYPE>INTERRUPT</CALL-TYPE>
              [!IF "as:modconf('Cdd_FsiRx')[1]/CddFsiRxGeneral/CddFsiRxTypeofInterruptFunction = 'CDD_FSI_RX_ISR_CAT2'"!][!//
              <EXECUTION-CONTEXT>INTERRUPT-CAT-2</EXECUTION-CONTEXT>
              [!ELSE!]
              <EXECUTION-CONTEXT>INTERRUPT-CAT-1</EXECUTION-CONTEXT>
              [!ENDIF!][!//
              <SW-SERVICE-IMPL-POLICY>STANDARD</SW-SERVICE-IMPL-POLICY>
              <BSW-ENTRY-KIND>CONCRETE</BSW-ENTRY-KIND>
            </BSW-MODULE-ENTRY>
            <BSW-MODULE-ENTRY UUID="8ab44a6f-88ff-4c76-ba34-db7712f6bf08">
              <SHORT-NAME>CddFsiRx_FSIINT2_IrqUnit1</SHORT-NAME>
              <IS-REENTRANT>false</IS-REENTRANT>
              <IS-SYNCHRONOUS>true</IS-SYNCHRONOUS>
              <CALL-TYPE>INTERRUPT</CALL-TYPE>
              [!IF "as:modconf('Cdd_FsiRx')[1]/CddFsiRxGeneral/CddFsiRxTypeofInterruptFunction = 'CDD_FSI_RX_ISR_CAT2'"!][!//
              <EXECUTION-CONTEXT>INTERRUPT-CAT-2</EXECUTION-CONTEXT>
              [!ELSE!]
              <EXECUTION-CONTEXT>INTERRUPT-CAT-1</EXECUTION-CONTEXT>
              [!ENDIF!][!//
              <SW-SERVICE-IMPL-POLICY>STANDARD</SW-SERVICE-IMPL-POLICY>
              <BSW-ENTRY-KIND>CONCRETE</BSW-ENTRY-KIND>
            </BSW-MODULE-ENTRY>
            <BSW-MODULE-ENTRY UUID="47c4b0d9-922f-4530-b865-cfc0838b033a">
              <SHORT-NAME>CddFsiRx_FSIINT2_IrqUnit2</SHORT-NAME>
              <IS-REENTRANT>false</IS-REENTRANT>
              <IS-SYNCHRONOUS>true</IS-SYNCHRONOUS>
              <CALL-TYPE>INTERRUPT</CALL-TYPE>
              [!IF "as:modconf('Cdd_FsiRx')[1]/CddFsiRxGeneral/CddFsiRxTypeofInterruptFunction = 'CDD_FSI_RX_ISR_CAT2'"!][!//
              <EXECUTION-CONTEXT>INTERRUPT-CAT-2</EXECUTION-CONTEXT>
              [!ELSE!]
              <EXECUTION-CONTEXT>INTERRUPT-CAT-1</EXECUTION-CONTEXT>
              [!ENDIF!][!//
              <SW-SERVICE-IMPL-POLICY>STANDARD</SW-SERVICE-IMPL-POLICY>
              <BSW-ENTRY-KIND>CONCRETE</BSW-ENTRY-KIND>
            </BSW-MODULE-ENTRY>
            <BSW-MODULE-ENTRY UUID="209f5d8d-bba3-4e0e-be51-66259739f82a">
              <SHORT-NAME>CddFsiRx_FSIINT2_IrqUnit3</SHORT-NAME>
              <IS-REENTRANT>false</IS-REENTRANT>
              <IS-SYNCHRONOUS>true</IS-SYNCHRONOUS>
              <CALL-TYPE>INTERRUPT</CALL-TYPE>
              [!IF "as:modconf('Cdd_FsiRx')[1]/CddFsiRxGeneral/CddFsiRxTypeofInterruptFunction = 'CDD_FSI_RX_ISR_CAT2'"!][!//
              <EXECUTION-CONTEXT>INTERRUPT-CAT-2</EXECUTION-CONTEXT>
              [!ELSE!]
              <EXECUTION-CONTEXT>INTERRUPT-CAT-1</EXECUTION-CONTEXT>
              [!ENDIF!][!//
              <SW-SERVICE-IMPL-POLICY>STANDARD</SW-SERVICE-IMPL-POLICY>
              <BSW-ENTRY-KIND>CONCRETE</BSW-ENTRY-KIND>
            </BSW-MODULE-ENTRY>
            <BSW-MODULE-ENTRY UUID="891b8508-e88b-4788-a024-16925fcbb269">
              <SHORT-NAME>CddFsiRx_GetStatus</SHORT-NAME>
              <SERVICE-ID>5</SERVICE-ID>
              <IS-REENTRANT>false</IS-REENTRANT>
              <IS-SYNCHRONOUS>true</IS-SYNCHRONOUS>
              <CALL-TYPE>REGULAR</CALL-TYPE>
              <EXECUTION-CONTEXT>UNSPECIFIED</EXECUTION-CONTEXT>
              <SW-SERVICE-IMPL-POLICY>STANDARD</SW-SERVICE-IMPL-POLICY>
              <BSW-ENTRY-KIND>CONCRETE</BSW-ENTRY-KIND>
            </BSW-MODULE-ENTRY>
            <BSW-MODULE-ENTRY UUID="ea77369f-ab16-4ee4-8381-9e3e695e6c72">
              <SHORT-NAME>Cdd_FsiRx_DeInit</SHORT-NAME>
              <SERVICE-ID>4</SERVICE-ID>
              <IS-REENTRANT>false</IS-REENTRANT>
              <IS-SYNCHRONOUS>true</IS-SYNCHRONOUS>
              <CALL-TYPE>REGULAR</CALL-TYPE>
              <EXECUTION-CONTEXT>UNSPECIFIED</EXECUTION-CONTEXT>
              <SW-SERVICE-IMPL-POLICY>STANDARD</SW-SERVICE-IMPL-POLICY>
              <BSW-ENTRY-KIND>CONCRETE</BSW-ENTRY-KIND>
            </BSW-MODULE-ENTRY>
            <BSW-MODULE-ENTRY UUID="9a5e8784-f4fa-473b-877a-e6685b99aed7">
              <SHORT-NAME>Cdd_FsiRx_GetVersionInfo</SHORT-NAME>
              <SERVICE-ID>2</SERVICE-ID>
              <IS-REENTRANT>true</IS-REENTRANT>
              <IS-SYNCHRONOUS>true</IS-SYNCHRONOUS>
              <CALL-TYPE>REGULAR</CALL-TYPE>
              <EXECUTION-CONTEXT>UNSPECIFIED</EXECUTION-CONTEXT>
              <SW-SERVICE-IMPL-POLICY>STANDARD</SW-SERVICE-IMPL-POLICY>
              <BSW-ENTRY-KIND>CONCRETE</BSW-ENTRY-KIND>
            </BSW-MODULE-ENTRY>
            <BSW-MODULE-ENTRY UUID="1ad3562c-3321-449c-9c8a-3e84d548d12e">
              <SHORT-NAME>Cdd_FsiRx_Init</SHORT-NAME>
              <SERVICE-ID>1</SERVICE-ID>
              <IS-REENTRANT>false</IS-REENTRANT>
              <IS-SYNCHRONOUS>true</IS-SYNCHRONOUS>
              <CALL-TYPE>REGULAR</CALL-TYPE>
              <EXECUTION-CONTEXT>UNSPECIFIED</EXECUTION-CONTEXT>
              <SW-SERVICE-IMPL-POLICY>STANDARD</SW-SERVICE-IMPL-POLICY>
              <BSW-ENTRY-KIND>CONCRETE</BSW-ENTRY-KIND>
            </BSW-MODULE-ENTRY>
            <BSW-MODULE-ENTRY UUID="f69847d1-d132-4589-a38f-9b8c5a8306f2">
              <SHORT-NAME>Cdd_FsiRx_MainFunction</SHORT-NAME>
              <SERVICE-ID>3</SERVICE-ID>
              <IS-REENTRANT>true</IS-REENTRANT>
              <IS-SYNCHRONOUS>true</IS-SYNCHRONOUS>
              <CALL-TYPE>REGULAR</CALL-TYPE>
              <EXECUTION-CONTEXT>UNSPECIFIED</EXECUTION-CONTEXT>
              <SW-SERVICE-IMPL-POLICY>STANDARD</SW-SERVICE-IMPL-POLICY>
              <BSW-ENTRY-KIND>CONCRETE</BSW-ENTRY-KIND>
            </BSW-MODULE-ENTRY>
            <BSW-MODULE-ENTRY UUID="6b527ebf-8fa2-4051-8d8c-f38333f05b05">
              <SHORT-NAME>Cdd_FsiRx_Reset</SHORT-NAME>
              <SERVICE-ID>6</SERVICE-ID>
              <IS-REENTRANT>false</IS-REENTRANT>
              <IS-SYNCHRONOUS>true</IS-SYNCHRONOUS>
              <CALL-TYPE>REGULAR</CALL-TYPE>
              <EXECUTION-CONTEXT>UNSPECIFIED</EXECUTION-CONTEXT>
              <SW-SERVICE-IMPL-POLICY>STANDARD</SW-SERVICE-IMPL-POLICY>
              <BSW-ENTRY-KIND>CONCRETE</BSW-ENTRY-KIND>
            </BSW-MODULE-ENTRY>
            <BSW-MODULE-ENTRY UUID="1ebe1176-d917-461f-bc3d-2e632918232a">
              <SHORT-NAME>Cdd_FsiRx_setUpBuffer</SHORT-NAME>
              <SERVICE-ID>7</SERVICE-ID>
              <IS-REENTRANT>true</IS-REENTRANT>
              <IS-SYNCHRONOUS>true</IS-SYNCHRONOUS>
              <CALL-TYPE>REGULAR</CALL-TYPE>
              <EXECUTION-CONTEXT>UNSPECIFIED</EXECUTION-CONTEXT>
              <SW-SERVICE-IMPL-POLICY>STANDARD</SW-SERVICE-IMPL-POLICY>
              <BSW-ENTRY-KIND>CONCRETE</BSW-ENTRY-KIND>
            </BSW-MODULE-ENTRY>
          </ELEMENTS>
        </AR-PACKAGE>
      </AR-PACKAGES>
    </AR-PACKAGE>
  </AR-PACKAGES>
</AUTOSAR>
