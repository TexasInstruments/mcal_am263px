<?xml version="1.0" encoding="UTF-8"?>
<AUTOSAR xmlns="http://autosar.org/schema/r4.0" xmlns:xsi="http://www.w3.org/2001/XMLSchema-instance" xsi:schemaLocation="http://autosar.org/schema/r4.0 AUTOSAR_00044.xsd">
[!SELECT "as:modconf('EthTrcv')[1]"!]
[!AUTOSPACING!][!//
[!VAR "EthTrcvVersionInfoApi_Enable"="EthTrcvGeneral/EthTrcvVersionInfoApi = 'true'"!][!//
[!VAR "EthTrcvDevErrorDet_Enable"="EthTrcvGeneral/EthTrcvDevErrorDetect = 'true'"!][!//
[!VAR "EthTrcvWakeupSupportApi_Enable"="EthTrcvGeneral/EthTrcvWakeUpSupport != 'ETHTRCV_WAKEUP_NOT_SUPPORTED'"!][!//
[!VAR "EthTrcvSetTransceiverModeApi_Enable"="EthTrcvGeneral/EthTrcvSetTransceiverModeApi = 'true'"!][!//
[!VAR "EthTrcvGetTransceiverModeApi_Enable"="EthTrcvGeneral/EthTrcvGetTransceiverModeApi = 'true'"!][!//
[!VAR "EthTrcvStartAutoNegotiationApi_Enable"="EthTrcvGeneral/EthTrcvStartAutoNegotiationApi = 'true'"!][!//
[!VAR "EthTrcvGetLinkStateApi_Enable"="EthTrcvGeneral/EthTrcvGetLinkStateApi = 'true'"!][!//
[!VAR "EthTrcvGetBaudRateApi_Enable"="EthTrcvGeneral/EthTrcvGetBaudRateApi = 'true'"!][!//
[!VAR "EthTrcvGetDuplexModeApi_Enable"="EthTrcvGeneral/EthTrcvGetDuplexModeApi = 'true'"!][!//
[!VAR "EthTrcvSetPhyTxModeApi_Enable"="EthTrcvGeneral/EthTrcvSetPhyTxModeApi = 'true'"!][!//
[!VAR "EthTrcvGetCableDiagnosticsResultApi_Enable"="EthTrcvGeneral/EthTrcvGetCableDiagnosticsResultApi = 'true'"!][!//
[!VAR "EthTrcvGetPhyIdentifierApi_Enable"="EthTrcvGeneral/EthTrcvGetPhyIdentifierApi = 'true'"!][!//
[!VAR "EthTrcvSetPhyTestModeApi_Enable"="EthTrcvGeneral/EthTrcvSetPhyTestModeApi = 'true'"!][!//
[!VAR "EthTrcvGetTransceiverWakeupModeApi_Enable"="EthTrcvGeneral/EthTrcvGetTransceiverWakeupModeApi = 'true'"!][!//
[!VAR "EthTrcvGetPhySignalQualityApi_Enable"="EthTrcvGeneral/EthTrcvGetPhySignalQualityApi = 'true'"!][!//
[!VAR "EthTrcv_SetPhyLoopbackMode_Enable"="EthTrcvConfigSet/EthTrcvConfig/*[1]/EthTrcvEnableLoopback = 'true'"!][!//
  <AR-PACKAGES>
    <AR-PACKAGE UUID="ae97d90f-e362-46a1-b88a-279a559831df">
      <SHORT-NAME>EthTrcv_TI_AM263Px_C</SHORT-NAME>
      <ELEMENTS>
        <BSW-MODULE-DESCRIPTION UUID="157228d6-e7d3-4d03-a2c4-fc9ea55a4c70">
          <SHORT-NAME>EthTrcv</SHORT-NAME>
          <MODULE-ID>73</MODULE-ID>
          <IMPLEMENTED-ENTRYS>
				    [!IF "$EthTrcvVersionInfoApi_Enable = 'true'"!][!//
            <BSW-MODULE-ENTRY-REF-CONDITIONAL S="EthTrcv_GetVersionInfo">
              <BSW-MODULE-ENTRY-REF DEST="BSW-MODULE-ENTRY">/EthTrcv_TI_AM263Px_C/EthTrcv_ModuleEntry/EthTrcv_GetVersionInfo</BSW-MODULE-ENTRY-REF>
            </BSW-MODULE-ENTRY-REF-CONDITIONAL>
					  [!ENDIF!][!//
            <BSW-MODULE-ENTRY-REF-CONDITIONAL S="EthTrcv_Init">
              <BSW-MODULE-ENTRY-REF DEST="BSW-MODULE-ENTRY">/EthTrcv_TI_AM263Px_C/EthTrcv_ModuleEntry/EthTrcv_Init</BSW-MODULE-ENTRY-REF>
            </BSW-MODULE-ENTRY-REF-CONDITIONAL>
            [!IF "$EthTrcvSetTransceiverModeApi_Enable = 'true'"!][!//
					  <BSW-MODULE-ENTRY-REF-CONDITIONAL S="EthTrcv_SetTransceiverMode">
              <BSW-MODULE-ENTRY-REF DEST="BSW-MODULE-ENTRY">/EthTrcv_TI_AM263Px_C/EthTrcv_ModuleEntry/EthTrcv_SetTransceiverMode</BSW-MODULE-ENTRY-REF>
            </BSW-MODULE-ENTRY-REF-CONDITIONAL>
					  [!ENDIF!][!//
            [!IF "$EthTrcvGetTransceiverModeApi_Enable = 'true'"!][!//
					  <BSW-MODULE-ENTRY-REF-CONDITIONAL S="EthTrcv_GetTransceiverMode">
              <BSW-MODULE-ENTRY-REF DEST="BSW-MODULE-ENTRY">/EthTrcv_TI_AM263Px_C/EthTrcv_ModuleEntry/EthTrcv_GetTransceiverMode</BSW-MODULE-ENTRY-REF>
            </BSW-MODULE-ENTRY-REF-CONDITIONAL>
					  [!ENDIF!][!//
            [!IF "$EthTrcvWakeupSupportApi_Enable = 'true'"!][!//
					  <BSW-MODULE-ENTRY-REF-CONDITIONAL S="EthTrcv_SetTransceiverWakeupMode">
              <BSW-MODULE-ENTRY-REF DEST="BSW-MODULE-ENTRY">/EthTrcv_TI_AM263Px_C/EthTrcv_ModuleEntry/EthTrcv_SetTransceiverWakeupMode</BSW-MODULE-ENTRY-REF>
            </BSW-MODULE-ENTRY-REF-CONDITIONAL>
            <BSW-MODULE-ENTRY-REF-CONDITIONAL S="EthTrcv_GetTransceiverWakeupMode">
              <BSW-MODULE-ENTRY-REF DEST="BSW-MODULE-ENTRY">/EthTrcv_TI_AM263Px_C/EthTrcv_ModuleEntry/EthTrcv_GetTransceiverWakeupMode</BSW-MODULE-ENTRY-REF>
            </BSW-MODULE-ENTRY-REF-CONDITIONAL>
            <BSW-MODULE-ENTRY-REF-CONDITIONAL S="EthTrcv_CheckWakeup">
              <BSW-MODULE-ENTRY-REF DEST="BSW-MODULE-ENTRY">/EthTrcv_TI_AM263Px_C/EthTrcv_ModuleEntry/EthTrcv_CheckWakeup</BSW-MODULE-ENTRY-REF>
            </BSW-MODULE-ENTRY-REF-CONDITIONAL>
					  [!ENDIF!][!//
					  [!IF "$EthTrcvStartAutoNegotiationApi_Enable = 'true'"!][!//
            <BSW-MODULE-ENTRY-REF-CONDITIONAL S="EthTrcv_StartAutoNegotiation">
              <BSW-MODULE-ENTRY-REF DEST="BSW-MODULE-ENTRY">/EthTrcv_TI_AM263Px_C/EthTrcv_ModuleEntry/EthTrcv_StartAutoNegotiation</BSW-MODULE-ENTRY-REF>
            </BSW-MODULE-ENTRY-REF-CONDITIONAL>
					  [!ENDIF!][!//
					  [!IF "$EthTrcvGetLinkStateApi_Enable = 'true'"!][!//
            <BSW-MODULE-ENTRY-REF-CONDITIONAL S="EthTrcv_GetLinkState">
              <BSW-MODULE-ENTRY-REF DEST="BSW-MODULE-ENTRY">/EthTrcv_TI_AM263Px_C/EthTrcv_ModuleEntry/EthTrcv_GetLinkState</BSW-MODULE-ENTRY-REF>
            </BSW-MODULE-ENTRY-REF-CONDITIONAL>
					  [!ENDIF!][!//
					  [!IF "$EthTrcvGetBaudRateApi_Enable = 'true'"!][!//
            <BSW-MODULE-ENTRY-REF-CONDITIONAL S="EthTrcv_GetBaudRate">
              <BSW-MODULE-ENTRY-REF DEST="BSW-MODULE-ENTRY">/EthTrcv_TI_AM263Px_C/EthTrcv_ModuleEntry/EthTrcv_GetBaudRate</BSW-MODULE-ENTRY-REF>
            </BSW-MODULE-ENTRY-REF-CONDITIONAL>
					  [!ENDIF!][!//
					  [!IF "$EthTrcvGetDuplexModeApi_Enable = 'true'"!][!//
            <BSW-MODULE-ENTRY-REF-CONDITIONAL S="EthTrcv_GetDuplexMode">
              <BSW-MODULE-ENTRY-REF DEST="BSW-MODULE-ENTRY">/EthTrcv_TI_AM263Px_C/EthTrcv_ModuleEntry/EthTrcv_GetDuplexMode</BSW-MODULE-ENTRY-REF>
            </BSW-MODULE-ENTRY-REF-CONDITIONAL>
					  [!ENDIF!][!//
					  [!IF "$EthTrcvSetPhyTxModeApi_Enable = 'true'"!][!//
            <BSW-MODULE-ENTRY-REF-CONDITIONAL S="EthTrcv_SetPhyTxMode">
              <BSW-MODULE-ENTRY-REF DEST="BSW-MODULE-ENTRY">/EthTrcv_TI_AM263Px_C/EthTrcv_ModuleEntry/EthTrcv_SetPhyTxMode</BSW-MODULE-ENTRY-REF>
            </BSW-MODULE-ENTRY-REF-CONDITIONAL>
					  [!ENDIF!][!//
					  [!IF "$EthTrcvGetCableDiagnosticsResultApi_Enable = 'true'"!][!//
            <BSW-MODULE-ENTRY-REF-CONDITIONAL S="EthTrcv_GetCableDiagnosticsResult">
              <BSW-MODULE-ENTRY-REF DEST="BSW-MODULE-ENTRY">/EthTrcv_TI_AM263Px_C/EthTrcv_ModuleEntry/EthTrcv_GetCableDiagnosticsResult</BSW-MODULE-ENTRY-REF>
            </BSW-MODULE-ENTRY-REF-CONDITIONAL>
					  [!ENDIF!][!//
					  [!IF "$EthTrcvGetPhyIdentifierApi_Enable = 'true'"!][!//
            <BSW-MODULE-ENTRY-REF-CONDITIONAL S="EthTrcv_GetPhyIdentifier">
              <BSW-MODULE-ENTRY-REF DEST="BSW-MODULE-ENTRY">/EthTrcv_TI_AM263Px_C/EthTrcv_ModuleEntry/EthTrcv_GetPhyIdentifier</BSW-MODULE-ENTRY-REF>
            </BSW-MODULE-ENTRY-REF-CONDITIONAL>
					  [!ENDIF!][!//
					  [!IF "$EthTrcvSetPhyTestModeApi_Enable = 'true'"!][!//
            <BSW-MODULE-ENTRY-REF-CONDITIONAL S="EthTrcv_SetPhyTestMode">
              <BSW-MODULE-ENTRY-REF DEST="BSW-MODULE-ENTRY">/EthTrcv_TI_AM263Px_C/EthTrcv_ModuleEntry/EthTrcv_SetPhyTestMode</BSW-MODULE-ENTRY-REF>
            </BSW-MODULE-ENTRY-REF-CONDITIONAL>
					  [!ENDIF!][!//
					  [!IF "$EthTrcvGetPhySignalQualityApi_Enable = 'true'"!][!//
            <BSW-MODULE-ENTRY-REF-CONDITIONAL S="EthTrcv_GetPhySignalQuality">
              <BSW-MODULE-ENTRY-REF DEST="BSW-MODULE-ENTRY">/EthTrcv_TI_AM263Px_C/EthTrcv_ModuleEntry/EthTrcv_GetPhySignalQuality</BSW-MODULE-ENTRY-REF>
            </BSW-MODULE-ENTRY-REF-CONDITIONAL>
					  [!ENDIF!][!//
					  [!IF "$EthTrcv_SetPhyLoopbackMode_Enable = 'true'"!][!//
            <BSW-MODULE-ENTRY-REF-CONDITIONAL S="EthTrcv_SetPhyLoopbackMode">
              <BSW-MODULE-ENTRY-REF DEST="BSW-MODULE-ENTRY">/EthTrcv_TI_AM263Px_C/EthTrcv_ModuleEntry/EthTrcv_SetPhyLoopbackMode</BSW-MODULE-ENTRY-REF>
            </BSW-MODULE-ENTRY-REF-CONDITIONAL>
					  [!ENDIF!][!//
            <BSW-MODULE-ENTRY-REF-CONDITIONAL S="EthTrcv_ReadMiiIndication">
              <BSW-MODULE-ENTRY-REF DEST="BSW-MODULE-ENTRY">/EthTrcv_TI_AM263Px_C/EthTrcv_ModuleEntry/EthTrcv_ReadMiiIndication</BSW-MODULE-ENTRY-REF>
            </BSW-MODULE-ENTRY-REF-CONDITIONAL>
            <BSW-MODULE-ENTRY-REF-CONDITIONAL S="EthTrcv_WriteMiiIndication">
              <BSW-MODULE-ENTRY-REF DEST="BSW-MODULE-ENTRY">/EthTrcv_TI_AM263Px_C/EthTrcv_ModuleEntry/EthTrcv_WriteMiiIndication</BSW-MODULE-ENTRY-REF>
            </BSW-MODULE-ENTRY-REF-CONDITIONAL>
            <BSW-MODULE-ENTRY-REF-CONDITIONAL S="EthTrcv_MainFunction">
              <BSW-MODULE-ENTRY-REF DEST="BSW-MODULE-ENTRY">/EthTrcv_TI_AM263Px_C/EthTrcv_ModuleEntry/EthTrcv_MainFunction</BSW-MODULE-ENTRY-REF>
            </BSW-MODULE-ENTRY-REF-CONDITIONAL>
          </IMPLEMENTED-ENTRYS>
          <BSW-MODULE-DEPENDENCYS>
            <BSW-MODULE-DEPENDENCY UUID="ba362386-8811-42bf-af3a-84f738e7823c">
              <SHORT-NAME>Dem</SHORT-NAME>
              <TARGET-MODULE-ID>54</TARGET-MODULE-ID>
              <TARGET-MODULE-REFS>
              <BSW-MODULE-DESCRIPTION-REF-CONDITIONAL>
                <BSW-MODULE-DESCRIPTION-REF DEST="BSW-MODULE-DESCRIPTION">/AUTOSAR_Dem/Dem</BSW-MODULE-DESCRIPTION-REF>
              </BSW-MODULE-DESCRIPTION-REF-CONDITIONAL>
              </TARGET-MODULE-REFS>
            </BSW-MODULE-DEPENDENCY>
					  <BSW-MODULE-DEPENDENCY UUID="9d90c255-2a7a-4827-9933-fbbeed7687d4">
              <SHORT-NAME>Os</SHORT-NAME>
              <TARGET-MODULE-ID>01</TARGET-MODULE-ID>
              <TARGET-MODULE-REFS>
              <BSW-MODULE-DESCRIPTION-REF-CONDITIONAL>
                <BSW-MODULE-DESCRIPTION-REF DEST="BSW-MODULE-DESCRIPTION">/AUTOSAR_Os/Os</BSW-MODULE-DESCRIPTION-REF>
              </BSW-MODULE-DESCRIPTION-REF-CONDITIONAL>
              </TARGET-MODULE-REFS>
            </BSW-MODULE-DEPENDENCY>
            [!IF "$EthTrcvDevErrorDet_Enable = 'true'"!][!//
					  <BSW-MODULE-DEPENDENCY UUID="acd54aeb-f512-41f4-8c40-4a029d7f80bd">
              <SHORT-NAME>Det</SHORT-NAME>
              <TARGET-MODULE-ID>15</TARGET-MODULE-ID>
              <TARGET-MODULE-REFS>
              <BSW-MODULE-DESCRIPTION-REF-CONDITIONAL>
                <BSW-MODULE-DESCRIPTION-REF DEST="BSW-MODULE-DESCRIPTION">/AUTOSAR_Det/Det</BSW-MODULE-DESCRIPTION-REF>
              </BSW-MODULE-DESCRIPTION-REF-CONDITIONAL>
              </TARGET-MODULE-REFS>
            </BSW-MODULE-DEPENDENCY>
					  [!ENDIF!][!//
          </BSW-MODULE-DEPENDENCYS>
          <INTERNAL-BEHAVIORS>
            <BSW-INTERNAL-BEHAVIOR UUID="d07a7500-ef4b-4272-8a11-500457dc0e0e">
              <SHORT-NAME>EthTrcv_Behavior</SHORT-NAME>
              <EXCLUSIVE-AREAS>
                <EXCLUSIVE-AREA UUID="d6304a74-4d64-49a1-8a7a-ba7bef0dd5fb">
                  <SHORT-NAME>ETHTRCV_EXCLUSIVE_AREA_0</SHORT-NAME>
                </EXCLUSIVE-AREA>
              </EXCLUSIVE-AREAS>
              <ENTITYS>
                [!IF "$EthTrcvVersionInfoApi_Enable = 'true'"!][!//
						    <BSW-CALLED-ENTITY S="" UUID="c3dd3a8d-65a5-40ef-8f9d-d6e7ec365675">
                  <SHORT-NAME>EthTrcv_GetVersionInfo</SHORT-NAME>
                  <MINIMUM-START-INTERVAL>0.0</MINIMUM-START-INTERVAL>
                  <CALL-POINTS>
						        [!IF "$EthTrcvDevErrorDet_Enable = 'true'"!][!//
                    <BSW-DIRECT-CALL-POINT>
                      <SHORT-NAME>Det_ReportError</SHORT-NAME>
                      <CALLED-ENTRY-REF DEST="BSW-MODULE-ENTRY">/AUTOSAR_Det/BSWModuleEntry/Det_ReportError</CALLED-ENTRY-REF>
                    </BSW-DIRECT-CALL-POINT>
							      [!ENDIF!][!//
                  </CALL-POINTS>
                  <IMPLEMENTED-ENTRY-REF DEST="BSW-MODULE-ENTRY">/EthTrcv_TI_AM263Px_C/EthTrcv_ModuleEntry/EthTrcv_GetVersionInfo</IMPLEMENTED-ENTRY-REF>
                </BSW-CALLED-ENTITY>
						    [!ENDIF!][!//
                <BSW-CALLED-ENTITY UUID="a7193b24-ea11-4b36-bc3d-1cf90e4fcff6">
                  <SHORT-NAME>EthTrcv_Init</SHORT-NAME>
						      <CAN-ENTER-EXCLUSIVE-AREA-REFS>
                    <CAN-ENTER-EXCLUSIVE-AREA-REF DEST="EXCLUSIVE-AREA">/EthTrcv_TI_AM263Px_C/EthTrcv/EthTrcv_Behavior/ETHTRCV_EXCLUSIVE_AREA_0</CAN-ENTER-EXCLUSIVE-AREA-REF>
                  </CAN-ENTER-EXCLUSIVE-AREA-REFS>
                  <MINIMUM-START-INTERVAL>0.0</MINIMUM-START-INTERVAL>
                  <MINIMUM-START-INTERVAL>0.0</MINIMUM-START-INTERVAL>
                  <REENTRANCY-LEVEL>NON-REENTRANT</REENTRANCY-LEVEL>
                  <CALL-POINTS>
						        [!IF "$EthTrcvDevErrorDet_Enable = 'true'"!][!//
                    <BSW-DIRECT-CALL-POINT>
                      <SHORT-NAME>Det_ReportError</SHORT-NAME>
                      <CALLED-ENTRY-REF DEST="BSW-MODULE-ENTRY">/AUTOSAR_Det/BSWModuleEntry/Det_ReportError</CALLED-ENTRY-REF>
                    </BSW-DIRECT-CALL-POINT>
							      [!ENDIF!][!//
							      <BSW-DIRECT-CALL-POINT>
                      <SHORT-NAME>Dem_SetEventStatus</SHORT-NAME>
                      <CALLED-ENTRY-REF DEST="BSW-MODULE-ENTRY">/AUTOSAR_Dem/BSWModuleEntry/Dem_SetEventStatus</CALLED-ENTRY-REF>
                    </BSW-DIRECT-CALL-POINT>
                    <BSW-DIRECT-CALL-POINT>
                      <SHORT-NAME>GetCounterValue</SHORT-NAME>
                      <CALLED-ENTRY-REF DEST="BSW-MODULE-ENTRY">/AUTOSAR_Os/BSWModuleEntry/GetCounterValue</CALLED-ENTRY-REF>
                    </BSW-DIRECT-CALL-POINT>
                    <BSW-DIRECT-CALL-POINT>
                      <SHORT-NAME>GetElapsedValue</SHORT-NAME>
                      <CALLED-ENTRY-REF DEST="BSW-MODULE-ENTRY">/AUTOSAR_Os/BSWModuleEntry/GetElapsedValue</CALLED-ENTRY-REF>
                    </BSW-DIRECT-CALL-POINT>
                  </CALL-POINTS>
                  <IMPLEMENTED-ENTRY-REF DEST="BSW-MODULE-ENTRY">/EthTrcv_TI_AM263Px_C/EthTrcv_ModuleEntry/EthTrcv_Init</IMPLEMENTED-ENTRY-REF>
                </BSW-CALLED-ENTITY>
                [!IF "$EthTrcvSetTransceiverModeApi_Enable = 'true'"!][!//
                <BSW-CALLED-ENTITY UUID="533d0b22-fafa-47b1-8a54-75c3dd0b73dd">
                  <SHORT-NAME>EthTrcv_SetTransceiverMode</SHORT-NAME>
                  <CAN-ENTER-EXCLUSIVE-AREA-REFS>
                    <CAN-ENTER-EXCLUSIVE-AREA-REF DEST="EXCLUSIVE-AREA">/EthTrcv_TI_AM263Px_C/EthTrcv/EthTrcv_Behavior/ETHTRCV_EXCLUSIVE_AREA_0</CAN-ENTER-EXCLUSIVE-AREA-REF>
                  </CAN-ENTER-EXCLUSIVE-AREA-REFS>
                  <MINIMUM-START-INTERVAL>0.0</MINIMUM-START-INTERVAL>
                  <MINIMUM-START-INTERVAL>0.0</MINIMUM-START-INTERVAL>
                  <REENTRANCY-LEVEL>NON-REENTRANT</REENTRANCY-LEVEL>
                  <CALL-POINTS>
                    [!IF "$EthTrcvDevErrorDet_Enable = 'true'"!][!//
                    <BSW-DIRECT-CALL-POINT>
                      <SHORT-NAME>Det_ReportError</SHORT-NAME>
                      <CALLED-ENTRY-REF DEST="BSW-MODULE-ENTRY">/AUTOSAR_Det/BSWModuleEntry/Det_ReportError</CALLED-ENTRY-REF>
                    </BSW-DIRECT-CALL-POINT>
                    [!ENDIF!][!//
                    <BSW-DIRECT-CALL-POINT>
                      <SHORT-NAME>Dem_SetEventStatus</SHORT-NAME>
                      <CALLED-ENTRY-REF DEST="BSW-MODULE-ENTRY">/AUTOSAR_Dem/BSWModuleEntry/Dem_SetEventStatus</CALLED-ENTRY-REF>
                    </BSW-DIRECT-CALL-POINT>
                  </CALL-POINTS>
                  <IMPLEMENTED-ENTRY-REF DEST="BSW-MODULE-ENTRY">/EthTrcv_TI_AM263Px_C/EthTrcv_ModuleEntry/EthTrcv_SetTransceiverMode</IMPLEMENTED-ENTRY-REF>
                </BSW-CALLED-ENTITY>
						    [!ENDIF!][!//
                [!IF "$EthTrcvGetTransceiverModeApi_Enable = 'true'"!][!//
						    <BSW-CALLED-ENTITY UUID="6e5ecb3a-290c-4848-b07f-73b7f3037d03">
                  <SHORT-NAME>EthTrcv_GetTransceiverMode</SHORT-NAME>
                  <CAN-ENTER-EXCLUSIVE-AREA-REFS>
                    <CAN-ENTER-EXCLUSIVE-AREA-REF DEST="EXCLUSIVE-AREA">/EthTrcv_TI_AM263Px_C/EthTrcv/EthTrcv_Behavior/ETHTRCV_EXCLUSIVE_AREA_0</CAN-ENTER-EXCLUSIVE-AREA-REF>
                  </CAN-ENTER-EXCLUSIVE-AREA-REFS>
                  <MINIMUM-START-INTERVAL>0.0</MINIMUM-START-INTERVAL>
                  <MINIMUM-START-INTERVAL>0.0</MINIMUM-START-INTERVAL>
                  <REENTRANCY-LEVEL>NON-REENTRANT</REENTRANCY-LEVEL>
						      <CALL-POINTS>
						        [!IF "$EthTrcvDevErrorDet_Enable = 'true'"!][!//
                    <BSW-DIRECT-CALL-POINT>
                      <SHORT-NAME>Det_ReportError</SHORT-NAME>
                      <CALLED-ENTRY-REF DEST="BSW-MODULE-ENTRY">/AUTOSAR_Det/BSWModuleEntry/Det_ReportError</CALLED-ENTRY-REF>
                    </BSW-DIRECT-CALL-POINT>
							      [!ENDIF!][!//
                  </CALL-POINTS>
                  <IMPLEMENTED-ENTRY-REF DEST="BSW-MODULE-ENTRY">/EthTrcv_TI_AM263Px_C/EthTrcv_ModuleEntry/EthTrcv_GetTransceiverMode</IMPLEMENTED-ENTRY-REF>
                </BSW-CALLED-ENTITY>
						    [!ENDIF!][!//
						    [!IF "$EthTrcvWakeupSupportApi_Enable = 'true'"!][!//
                <BSW-CALLED-ENTITY UUID="a20fd54f-7133-4bfd-861d-9d6eaa4e297a">
                  <SHORT-NAME>EthTrcv_SetTransceiverWakeupMode</SHORT-NAME>
                  <CAN-ENTER-EXCLUSIVE-AREA-REFS>
                    <CAN-ENTER-EXCLUSIVE-AREA-REF DEST="EXCLUSIVE-AREA">/EthTrcv_TI_AM263Px_C/EthTrcv/EthTrcv_Behavior/ETHTRCV_EXCLUSIVE_AREA_0</CAN-ENTER-EXCLUSIVE-AREA-REF>
                  </CAN-ENTER-EXCLUSIVE-AREA-REFS>
                  <MINIMUM-START-INTERVAL>0.0</MINIMUM-START-INTERVAL>
                  <MINIMUM-START-INTERVAL>0.0</MINIMUM-START-INTERVAL>
                  <REENTRANCY-LEVEL>NON-REENTRANT</REENTRANCY-LEVEL>
                  <IMPLEMENTED-ENTRY-REF DEST="BSW-MODULE-ENTRY">/EthTrcv_TI_AM263Px_C/EthTrcv_ModuleEntry/EthTrcv_SetTransceiverWakeupMode</IMPLEMENTED-ENTRY-REF>
                </BSW-CALLED-ENTITY>
                <BSW-CALLED-ENTITY S="" UUID="7970d95e-4341-43c5-a90b-4094a5ee2237">
                  <SHORT-NAME>EthTrcv_GetTransceiverWakeupMode</SHORT-NAME>
                  <CAN-ENTER-EXCLUSIVE-AREA-REFS>
                    <CAN-ENTER-EXCLUSIVE-AREA-REF DEST="EXCLUSIVE-AREA">/EthTrcv_TI_AM263Px_C/EthTrcv/EthTrcv_Behavior/ETHTRCV_EXCLUSIVE_AREA_0</CAN-ENTER-EXCLUSIVE-AREA-REF>
                  </CAN-ENTER-EXCLUSIVE-AREA-REFS>
                  <MINIMUM-START-INTERVAL>0.0</MINIMUM-START-INTERVAL>
                  <MINIMUM-START-INTERVAL>0.0</MINIMUM-START-INTERVAL>
                  <REENTRANCY-LEVEL>NON-REENTRANT</REENTRANCY-LEVEL>
                  <IMPLEMENTED-ENTRY-REF DEST="BSW-MODULE-ENTRY">/EthTrcv_TI_AM263Px_C/EthTrcv_ModuleEntry/EthTrcv_GetTransceiverWakeupMode</IMPLEMENTED-ENTRY-REF>
                </BSW-CALLED-ENTITY>
                <BSW-CALLED-ENTITY S="" UUID="7de98693-e55f-4b89-9264-835382537ad3">
                  <SHORT-NAME>EthTrcv_CheckWakeup</SHORT-NAME>
                  <CAN-ENTER-EXCLUSIVE-AREA-REFS>
                    <CAN-ENTER-EXCLUSIVE-AREA-REF DEST="EXCLUSIVE-AREA">/EthTrcv_TI_AM263Px_C/EthTrcv/EthTrcv_Behavior/ETHTRCV_EXCLUSIVE_AREA_0</CAN-ENTER-EXCLUSIVE-AREA-REF>
                  </CAN-ENTER-EXCLUSIVE-AREA-REFS>
                  <MINIMUM-START-INTERVAL>0.0</MINIMUM-START-INTERVAL>
                  <IMPLEMENTED-ENTRY-REF DEST="BSW-MODULE-ENTRY">/EthTrcv_TI_AM263Px_C/EthTrcv_ModuleEntry/EthTrcv_CheckWakeup</IMPLEMENTED-ENTRY-REF>
                </BSW-CALLED-ENTITY>
						    [!ENDIF!][!//
                [!IF "$EthTrcvStartAutoNegotiationApi_Enable = 'true'"!][!//
						    <BSW-CALLED-ENTITY S="" UUID="8afa7b42-8471-4f55-b8e7-513847ad0ff6">
                  <SHORT-NAME>EthTrcv_StartAutoNegotiation</SHORT-NAME>
                  <CAN-ENTER-EXCLUSIVE-AREA-REFS>
                    <CAN-ENTER-EXCLUSIVE-AREA-REF DEST="EXCLUSIVE-AREA">/EthTrcv_TI_AM263Px_C/EthTrcv/EthTrcv_Behavior/ETHTRCV_EXCLUSIVE_AREA_0</CAN-ENTER-EXCLUSIVE-AREA-REF>
                  </CAN-ENTER-EXCLUSIVE-AREA-REFS>
                  <MINIMUM-START-INTERVAL>0.0</MINIMUM-START-INTERVAL>
                  <MINIMUM-START-INTERVAL>0.0</MINIMUM-START-INTERVAL>
                  <REENTRANCY-LEVEL>NON-REENTRANT</REENTRANCY-LEVEL>
						      <CALL-POINTS>
						        [!IF "$EthTrcvDevErrorDet_Enable = 'true'"!][!//
                    <BSW-DIRECT-CALL-POINT>
                      <SHORT-NAME>Det_ReportError</SHORT-NAME>
                      <CALLED-ENTRY-REF DEST="BSW-MODULE-ENTRY">/AUTOSAR_Det/BSWModuleEntry/Det_ReportError</CALLED-ENTRY-REF>
                    </BSW-DIRECT-CALL-POINT>
							      [!ENDIF!][!//
							      <BSW-DIRECT-CALL-POINT>
                      <SHORT-NAME>Dem_SetEventStatus</SHORT-NAME>
                      <CALLED-ENTRY-REF DEST="BSW-MODULE-ENTRY">/AUTOSAR_Dem/BSWModuleEntry/Dem_SetEventStatus</CALLED-ENTRY-REF>
                    </BSW-DIRECT-CALL-POINT>
                    <BSW-DIRECT-CALL-POINT>
                      <SHORT-NAME>GetCounterValue</SHORT-NAME>
                      <CALLED-ENTRY-REF DEST="BSW-MODULE-ENTRY">/AUTOSAR_Os/BSWModuleEntry/GetCounterValue</CALLED-ENTRY-REF>
                    </BSW-DIRECT-CALL-POINT>
                    <BSW-DIRECT-CALL-POINT>
                      <SHORT-NAME>GetElapsedValue</SHORT-NAME>
                      <CALLED-ENTRY-REF DEST="BSW-MODULE-ENTRY">/AUTOSAR_Os/BSWModuleEntry/GetElapsedValue</CALLED-ENTRY-REF>
                    </BSW-DIRECT-CALL-POINT>
                  </CALL-POINTS>
                  <IMPLEMENTED-ENTRY-REF DEST="BSW-MODULE-ENTRY">/EthTrcv_TI_AM263Px_C/EthTrcv_ModuleEntry/EthTrcv_StartAutoNegotiation</IMPLEMENTED-ENTRY-REF>
                </BSW-CALLED-ENTITY>
						    [!ENDIF!][!//
                [!IF "$EthTrcvGetLinkStateApi_Enable = 'true'"!][!//
						    <BSW-CALLED-ENTITY S="" UUID="e7c5376c-bafc-4ab0-b48f-e4da833603e6">
                  <SHORT-NAME>EthTrcv_GetLinkState</SHORT-NAME>
                  <CAN-ENTER-EXCLUSIVE-AREA-REFS>
                    <CAN-ENTER-EXCLUSIVE-AREA-REF DEST="EXCLUSIVE-AREA">/EthTrcv_TI_AM263Px_C/EthTrcv/EthTrcv_Behavior/ETHTRCV_EXCLUSIVE_AREA_0</CAN-ENTER-EXCLUSIVE-AREA-REF>
                  </CAN-ENTER-EXCLUSIVE-AREA-REFS>
                  <MINIMUM-START-INTERVAL>0.0</MINIMUM-START-INTERVAL>
                  <MINIMUM-START-INTERVAL>0.0</MINIMUM-START-INTERVAL>
                  <REENTRANCY-LEVEL>NON-REENTRANT</REENTRANCY-LEVEL>
						      <CALL-POINTS>
						        [!IF "$EthTrcvDevErrorDet_Enable = 'true'"!][!//
                    <BSW-DIRECT-CALL-POINT>
                      <SHORT-NAME>Det_ReportError</SHORT-NAME>
                      <CALLED-ENTRY-REF DEST="BSW-MODULE-ENTRY">/AUTOSAR_Det/BSWModuleEntry/Det_ReportError</CALLED-ENTRY-REF>
                    </BSW-DIRECT-CALL-POINT>
							      [!ENDIF!][!//
                    <BSW-DIRECT-CALL-POINT>
                      <SHORT-NAME>GetCounterValue</SHORT-NAME>
                      <CALLED-ENTRY-REF DEST="BSW-MODULE-ENTRY">/AUTOSAR_Os/BSWModuleEntry/GetCounterValue</CALLED-ENTRY-REF>
                    </BSW-DIRECT-CALL-POINT>
                    <BSW-DIRECT-CALL-POINT>
                      <SHORT-NAME>GetElapsedValue</SHORT-NAME>
                      <CALLED-ENTRY-REF DEST="BSW-MODULE-ENTRY">/AUTOSAR_Os/BSWModuleEntry/GetElapsedValue</CALLED-ENTRY-REF>
                    </BSW-DIRECT-CALL-POINT>
                  </CALL-POINTS>
                  <IMPLEMENTED-ENTRY-REF DEST="BSW-MODULE-ENTRY">/EthTrcv_TI_AM263Px_C/EthTrcv_ModuleEntry/EthTrcv_GetLinkState</IMPLEMENTED-ENTRY-REF>
                </BSW-CALLED-ENTITY>
						    [!ENDIF!][!//
                [!IF "$EthTrcvGetBaudRateApi_Enable = 'true'"!][!//
						    <BSW-CALLED-ENTITY S="" UUID="b012de52-c707-4687-bbad-d5fcc43c1262">
                  <SHORT-NAME>EthTrcv_GetBaudRate</SHORT-NAME>
                  <CAN-ENTER-EXCLUSIVE-AREA-REFS>
                    <CAN-ENTER-EXCLUSIVE-AREA-REF DEST="EXCLUSIVE-AREA">/EthTrcv_TI_AM263Px_C/EthTrcv/EthTrcv_Behavior/ETHTRCV_EXCLUSIVE_AREA_0</CAN-ENTER-EXCLUSIVE-AREA-REF>
                  </CAN-ENTER-EXCLUSIVE-AREA-REFS>
                  <MINIMUM-START-INTERVAL>0.0</MINIMUM-START-INTERVAL>
                  <MINIMUM-START-INTERVAL>0.0</MINIMUM-START-INTERVAL>
                  <REENTRANCY-LEVEL>NON-REENTRANT</REENTRANCY-LEVEL>
						      <CALL-POINTS>
						        [!IF "$EthTrcvDevErrorDet_Enable = 'true'"!][!//
                    <BSW-DIRECT-CALL-POINT>
                      <SHORT-NAME>Det_ReportError</SHORT-NAME>
                      <CALLED-ENTRY-REF DEST="BSW-MODULE-ENTRY">/AUTOSAR_Det/BSWModuleEntry/Det_ReportError</CALLED-ENTRY-REF>
                    </BSW-DIRECT-CALL-POINT>
							      [!ENDIF!][!//
							      <BSW-DIRECT-CALL-POINT>
                      <SHORT-NAME>Dem_SetEventStatus</SHORT-NAME>
                      <CALLED-ENTRY-REF DEST="BSW-MODULE-ENTRY">/AUTOSAR_Dem/BSWModuleEntry/Dem_SetEventStatus</CALLED-ENTRY-REF>
                    </BSW-DIRECT-CALL-POINT>
                  </CALL-POINTS>
                  <IMPLEMENTED-ENTRY-REF DEST="BSW-MODULE-ENTRY">/EthTrcv_TI_AM263Px_C/EthTrcv_ModuleEntry/EthTrcv_GetBaudRate</IMPLEMENTED-ENTRY-REF>
                </BSW-CALLED-ENTITY>
						    [!ENDIF!][!//
                [!IF "$EthTrcvGetDuplexModeApi_Enable = 'true'"!][!//
						    <BSW-CALLED-ENTITY S="" UUID="bab97778-3dbc-4c37-9241-4b89621aee7a">
                  <SHORT-NAME>EthTrcv_GetDuplexMode</SHORT-NAME>
                  <CAN-ENTER-EXCLUSIVE-AREA-REFS>
                    <CAN-ENTER-EXCLUSIVE-AREA-REF DEST="EXCLUSIVE-AREA">/EthTrcv_TI_AM263Px_C/EthTrcv/EthTrcv_Behavior/ETHTRCV_EXCLUSIVE_AREA_0</CAN-ENTER-EXCLUSIVE-AREA-REF>
                  </CAN-ENTER-EXCLUSIVE-AREA-REFS>
                  <MINIMUM-START-INTERVAL>0.0</MINIMUM-START-INTERVAL>
                  <MINIMUM-START-INTERVAL>0.0</MINIMUM-START-INTERVAL>
                  <REENTRANCY-LEVEL>NON-REENTRANT</REENTRANCY-LEVEL>
						      <CALL-POINTS>
						        [!IF "$EthTrcvDevErrorDet_Enable = 'true'"!][!//
                    <BSW-DIRECT-CALL-POINT>
                      <SHORT-NAME>Det_ReportError</SHORT-NAME>
                      <CALLED-ENTRY-REF DEST="BSW-MODULE-ENTRY">/AUTOSAR_Det/BSWModuleEntry/Det_ReportError</CALLED-ENTRY-REF>
                    </BSW-DIRECT-CALL-POINT>
							      [!ENDIF!][!//
							      <BSW-DIRECT-CALL-POINT>
                      <SHORT-NAME>Dem_SetEventStatus</SHORT-NAME>
                      <CALLED-ENTRY-REF DEST="BSW-MODULE-ENTRY">/AUTOSAR_Dem/BSWModuleEntry/Dem_SetEventStatus</CALLED-ENTRY-REF>
                    </BSW-DIRECT-CALL-POINT>
                  </CALL-POINTS>
                  <IMPLEMENTED-ENTRY-REF DEST="BSW-MODULE-ENTRY">/EthTrcv_TI_AM263Px_C/EthTrcv_ModuleEntry/EthTrcv_GetDuplexMode</IMPLEMENTED-ENTRY-REF>
                </BSW-CALLED-ENTITY>
						    [!ENDIF!][!//
						    [!IF "$EthTrcvSetPhyTxModeApi_Enable = 'true'"!][!//
						    <BSW-CALLED-ENTITY S="" UUID="bab97778-3dbc-4c37-9241-4b89621aea7a">
                  <SHORT-NAME>EthTrcv_SetPhyTxMode</SHORT-NAME>
                  <CAN-ENTER-EXCLUSIVE-AREA-REFS>
                    <CAN-ENTER-EXCLUSIVE-AREA-REF DEST="EXCLUSIVE-AREA">/EthTrcv_TI_AM263Px_C/EthTrcv/EthTrcv_Behavior/ETHTRCV_EXCLUSIVE_AREA_0</CAN-ENTER-EXCLUSIVE-AREA-REF>
                  </CAN-ENTER-EXCLUSIVE-AREA-REFS>
                  <MINIMUM-START-INTERVAL>0.0</MINIMUM-START-INTERVAL>
                  <MINIMUM-START-INTERVAL>0.0</MINIMUM-START-INTERVAL>
                  <REENTRANCY-LEVEL>NON-REENTRANT</REENTRANCY-LEVEL>
						      <CALL-POINTS>
						        [!IF "$EthTrcvDevErrorDet_Enable = 'true'"!][!//
                    <BSW-DIRECT-CALL-POINT>
                      <SHORT-NAME>Det_ReportError</SHORT-NAME>
                      <CALLED-ENTRY-REF DEST="BSW-MODULE-ENTRY">/AUTOSAR_Det/BSWModuleEntry/Det_ReportError</CALLED-ENTRY-REF>
                    </BSW-DIRECT-CALL-POINT>
							      [!ENDIF!][!//
							      <BSW-DIRECT-CALL-POINT>
                      <SHORT-NAME>Dem_SetEventStatus</SHORT-NAME>
                      <CALLED-ENTRY-REF DEST="BSW-MODULE-ENTRY">/AUTOSAR_Dem/BSWModuleEntry/Dem_SetEventStatus</CALLED-ENTRY-REF>
                    </BSW-DIRECT-CALL-POINT>
                  </CALL-POINTS>
                  <IMPLEMENTED-ENTRY-REF DEST="BSW-MODULE-ENTRY">/EthTrcv_TI_AM263Px_C/EthTrcv_ModuleEntry/EthTrcv_SetPhyTxMode</IMPLEMENTED-ENTRY-REF>
                </BSW-CALLED-ENTITY>
						    [!ENDIF!][!//
						    [!IF "$EthTrcvGetCableDiagnosticsResultApi_Enable = 'true'"!][!//
						    <BSW-CALLED-ENTITY S="" UUID="bab97778-3dbc-4c37-9241-4b89621aae7a">
                  <SHORT-NAME>EthTrcv_GetCableDiagnosticsResult</SHORT-NAME>
                  <CAN-ENTER-EXCLUSIVE-AREA-REFS>
                    <CAN-ENTER-EXCLUSIVE-AREA-REF DEST="EXCLUSIVE-AREA">/EthTrcv_TI_AM263Px_C/EthTrcv/EthTrcv_Behavior/ETHTRCV_EXCLUSIVE_AREA_0</CAN-ENTER-EXCLUSIVE-AREA-REF>
                  </CAN-ENTER-EXCLUSIVE-AREA-REFS>
                  <MINIMUM-START-INTERVAL>0.0</MINIMUM-START-INTERVAL>
                  <MINIMUM-START-INTERVAL>0.0</MINIMUM-START-INTERVAL>
                  <REENTRANCY-LEVEL>NON-REENTRANT</REENTRANCY-LEVEL>
						      <CALL-POINTS>
						        [!IF "$EthTrcvDevErrorDet_Enable = 'true'"!][!//
                    <BSW-DIRECT-CALL-POINT>
                      <SHORT-NAME>Det_ReportError</SHORT-NAME>
                      <CALLED-ENTRY-REF DEST="BSW-MODULE-ENTRY">/AUTOSAR_Det/BSWModuleEntry/Det_ReportError</CALLED-ENTRY-REF>
                    </BSW-DIRECT-CALL-POINT>
							      [!ENDIF!][!//
							      <BSW-DIRECT-CALL-POINT>
                      <SHORT-NAME>Dem_SetEventStatus</SHORT-NAME>
                      <CALLED-ENTRY-REF DEST="BSW-MODULE-ENTRY">/AUTOSAR_Dem/BSWModuleEntry/Dem_SetEventStatus</CALLED-ENTRY-REF>
                    </BSW-DIRECT-CALL-POINT>
                  </CALL-POINTS>
                  <IMPLEMENTED-ENTRY-REF DEST="BSW-MODULE-ENTRY">/EthTrcv_TI_AM263Px_C/EthTrcv_ModuleEntry/EthTrcv_GetCableDiagnosticsResult</IMPLEMENTED-ENTRY-REF>
                </BSW-CALLED-ENTITY>
						    [!ENDIF!][!//
						    [!IF "$EthTrcvGetPhyIdentifierApi_Enable = 'true'"!][!//
						    <BSW-CALLED-ENTITY S="" UUID="0e2c592c-e4bf-4e9e-889f-75da0f010fde">
                  <SHORT-NAME>EthTrcv_GetPhyIdentifier</SHORT-NAME>
                  <CAN-ENTER-EXCLUSIVE-AREA-REFS>
                    <CAN-ENTER-EXCLUSIVE-AREA-REF DEST="EXCLUSIVE-AREA">/EthTrcv_TI_AM263Px_C/EthTrcv/EthTrcv_Behavior/ETHTRCV_EXCLUSIVE_AREA_0</CAN-ENTER-EXCLUSIVE-AREA-REF>
                  </CAN-ENTER-EXCLUSIVE-AREA-REFS>
                  <MINIMUM-START-INTERVAL>0.0</MINIMUM-START-INTERVAL>
                  <MINIMUM-START-INTERVAL>0.0</MINIMUM-START-INTERVAL>
                  <REENTRANCY-LEVEL>NON-REENTRANT</REENTRANCY-LEVEL>
						      <CALL-POINTS>
						        [!IF "$EthTrcvDevErrorDet_Enable = 'true'"!][!//
                    <BSW-DIRECT-CALL-POINT>
                      <SHORT-NAME>Det_ReportError</SHORT-NAME>
                      <CALLED-ENTRY-REF DEST="BSW-MODULE-ENTRY">/AUTOSAR_Det/BSWModuleEntry/Det_ReportError</CALLED-ENTRY-REF>
                    </BSW-DIRECT-CALL-POINT>
							      [!ENDIF!][!//
                  </CALL-POINTS>
                  <IMPLEMENTED-ENTRY-REF DEST="BSW-MODULE-ENTRY">/EthTrcv_TI_AM263Px_C/EthTrcv_ModuleEntry/EthTrcv_GetPhyIdentifier</IMPLEMENTED-ENTRY-REF>
                </BSW-CALLED-ENTITY>
						    [!ENDIF!][!//
						    [!IF "$EthTrcvSetPhyTestModeApi_Enable = 'true'"!][!//
						    <BSW-CALLED-ENTITY S="" UUID="bab97778-3dbc-4c37-9241-4b89621aee7b">
                  <SHORT-NAME>EthTrcv_SetPhyTestMode</SHORT-NAME>
                  <CAN-ENTER-EXCLUSIVE-AREA-REFS>
                    <CAN-ENTER-EXCLUSIVE-AREA-REF DEST="EXCLUSIVE-AREA">/EthTrcv_TI_AM263Px_C/EthTrcv/EthTrcv_Behavior/ETHTRCV_EXCLUSIVE_AREA_0</CAN-ENTER-EXCLUSIVE-AREA-REF>
                  </CAN-ENTER-EXCLUSIVE-AREA-REFS>
                  <MINIMUM-START-INTERVAL>0.0</MINIMUM-START-INTERVAL>
                  <MINIMUM-START-INTERVAL>0.0</MINIMUM-START-INTERVAL>
                  <REENTRANCY-LEVEL>NON-REENTRANT</REENTRANCY-LEVEL>
						      <CALL-POINTS>
						        [!IF "$EthTrcvDevErrorDet_Enable = 'true'"!][!//
                    <BSW-DIRECT-CALL-POINT>
                      <SHORT-NAME>Det_ReportError</SHORT-NAME>
                      <CALLED-ENTRY-REF DEST="BSW-MODULE-ENTRY">/AUTOSAR_Det/BSWModuleEntry/Det_ReportError</CALLED-ENTRY-REF>
                    </BSW-DIRECT-CALL-POINT>
							      [!ENDIF!][!//
							      <BSW-DIRECT-CALL-POINT>
                      <SHORT-NAME>Dem_SetEventStatus</SHORT-NAME>
                      <CALLED-ENTRY-REF DEST="BSW-MODULE-ENTRY">/AUTOSAR_Dem/BSWModuleEntry/Dem_SetEventStatus</CALLED-ENTRY-REF>
                    </BSW-DIRECT-CALL-POINT>
                  </CALL-POINTS>
                  <IMPLEMENTED-ENTRY-REF DEST="BSW-MODULE-ENTRY">/EthTrcv_TI_AM263Px_C/EthTrcv_ModuleEntry/EthTrcv_SetPhyTestMode</IMPLEMENTED-ENTRY-REF>
                </BSW-CALLED-ENTITY>
						    [!ENDIF!][!//
						    [!IF "$EthTrcvGetTransceiverWakeupModeApi_Enable = 'true'"!][!//
						    <BSW-CALLED-ENTITY S="" UUID="bab97778-3dbc-4c37-9241-4b89621aee7c">
                  <SHORT-NAME>EthTrcv_GetTransceiverWakeupMode</SHORT-NAME>
                  <CAN-ENTER-EXCLUSIVE-AREA-REFS>
                    <CAN-ENTER-EXCLUSIVE-AREA-REF DEST="EXCLUSIVE-AREA">/EthTrcv_TI_AM263Px_C/EthTrcv/EthTrcv_Behavior/ETHTRCV_EXCLUSIVE_AREA_0</CAN-ENTER-EXCLUSIVE-AREA-REF>
                  </CAN-ENTER-EXCLUSIVE-AREA-REFS>
                  <MINIMUM-START-INTERVAL>0.0</MINIMUM-START-INTERVAL>
                  <MINIMUM-START-INTERVAL>0.0</MINIMUM-START-INTERVAL>
                  <REENTRANCY-LEVEL>NON-REENTRANT</REENTRANCY-LEVEL>
                  <IMPLEMENTED-ENTRY-REF DEST="BSW-MODULE-ENTRY">/EthTrcv_TI_AM263Px_C/EthTrcv_ModuleEntry/EthTrcv_GetTransceiverWakeupMode</IMPLEMENTED-ENTRY-REF>
                </BSW-CALLED-ENTITY>
						    [!ENDIF!][!//
						    [!IF "$EthTrcvGetPhySignalQualityApi_Enable = 'true'"!][!//
						    <BSW-CALLED-ENTITY S="" UUID="bab97778-3dbc-4c37-9241-4b89621aee7d">
                  <SHORT-NAME>EthTrcv_GetPhySignalQuality</SHORT-NAME>
                  <CAN-ENTER-EXCLUSIVE-AREA-REFS>
                    <CAN-ENTER-EXCLUSIVE-AREA-REF DEST="EXCLUSIVE-AREA">/EthTrcv_TI_AM263Px_C/EthTrcv/EthTrcv_Behavior/ETHTRCV_EXCLUSIVE_AREA_0</CAN-ENTER-EXCLUSIVE-AREA-REF>
                  </CAN-ENTER-EXCLUSIVE-AREA-REFS>
                  <MINIMUM-START-INTERVAL>0.0</MINIMUM-START-INTERVAL>
                  <MINIMUM-START-INTERVAL>0.0</MINIMUM-START-INTERVAL>
                  <REENTRANCY-LEVEL>NON-REENTRANT</REENTRANCY-LEVEL>
                  <IMPLEMENTED-ENTRY-REF DEST="BSW-MODULE-ENTRY">/EthTrcv_TI_AM263Px_C/EthTrcv_ModuleEntry/EthTrcv_GetPhySignalQuality</IMPLEMENTED-ENTRY-REF>
                </BSW-CALLED-ENTITY>
						    [!ENDIF!][!//
						    [!IF "$EthTrcv_SetPhyLoopbackMode_Enable = 'true'"!][!//
						    <BSW-CALLED-ENTITY S="" UUID="bab97778-3dbc-4c37-9241-4b89621aef7d">
                  <SHORT-NAME>EthTrcv_SetPhyLoopbackMode</SHORT-NAME>
                  <CAN-ENTER-EXCLUSIVE-AREA-REFS>
                    <CAN-ENTER-EXCLUSIVE-AREA-REF DEST="EXCLUSIVE-AREA">/EthTrcv_TI_AM263Px_C/EthTrcv/EthTrcv_Behavior/ETHTRCV_EXCLUSIVE_AREA_0</CAN-ENTER-EXCLUSIVE-AREA-REF>
                  </CAN-ENTER-EXCLUSIVE-AREA-REFS>
                  <MINIMUM-START-INTERVAL>0.0</MINIMUM-START-INTERVAL>
                  <MINIMUM-START-INTERVAL>0.0</MINIMUM-START-INTERVAL>
                  <REENTRANCY-LEVEL>NON-REENTRANT</REENTRANCY-LEVEL>
						      <CALL-POINTS>
						        [!IF "$EthTrcvDevErrorDet_Enable = 'true'"!][!//
                    <BSW-DIRECT-CALL-POINT>
                      <SHORT-NAME>Det_ReportError</SHORT-NAME>
                      <CALLED-ENTRY-REF DEST="BSW-MODULE-ENTRY">/AUTOSAR_Det/BSWModuleEntry/Det_ReportError</CALLED-ENTRY-REF>
                    </BSW-DIRECT-CALL-POINT>
							      [!ENDIF!][!//
							      <BSW-DIRECT-CALL-POINT>
                      <SHORT-NAME>Dem_SetEventStatus</SHORT-NAME>
                      <CALLED-ENTRY-REF DEST="BSW-MODULE-ENTRY">/AUTOSAR_Dem/BSWModuleEntry/Dem_SetEventStatus</CALLED-ENTRY-REF>
                    </BSW-DIRECT-CALL-POINT>
                  </CALL-POINTS>
                  <IMPLEMENTED-ENTRY-REF DEST="BSW-MODULE-ENTRY">/EthTrcv_TI_AM263Px_C/EthTrcv_ModuleEntry/EthTrcv_SetPhyLoopbackMode</IMPLEMENTED-ENTRY-REF>
                </BSW-CALLED-ENTITY>
						    [!ENDIF!][!//
                <BSW-CALLED-ENTITY S="" UUID="b5b3c09a-0b4e-43c1-8749-5dbf68cfb8e1">
                  <SHORT-NAME>EthTrcv_ReadMiiIndication</SHORT-NAME>
                  <MINIMUM-START-INTERVAL>0.0</MINIMUM-START-INTERVAL>
                  <MINIMUM-START-INTERVAL>0.0</MINIMUM-START-INTERVAL>
                  <REENTRANCY-LEVEL>NON-REENTRANT</REENTRANCY-LEVEL>
                  <IMPLEMENTED-ENTRY-REF DEST="BSW-MODULE-ENTRY">/EthTrcv_TI_AM263Px_C/EthTrcv_ModuleEntry/EthTrcv_ReadMiiIndication</IMPLEMENTED-ENTRY-REF>
                </BSW-CALLED-ENTITY>
                <BSW-CALLED-ENTITY S="" UUID="b146cc47-0bbe-4b4b-9a67-7e95306dbe1a">
                  <SHORT-NAME>EthTrcv_WriteMiiIndication</SHORT-NAME>
                  <MINIMUM-START-INTERVAL>0.0</MINIMUM-START-INTERVAL>
                  <MINIMUM-START-INTERVAL>0.0</MINIMUM-START-INTERVAL>
                  <REENTRANCY-LEVEL>NON-REENTRANT</REENTRANCY-LEVEL>
                  <IMPLEMENTED-ENTRY-REF DEST="BSW-MODULE-ENTRY">/EthTrcv_TI_AM263Px_C/EthTrcv_ModuleEntry/EthTrcv_WriteMiiIndication</IMPLEMENTED-ENTRY-REF>
                </BSW-CALLED-ENTITY>
                <BSW-SCHEDULABLE-ENTITY UUID="f9ab814d-e3f8-4525-ade3-e72d4dee3ea1">
                  <SHORT-NAME>EthTrcv_MainFunction</SHORT-NAME>
                  <CAN-ENTER-EXCLUSIVE-AREA-REFS>
                    <CAN-ENTER-EXCLUSIVE-AREA-REF DEST="EXCLUSIVE-AREA">/EthTrcv_TI_AM263Px_C/EthTrcv/EthTrcv_Behavior/ETHTRCV_EXCLUSIVE_AREA_0</CAN-ENTER-EXCLUSIVE-AREA-REF>
                  </CAN-ENTER-EXCLUSIVE-AREA-REFS>
                  <MINIMUM-START-INTERVAL>0.0</MINIMUM-START-INTERVAL>
                  <REENTRANCY-LEVEL>SINGLE-CORE-REENTRANT</REENTRANCY-LEVEL>
                  <CALL-POINTS>
                    [!IF "$EthTrcvDevErrorDet_Enable = 'true'"!][!//
                    <BSW-DIRECT-CALL-POINT>
                      <SHORT-NAME>Det_ReportError</SHORT-NAME>
                      <CALLED-ENTRY-REF DEST="BSW-MODULE-ENTRY">/AUTOSAR_Det/BSWModuleEntry/Det_ReportError</CALLED-ENTRY-REF>
                    </BSW-DIRECT-CALL-POINT>
                    [!ENDIF!][!//
                    <BSW-DIRECT-CALL-POINT>
                      <SHORT-NAME>EthIf_TrcvModeIndication</SHORT-NAME>
                      <CALLED-ENTRY-REF DEST="BSW-MODULE-ENTRY">/AUTOSAR/EthIf/BswModuleEntries/EthIf_TrcvModeIndication</CALLED-ENTRY-REF>
                    </BSW-DIRECT-CALL-POINT>
                    <BSW-DIRECT-CALL-POINT>
                      <SHORT-NAME>Dem_SetEventStatus</SHORT-NAME>
                      <CALLED-ENTRY-REF DEST="BSW-MODULE-ENTRY">/AUTOSAR_Dem/BSWModuleEntry/Dem_SetEventStatus</CALLED-ENTRY-REF>
                    </BSW-DIRECT-CALL-POINT>
                  </CALL-POINTS>
                  <IMPLEMENTED-ENTRY-REF DEST="BSW-MODULE-ENTRY">/EthTrcv_TI_AM263Px_C/EthTrcv_ModuleEntry/EthTrcv_MainFunction</IMPLEMENTED-ENTRY-REF>
                </BSW-SCHEDULABLE-ENTITY>
              </ENTITYS>
              <EVENTS>
                <BSW-TIMING-EVENT S="" UUID="2bd5a28d-6688-409f-991a-6485d0b02d3d">
                  <SHORT-NAME>EthTrcvTimingEvent_MainFunction</SHORT-NAME>
                  <STARTS-ON-EVENT-REF DEST="BSW-SCHEDULABLE-ENTITY">/EthTrcv_TI_AM263Px_C/EthTrcv/EthTrcv_Behavior/EthTrcv_MainFunction</STARTS-ON-EVENT-REF>
                  <PERIOD>0.005</PERIOD>
						    </BSW-TIMING-EVENT>
              </EVENTS>
            </BSW-INTERNAL-BEHAVIOR>
          </INTERNAL-BEHAVIORS>
        </BSW-MODULE-DESCRIPTION>
        <BSW-IMPLEMENTATION UUID="8e3e2f85-086f-4b55-848c-2e4e40548977">
          <SHORT-NAME>EthTrcv_Impl</SHORT-NAME>
          <CODE-DESCRIPTORS>
            <CODE UUID="7ea2b1f0-3462-43c9-a301-fee87b76b8d8">
              <SHORT-NAME>Files</SHORT-NAME>
              <ARTIFACT-DESCRIPTORS>
                <AUTOSAR-ENGINEERING-OBJECT S="">
                  <SHORT-LABEL>include::EthTrcv_Cfg.h</SHORT-LABEL>
                  <CATEGORY>SWHDR</CATEGORY>
                </AUTOSAR-ENGINEERING-OBJECT>
                <AUTOSAR-ENGINEERING-OBJECT S="">
                  <SHORT-LABEL>src::EthTrcv_Cfg.c</SHORT-LABEL>
                  <CATEGORY>SWSRC</CATEGORY>
                </AUTOSAR-ENGINEERING-OBJECT>
                <AUTOSAR-ENGINEERING-OBJECT S="">
                  <SHORT-LABEL>src::EthTrcv_Lcfg.c</SHORT-LABEL>
                  <CATEGORY>SWSRC</CATEGORY>
                </AUTOSAR-ENGINEERING-OBJECT>
                <AUTOSAR-ENGINEERING-OBJECT S="">
                  <SHORT-LABEL>src::EthTrcv_PBcfg.c</SHORT-LABEL>
                  <CATEGORY>SWSRC</CATEGORY>
                </AUTOSAR-ENGINEERING-OBJECT>
                <AUTOSAR-ENGINEERING-OBJECT S="">
                  <SHORT-LABEL>include::EthTrcv_Types.h</SHORT-LABEL>
                  <CATEGORY>SWHDR</CATEGORY>
                </AUTOSAR-ENGINEERING-OBJECT>
                <AUTOSAR-ENGINEERING-OBJECT S="">
                  <SHORT-LABEL>src::EthTrcv.c</SHORT-LABEL>
                  <CATEGORY>SWSRC</CATEGORY>
                </AUTOSAR-ENGINEERING-OBJECT>
                <AUTOSAR-ENGINEERING-OBJECT S="">
                  <SHORT-LABEL>include::EthTrcv.h</SHORT-LABEL>
                  <CATEGORY>SWHDR</CATEGORY>
                </AUTOSAR-ENGINEERING-OBJECT>
                <AUTOSAR-ENGINEERING-OBJECT S="">
                  <SHORT-LABEL>V0::EthTrcv_Priv.c</SHORT-LABEL>
                  <CATEGORY>SWSRC</CATEGORY>
                </AUTOSAR-ENGINEERING-OBJECT>
                <AUTOSAR-ENGINEERING-OBJECT S="">
                  <SHORT-LABEL>V0::EthTrcv_Priv.h</SHORT-LABEL>
                  <CATEGORY>SWHDR</CATEGORY>
                </AUTOSAR-ENGINEERING-OBJECT>
              </ARTIFACT-DESCRIPTORS>
            </CODE>
          </CODE-DESCRIPTORS>
          <COMPILERS>
            <COMPILER UUID="79188202-3524-4599-b148-6d858dd00156">
              <SHORT-NAME>tiarmclang</SHORT-NAME>
              <NAME>TI ARM Clang Compiler</NAME>
              <VENDOR>Texas Instruments</VENDOR>
              <VERSION>4.0.0</VERSION>
            </COMPILER>
          </COMPILERS>
          <LINKERS>
            <LINKER UUID="d94be72d-b17f-4a61-9f86-110b94c93535">
              <SHORT-NAME>tiarmlnk</SHORT-NAME>
              <NAME>TI ARM Linker</NAME>
              <VENDOR>Texas Instruments</VENDOR>
              <VERSION>4.0.0</VERSION>
            </LINKER>
          </LINKERS>
          <PROGRAMMING-LANGUAGE>C</PROGRAMMING-LANGUAGE>
          <RESOURCE-CONSUMPTION UUID="6f1dbdd6-b7ea-45e7-a6e6-4d0fa3711dc8">
            <SHORT-NAME>ResourceConsumption</SHORT-NAME>
            <MEMORY-SECTIONS>
              <MEMORY-SECTION UUID="cb66b918-441e-4c47-a1f9-9f7bb21f8967">
                <SHORT-NAME>ETHTRCV_CODE</SHORT-NAME>
                <SW-ADDRMETHOD-REF DEST="SW-ADDR-METHOD">/AUTOSAR_MemMap/SwAddrMethods/CODE</SW-ADDRMETHOD-REF>
                <SYMBOL>CODE</SYMBOL>
              </MEMORY-SECTION>
              <MEMORY-SECTION UUID="d6340197-47ab-4d3e-9b41-3835b828d6b9">
                <SHORT-NAME>ETHTRCV_CONFIG_DATA</SHORT-NAME>
                <ALIGNMENT>UNSPECIFIED</ALIGNMENT>
                <SW-ADDRMETHOD-REF DEST="SW-ADDR-METHOD">/AUTOSAR_MemMap/SwAddrMethods/CONFIG_DATA</SW-ADDRMETHOD-REF>
                <SYMBOL>CONFIG_DATA</SYMBOL>
              </MEMORY-SECTION>
              <MEMORY-SECTION UUID="26bca45e-c74e-4b8e-882c-bf09cedb8461">
                <SHORT-NAME>ETHTRCV_VAR_INIT_32</SHORT-NAME>
                <ALIGNMENT>32</ALIGNMENT>
                <SW-ADDRMETHOD-REF DEST="SW-ADDR-METHOD">/AUTOSAR_MemMap/SwAddrMethods/VAR_INIT</SW-ADDRMETHOD-REF>
                <SYMBOL>VAR_INIT_32</SYMBOL>
              </MEMORY-SECTION>
              <MEMORY-SECTION UUID="2593112d-6999-4d57-9d4c-59a3d9df963b">
                <SHORT-NAME>ETHTRCV_VAR_INIT_UNSPECIFIED</SHORT-NAME>
                <ALIGNMENT>UNSPECIFIED</ALIGNMENT>
                <SW-ADDRMETHOD-REF DEST="SW-ADDR-METHOD">/AUTOSAR_MemMap/SwAddrMethods/VAR_INIT</SW-ADDRMETHOD-REF>
                <SYMBOL>VAR_INIT_UNSPECIFIED</SYMBOL>
              </MEMORY-SECTION>
              <MEMORY-SECTION UUID="72273e8c-0696-44f6-869d-45d8d84d7e1a">
                <SHORT-NAME>ETHTRCV_VAR_NO_INIT_16</SHORT-NAME>
                <ALIGNMENT>16</ALIGNMENT>
                <SW-ADDRMETHOD-REF DEST="SW-ADDR-METHOD">/AUTOSAR_MemMap/SwAddrMethods/VAR_NO_INIT</SW-ADDRMETHOD-REF>
                <SYMBOL>VAR_NO_INIT_16</SYMBOL>
              </MEMORY-SECTION>
              <MEMORY-SECTION UUID="fde8c2ab-0357-4668-bb34-b172d5b061fb">
                <SHORT-NAME>ETHTRCV_VAR_NO_INIT_UNSPECIFIED</SHORT-NAME>
                <ALIGNMENT>UNSPECIFIED</ALIGNMENT>
                <SW-ADDRMETHOD-REF DEST="SW-ADDR-METHOD">/AUTOSAR_MemMap/SwAddrMethods/VAR_NO_INIT</SW-ADDRMETHOD-REF>
                <SYMBOL>VAR_NO_INIT_UNSPECIFIED</SYMBOL>
              </MEMORY-SECTION>
            </MEMORY-SECTIONS>
          </RESOURCE-CONSUMPTION>
          <SW-VERSION>10.01.00</SW-VERSION>
          <VENDOR-ID>44</VENDOR-ID>
          <AR-RELEASE-VERSION>4.3.1</AR-RELEASE-VERSION>
          <BEHAVIOR-REF DEST="BSW-INTERNAL-BEHAVIOR">/EthTrcv_TI_AM263Px_C/EthTrcv/EthTrcv_Behavior</BEHAVIOR-REF>
          <VENDOR-SPECIFIC-MODULE-DEF-REFS>
            <VENDOR-SPECIFIC-MODULE-DEF-REF DEST="ECUC-MODULE-DEF">/TI_AM263Px_C/EthTrcv</VENDOR-SPECIFIC-MODULE-DEF-REF>
          </VENDOR-SPECIFIC-MODULE-DEF-REFS>
        </BSW-IMPLEMENTATION>
      </ELEMENTS>
      <AR-PACKAGES>
        <AR-PACKAGE UUID="34201f14-5c65-476e-bee9-9b450f3bd05a">
          <SHORT-NAME>EthTrcv_ModuleEntry</SHORT-NAME>
          <ELEMENTS>
            <BSW-MODULE-ENTRY UUID="ad79a94a-7177-4a2e-b5c7-b4bd3097eabb">
              <SHORT-NAME>EthTrcv_GetVersionInfo</SHORT-NAME>
              <SHORT-NAME-PATTERN />
              <SERVICE-ID>0x0b</SERVICE-ID>
              <IS-REENTRANT>true</IS-REENTRANT>
              <IS-SYNCHRONOUS>true</IS-SYNCHRONOUS>
              <CALL-TYPE>REGULAR</CALL-TYPE>
              <EXECUTION-CONTEXT>UNSPECIFIED</EXECUTION-CONTEXT>
              <SW-SERVICE-IMPL-POLICY>STANDARD</SW-SERVICE-IMPL-POLICY>
              <BSW-ENTRY-KIND>CONCRETE</BSW-ENTRY-KIND>
            </BSW-MODULE-ENTRY>
            <BSW-MODULE-ENTRY S="" UUID="470e44d8-1f5c-4083-9e3d-fb9383e90b5f">
              <SHORT-NAME>EthTrcv_Init</SHORT-NAME>
              <SERVICE-ID>0x01</SERVICE-ID>
              <IS-REENTRANT>false</IS-REENTRANT>
              <IS-SYNCHRONOUS>true</IS-SYNCHRONOUS>
              <CALL-TYPE>REGULAR</CALL-TYPE>
              <EXECUTION-CONTEXT>UNSPECIFIED</EXECUTION-CONTEXT>
              <SW-SERVICE-IMPL-POLICY>STANDARD</SW-SERVICE-IMPL-POLICY>
              <BSW-ENTRY-KIND>CONCRETE</BSW-ENTRY-KIND>
            </BSW-MODULE-ENTRY>
            <BSW-MODULE-ENTRY UUID="938093b2-af3d-4325-bedd-f6bc511fc034">
              <SHORT-NAME>EthTrcv_SetTransceiverMode</SHORT-NAME>
              <SHORT-NAME-PATTERN />
              <SERVICE-ID>0x03</SERVICE-ID>
              <IS-REENTRANT>false</IS-REENTRANT>
              <IS-SYNCHRONOUS>false</IS-SYNCHRONOUS>
              <CALL-TYPE>REGULAR</CALL-TYPE>
              <EXECUTION-CONTEXT>UNSPECIFIED</EXECUTION-CONTEXT>
              <SW-SERVICE-IMPL-POLICY>STANDARD</SW-SERVICE-IMPL-POLICY>
              <BSW-ENTRY-KIND>CONCRETE</BSW-ENTRY-KIND>
            </BSW-MODULE-ENTRY>
            <BSW-MODULE-ENTRY UUID="f013a1c8-24c4-4d70-9dee-711050f524ea">
              <SHORT-NAME>EthTrcv_GetTransceiverMode</SHORT-NAME>
              <SHORT-NAME-PATTERN />
              <SERVICE-ID>0x04</SERVICE-ID>
              <IS-REENTRANT>false</IS-REENTRANT>
              <IS-SYNCHRONOUS>true</IS-SYNCHRONOUS>
              <CALL-TYPE>REGULAR</CALL-TYPE>
              <EXECUTION-CONTEXT>UNSPECIFIED</EXECUTION-CONTEXT>
              <SW-SERVICE-IMPL-POLICY>STANDARD</SW-SERVICE-IMPL-POLICY>
              <BSW-ENTRY-KIND>CONCRETE</BSW-ENTRY-KIND>
            </BSW-MODULE-ENTRY>
            <BSW-MODULE-ENTRY UUID="f50ecbed-f41f-4545-8efd-e8ada7ed69cd">
              <SHORT-NAME>EthTrcv_SetTransceiverWakeupMode</SHORT-NAME>
              <SHORT-NAME-PATTERN />
              <SERVICE-ID>0x0d</SERVICE-ID>
              <IS-REENTRANT>false</IS-REENTRANT>
              <IS-SYNCHRONOUS>true</IS-SYNCHRONOUS>
              <CALL-TYPE>REGULAR</CALL-TYPE>
              <EXECUTION-CONTEXT>UNSPECIFIED</EXECUTION-CONTEXT>
              <SW-SERVICE-IMPL-POLICY>STANDARD</SW-SERVICE-IMPL-POLICY>
              <BSW-ENTRY-KIND>CONCRETE</BSW-ENTRY-KIND>
            </BSW-MODULE-ENTRY>
            <BSW-MODULE-ENTRY UUID="a3ce0673-9222-4515-90d0-0e18f6e3fb73">
              <SHORT-NAME>EthTrcv_GetTransceiverWakeupMode</SHORT-NAME>
              <SHORT-NAME-PATTERN />
              <SERVICE-ID>0x0e</SERVICE-ID>
              <IS-REENTRANT>false</IS-REENTRANT>
              <IS-SYNCHRONOUS>true</IS-SYNCHRONOUS>
              <CALL-TYPE>REGULAR</CALL-TYPE>
              <EXECUTION-CONTEXT>UNSPECIFIED</EXECUTION-CONTEXT>
              <SW-SERVICE-IMPL-POLICY>STANDARD</SW-SERVICE-IMPL-POLICY>
              <BSW-ENTRY-KIND>CONCRETE</BSW-ENTRY-KIND>
            </BSW-MODULE-ENTRY>
            <BSW-MODULE-ENTRY UUID="99d8a836-8226-44f1-b76b-0f31f41b0510">
              <SHORT-NAME>EthTrcv_CheckWakeup</SHORT-NAME>
              <SHORT-NAME-PATTERN />
              <SERVICE-ID>0x0f</SERVICE-ID>
              <IS-REENTRANT>true</IS-REENTRANT>
              <IS-SYNCHRONOUS>true</IS-SYNCHRONOUS>
              <CALL-TYPE>REGULAR</CALL-TYPE>
              <EXECUTION-CONTEXT>UNSPECIFIED</EXECUTION-CONTEXT>
              <SW-SERVICE-IMPL-POLICY>STANDARD</SW-SERVICE-IMPL-POLICY>
              <BSW-ENTRY-KIND>CONCRETE</BSW-ENTRY-KIND>
            </BSW-MODULE-ENTRY>
            <BSW-MODULE-ENTRY UUID="af19ff3a-a8c4-41e1-a9f4-2f26292e04a1">
              <SHORT-NAME>EthTrcv_StartAutoNegotiation</SHORT-NAME>
              <SHORT-NAME-PATTERN />
              <SERVICE-ID>0x05</SERVICE-ID>
              <IS-REENTRANT>false</IS-REENTRANT>
              <IS-SYNCHRONOUS>true</IS-SYNCHRONOUS>
              <CALL-TYPE>REGULAR</CALL-TYPE>
              <EXECUTION-CONTEXT>UNSPECIFIED</EXECUTION-CONTEXT>
              <SW-SERVICE-IMPL-POLICY>STANDARD</SW-SERVICE-IMPL-POLICY>
              <BSW-ENTRY-KIND>CONCRETE</BSW-ENTRY-KIND>
            </BSW-MODULE-ENTRY>
            <BSW-MODULE-ENTRY UUID="a8132ffd-61f0-4063-9b8e-1f9359d24c4c">
              <SHORT-NAME>EthTrcv_GetLinkState</SHORT-NAME>
              <SHORT-NAME-PATTERN />
              <SERVICE-ID>0x06</SERVICE-ID>
              <IS-REENTRANT>false</IS-REENTRANT>
              <IS-SYNCHRONOUS>true</IS-SYNCHRONOUS>
              <CALL-TYPE>REGULAR</CALL-TYPE>
              <EXECUTION-CONTEXT>UNSPECIFIED</EXECUTION-CONTEXT>
              <SW-SERVICE-IMPL-POLICY>STANDARD</SW-SERVICE-IMPL-POLICY>
              <BSW-ENTRY-KIND>CONCRETE</BSW-ENTRY-KIND>
            </BSW-MODULE-ENTRY>
            <BSW-MODULE-ENTRY UUID="2c6e1bcc-a23e-4f5f-b0cf-97ce4f7ab5f0">
              <SHORT-NAME>EthTrcv_GetBaudRate</SHORT-NAME>
              <SHORT-NAME-PATTERN />
              <SERVICE-ID>0x07</SERVICE-ID>
              <IS-REENTRANT>false</IS-REENTRANT>
              <IS-SYNCHRONOUS>true</IS-SYNCHRONOUS>
              <CALL-TYPE>REGULAR</CALL-TYPE>
              <EXECUTION-CONTEXT>UNSPECIFIED</EXECUTION-CONTEXT>
              <SW-SERVICE-IMPL-POLICY>STANDARD</SW-SERVICE-IMPL-POLICY>
              <BSW-ENTRY-KIND>CONCRETE</BSW-ENTRY-KIND>
            </BSW-MODULE-ENTRY>
            <BSW-MODULE-ENTRY UUID="bb21fd3b-ffab-4197-b8a3-4402368629de">
              <SHORT-NAME>EthTrcv_GetDuplexMode</SHORT-NAME>
              <SHORT-NAME-PATTERN />
              <SERVICE-ID>0x08</SERVICE-ID>
              <IS-REENTRANT>false</IS-REENTRANT>
              <IS-SYNCHRONOUS>true</IS-SYNCHRONOUS>
              <CALL-TYPE>REGULAR</CALL-TYPE>
              <EXECUTION-CONTEXT>UNSPECIFIED</EXECUTION-CONTEXT>
              <SW-SERVICE-IMPL-POLICY>STANDARD</SW-SERVICE-IMPL-POLICY>
              <BSW-ENTRY-KIND>CONCRETE</BSW-ENTRY-KIND>
            </BSW-MODULE-ENTRY>
            <BSW-MODULE-ENTRY UUID="63f081b7-461e-45dd-a831-e6affc3d5d5d">
              <SHORT-NAME>EthTrcv_SetPhyTestMode</SHORT-NAME>
              <SHORT-NAME-PATTERN />
              <SERVICE-ID>0x11</SERVICE-ID>
              <IS-REENTRANT>false</IS-REENTRANT>
              <IS-SYNCHRONOUS>true</IS-SYNCHRONOUS>
              <CALL-TYPE>REGULAR</CALL-TYPE>
              <EXECUTION-CONTEXT>UNSPECIFIED</EXECUTION-CONTEXT>
              <SW-SERVICE-IMPL-POLICY>STANDARD</SW-SERVICE-IMPL-POLICY>
              <BSW-ENTRY-KIND>CONCRETE</BSW-ENTRY-KIND>
            </BSW-MODULE-ENTRY>
            <BSW-MODULE-ENTRY UUID="8b12d3cf-8035-4084-899e-c5baf67453b6">
              <SHORT-NAME>EthTrcv_SetPhyLoopbackMode</SHORT-NAME>
              <SHORT-NAME-PATTERN />
              <SERVICE-ID>0x12</SERVICE-ID>
              <IS-REENTRANT>false</IS-REENTRANT>
              <IS-SYNCHRONOUS>true</IS-SYNCHRONOUS>
              <CALL-TYPE>REGULAR</CALL-TYPE>
              <EXECUTION-CONTEXT>UNSPECIFIED</EXECUTION-CONTEXT>
              <SW-SERVICE-IMPL-POLICY>STANDARD</SW-SERVICE-IMPL-POLICY>
              <BSW-ENTRY-KIND>CONCRETE</BSW-ENTRY-KIND>
            </BSW-MODULE-ENTRY>
            <BSW-MODULE-ENTRY UUID="7f300eaa-4ff6-4809-a212-aa1d9495d243">
              <SHORT-NAME>EthTrcv_GetPhySignalQuality</SHORT-NAME>
              <SHORT-NAME-PATTERN />
              <SERVICE-ID>0x10</SERVICE-ID>
              <IS-REENTRANT>false</IS-REENTRANT>
              <IS-SYNCHRONOUS>true</IS-SYNCHRONOUS>
              <CALL-TYPE>REGULAR</CALL-TYPE>
              <EXECUTION-CONTEXT>UNSPECIFIED</EXECUTION-CONTEXT>
              <SW-SERVICE-IMPL-POLICY>STANDARD</SW-SERVICE-IMPL-POLICY>
              <BSW-ENTRY-KIND>CONCRETE</BSW-ENTRY-KIND>
            </BSW-MODULE-ENTRY>
            <BSW-MODULE-ENTRY UUID="ce0bd13e-d859-46f0-8b38-e4f9e345c675">
              <SHORT-NAME>EthTrcv_SetPhyTxMode</SHORT-NAME>
              <SHORT-NAME-PATTERN />
              <SERVICE-ID>0x13</SERVICE-ID>
              <IS-REENTRANT>false</IS-REENTRANT>
              <IS-SYNCHRONOUS>true</IS-SYNCHRONOUS>
              <CALL-TYPE>REGULAR</CALL-TYPE>
              <EXECUTION-CONTEXT>UNSPECIFIED</EXECUTION-CONTEXT>
              <SW-SERVICE-IMPL-POLICY>STANDARD</SW-SERVICE-IMPL-POLICY>
              <BSW-ENTRY-KIND>CONCRETE</BSW-ENTRY-KIND>
            </BSW-MODULE-ENTRY>
            <BSW-MODULE-ENTRY UUID="498acc17-c44e-4adb-9f64-3c672982dd13">
              <SHORT-NAME>EthTrcv_GetCableDiagnosticsResult</SHORT-NAME>
              <SHORT-NAME-PATTERN />
              <SERVICE-ID>0x14</SERVICE-ID>
              <IS-REENTRANT>false</IS-REENTRANT>
              <IS-SYNCHRONOUS>true</IS-SYNCHRONOUS>
              <CALL-TYPE>REGULAR</CALL-TYPE>
              <EXECUTION-CONTEXT>UNSPECIFIED</EXECUTION-CONTEXT>
              <SW-SERVICE-IMPL-POLICY>STANDARD</SW-SERVICE-IMPL-POLICY>
              <BSW-ENTRY-KIND>CONCRETE</BSW-ENTRY-KIND>
            </BSW-MODULE-ENTRY>
            <BSW-MODULE-ENTRY UUID="928a2c6c-9ec3-4984-9776-b790e2601f7f">
              <SHORT-NAME>EthTrcv_GetPhyIdentifier</SHORT-NAME>
              <SHORT-NAME-PATTERN />
              <SERVICE-ID>0x15</SERVICE-ID>
              <IS-REENTRANT>false</IS-REENTRANT>
              <IS-SYNCHRONOUS>true</IS-SYNCHRONOUS>
              <CALL-TYPE>REGULAR</CALL-TYPE>
              <EXECUTION-CONTEXT>UNSPECIFIED</EXECUTION-CONTEXT>
              <SW-SERVICE-IMPL-POLICY>STANDARD</SW-SERVICE-IMPL-POLICY>
              <BSW-ENTRY-KIND>CONCRETE</BSW-ENTRY-KIND>
            </BSW-MODULE-ENTRY>
            <BSW-MODULE-ENTRY UUID="104b5864-d478-44f7-95aa-f256385123b9">
              <SHORT-NAME>EthTrcv_ReadMiiIndication</SHORT-NAME>
              <SHORT-NAME-PATTERN />
              <SERVICE-ID>0x09</SERVICE-ID>
              <IS-REENTRANT>false</IS-REENTRANT>
              <IS-SYNCHRONOUS>true</IS-SYNCHRONOUS>
              <CALL-TYPE>REGULAR</CALL-TYPE>
              <EXECUTION-CONTEXT>UNSPECIFIED</EXECUTION-CONTEXT>
              <SW-SERVICE-IMPL-POLICY>STANDARD</SW-SERVICE-IMPL-POLICY>
              <BSW-ENTRY-KIND>CONCRETE</BSW-ENTRY-KIND>
            </BSW-MODULE-ENTRY>
            <BSW-MODULE-ENTRY UUID="d994adb1-f319-4bc2-a190-bdb44dbeb32c">
              <SHORT-NAME>EthTrcv_WriteMiiIndication</SHORT-NAME>
              <SHORT-NAME-PATTERN />
              <SERVICE-ID>0x0a</SERVICE-ID>
              <IS-REENTRANT>false</IS-REENTRANT>
              <IS-SYNCHRONOUS>true</IS-SYNCHRONOUS>
              <CALL-TYPE>REGULAR</CALL-TYPE>
              <EXECUTION-CONTEXT>UNSPECIFIED</EXECUTION-CONTEXT>
              <SW-SERVICE-IMPL-POLICY>STANDARD</SW-SERVICE-IMPL-POLICY>
              <BSW-ENTRY-KIND>CONCRETE</BSW-ENTRY-KIND>
            </BSW-MODULE-ENTRY>
            <BSW-MODULE-ENTRY UUID="be2cff7e-fe3a-4081-b294-a73994ff9ece">
              <SHORT-NAME>EthTrcv_MainFunction</SHORT-NAME>
              <SHORT-NAME-PATTERN />
              <SERVICE-ID>0x0c</SERVICE-ID>
              <IS-REENTRANT>false</IS-REENTRANT>
              <IS-SYNCHRONOUS>true</IS-SYNCHRONOUS>
              <CALL-TYPE>SCHEDULED</CALL-TYPE>
              <EXECUTION-CONTEXT>TASK</EXECUTION-CONTEXT>
              <SW-SERVICE-IMPL-POLICY>STANDARD</SW-SERVICE-IMPL-POLICY>
              <BSW-ENTRY-KIND>CONCRETE</BSW-ENTRY-KIND>
            </BSW-MODULE-ENTRY>
          </ELEMENTS>
        </AR-PACKAGE>
      </AR-PACKAGES>
    </AR-PACKAGE>
  </AR-PACKAGES>
[!ENDSELECT!]
</AUTOSAR>
