<?xml version="1.0" encoding="UTF-8"?>
<AUTOSAR xmlns="http://autosar.org/schema/r4.0" xmlns:xsi="http://www.w3.org/2001/XMLSchema-instance" xsi:schemaLocation="http://autosar.org/schema/r4.0 AUTOSAR_00044.xsd">
[!SELECT "as:modconf('EthTrcv')[1]"!]
[!AUTOSPACING!][!//
[!VAR "EthTrcvVersionInfoApi_Enable"="EthTrcvGeneral/EthTrcvVersionInfoApi = 'true'"!][!//
[!VAR "EthTrcvDevErrorDet_Enable"="EthTrcvGeneral/EthTrcvDevErrorDetect = 'true'"!][!//
[!VAR "EthTrcvWakeupSupportApi_Enable"="EthTrcvGeneral/EthTrcvWakeUpSupport != 'ETHTRCV_WAKEUP_NOT_SUPPORTED'"!][!//
[!VAR "EthTrcvSetTransceiverModeApi_Enable"="EthTrcvGeneral/EthTrcvSetTransceiverModeApi = 'true'"!][!//
[!VAR "EthTrcvGetTransceiverModeApi_Enable"="EthTrcvGeneral/EthTrcvGetTransceiverModeApi = 'true'"!][!//
[!VAR "EthTrcvStartAutoNegotiationApi_Enable"="EthTrcvGeneral/EthTrcvStartAutoNegotiationApi = 'true'"!][!//
[!VAR "EthTrcvGetLinkStateApi_Enable"="EthTrcvGeneral/EthTrcvGetLinkStateApi = 'true'"!][!//
[!VAR "EthTrcvGetBaudRateApi_Enable"="EthTrcvGeneral/EthTrcvGetBaudRateApi = 'true'"!][!//
[!VAR "EthTrcvGetDuplexModeApi_Enable"="EthTrcvGeneral/EthTrcvGetDuplexModeApi = 'true'"!][!//
[!VAR "EthTrcvSetPhyTxModeApi_Enable"="EthTrcvGeneral/EthTrcvSetPhyTxModeApi = 'true'"!][!//
[!VAR "EthTrcvGetCableDiagnosticsResultApi_Enable"="EthTrcvGeneral/EthTrcvGetCableDiagnosticsResultApi = 'true'"!][!//
[!VAR "EthTrcvGetPhyIdentifierApi_Enable"="EthTrcvGeneral/EthTrcvGetPhyIdentifierApi = 'true'"!][!//
[!VAR "EthTrcvSetPhyTestModeApi_Enable"="EthTrcvGeneral/EthTrcvSetPhyTestModeApi = 'true'"!][!//
[!VAR "EthTrcvGetTransceiverWakeupModeApi_Enable"="EthTrcvGeneral/EthTrcvGetTransceiverWakeupModeApi = 'true'"!][!//
[!VAR "EthTrcvGetPhySignalQualityApi_Enable"="EthTrcvGeneral/EthTrcvGetPhySignalQualityApi = 'true'"!][!//
[!VAR "EthTrcv_SetPhyLoopbackMode_Enable"="EthTrcvConfigSet/EthTrcvConfig/*[1]/EthTrcvEnableLoopback = 'true'"!][!//
  <AR-PACKAGES>
    <AR-PACKAGE UUID="b5bc9c4f-ed35-4b54-a9bb-3c073a235685">
      <SHORT-NAME>EthTrcv_TI_AM263Px_C</SHORT-NAME>
      <ELEMENTS>
        <BSW-MODULE-DESCRIPTION UUID="c57c13db-3a0a-4389-a05c-5fab2daa9d9f">
          <SHORT-NAME>EthTrcv</SHORT-NAME>
          <IMPLEMENTED-ENTRYS>
				    [!IF "$EthTrcvVersionInfoApi_Enable = 'true'"!][!//
            <BSW-MODULE-ENTRY-REF-CONDITIONAL S="EthTrcv_GetVersionInfo">
              <BSW-MODULE-ENTRY-REF DEST="BSW-MODULE-ENTRY">/EthTrcv_TI_AM263Px_C/EthTrcv_ModuleEntry/EthTrcv_GetVersionInfo</BSW-MODULE-ENTRY-REF>
            </BSW-MODULE-ENTRY-REF-CONDITIONAL>
					  [!ENDIF!][!//
            <BSW-MODULE-ENTRY-REF-CONDITIONAL S="EthTrcv_Init">
              <BSW-MODULE-ENTRY-REF DEST="BSW-MODULE-ENTRY">/EthTrcv_TI_AM263Px_C/EthTrcv_ModuleEntry/EthTrcv_Init</BSW-MODULE-ENTRY-REF>
            </BSW-MODULE-ENTRY-REF-CONDITIONAL>
            [!IF "$EthTrcvSetTransceiverModeApi_Enable = 'true'"!][!//
					  <BSW-MODULE-ENTRY-REF-CONDITIONAL S="EthTrcv_SetTransceiverMode">
              <BSW-MODULE-ENTRY-REF DEST="BSW-MODULE-ENTRY">/EthTrcv_TI_AM263Px_C/EthTrcv_ModuleEntry/EthTrcv_SetTransceiverMode</BSW-MODULE-ENTRY-REF>
            </BSW-MODULE-ENTRY-REF-CONDITIONAL>
					  [!ENDIF!][!//
            [!IF "$EthTrcvGetTransceiverModeApi_Enable = 'true'"!][!//
					  <BSW-MODULE-ENTRY-REF-CONDITIONAL S="EthTrcv_GetTransceiverMode">
              <BSW-MODULE-ENTRY-REF DEST="BSW-MODULE-ENTRY">/EthTrcv_TI_AM263Px_C/EthTrcv_ModuleEntry/EthTrcv_GetTransceiverMode</BSW-MODULE-ENTRY-REF>
            </BSW-MODULE-ENTRY-REF-CONDITIONAL>
					  [!ENDIF!][!//
            [!IF "$EthTrcvWakeupSupportApi_Enable = 'true'"!][!//
					  <BSW-MODULE-ENTRY-REF-CONDITIONAL S="EthTrcv_SetTransceiverWakeupMode">
              <BSW-MODULE-ENTRY-REF DEST="BSW-MODULE-ENTRY">/EthTrcv_TI_AM263Px_C/EthTrcv_ModuleEntry/EthTrcv_SetTransceiverWakeupMode</BSW-MODULE-ENTRY-REF>
            </BSW-MODULE-ENTRY-REF-CONDITIONAL>
            <BSW-MODULE-ENTRY-REF-CONDITIONAL S="EthTrcv_GetTransceiverWakeupMode">
              <BSW-MODULE-ENTRY-REF DEST="BSW-MODULE-ENTRY">/EthTrcv_TI_AM263Px_C/EthTrcv_ModuleEntry/EthTrcv_GetTransceiverWakeupMode</BSW-MODULE-ENTRY-REF>
            </BSW-MODULE-ENTRY-REF-CONDITIONAL>
            <BSW-MODULE-ENTRY-REF-CONDITIONAL S="EthTrcv_CheckWakeup">
              <BSW-MODULE-ENTRY-REF DEST="BSW-MODULE-ENTRY">/EthTrcv_TI_AM263Px_C/EthTrcv_ModuleEntry/EthTrcv_CheckWakeup</BSW-MODULE-ENTRY-REF>
            </BSW-MODULE-ENTRY-REF-CONDITIONAL>
					  [!ENDIF!][!//
					  [!IF "$EthTrcvStartAutoNegotiationApi_Enable = 'true'"!][!//
            <BSW-MODULE-ENTRY-REF-CONDITIONAL S="EthTrcv_StartAutoNegotiation">
              <BSW-MODULE-ENTRY-REF DEST="BSW-MODULE-ENTRY">/EthTrcv_TI_AM263Px_C/EthTrcv_ModuleEntry/EthTrcv_StartAutoNegotiation</BSW-MODULE-ENTRY-REF>
            </BSW-MODULE-ENTRY-REF-CONDITIONAL>
					  [!ENDIF!][!//
					  [!IF "$EthTrcvGetLinkStateApi_Enable = 'true'"!][!//
            <BSW-MODULE-ENTRY-REF-CONDITIONAL S="EthTrcv_GetLinkState">
              <BSW-MODULE-ENTRY-REF DEST="BSW-MODULE-ENTRY">/EthTrcv_TI_AM263Px_C/EthTrcv_ModuleEntry/EthTrcv_GetLinkState</BSW-MODULE-ENTRY-REF>
            </BSW-MODULE-ENTRY-REF-CONDITIONAL>
					  [!ENDIF!][!//
					  [!IF "$EthTrcvGetBaudRateApi_Enable = 'true'"!][!//
            <BSW-MODULE-ENTRY-REF-CONDITIONAL S="EthTrcv_GetBaudRate">
              <BSW-MODULE-ENTRY-REF DEST="BSW-MODULE-ENTRY">/EthTrcv_TI_AM263Px_C/EthTrcv_ModuleEntry/EthTrcv_GetBaudRate</BSW-MODULE-ENTRY-REF>
            </BSW-MODULE-ENTRY-REF-CONDITIONAL>
					  [!ENDIF!][!//
					  [!IF "$EthTrcvGetDuplexModeApi_Enable = 'true'"!][!//
            <BSW-MODULE-ENTRY-REF-CONDITIONAL S="EthTrcv_GetDuplexMode">
              <BSW-MODULE-ENTRY-REF DEST="BSW-MODULE-ENTRY">/EthTrcv_TI_AM263Px_C/EthTrcv_ModuleEntry/EthTrcv_GetDuplexMode</BSW-MODULE-ENTRY-REF>
            </BSW-MODULE-ENTRY-REF-CONDITIONAL>
					  [!ENDIF!][!//
					  [!IF "$EthTrcvSetPhyTxModeApi_Enable = 'true'"!][!//
            <BSW-MODULE-ENTRY-REF-CONDITIONAL S="EthTrcv_SetPhyTxMode">
              <BSW-MODULE-ENTRY-REF DEST="BSW-MODULE-ENTRY">/EthTrcv_TI_AM263Px_C/EthTrcv_ModuleEntry/EthTrcv_SetPhyTxMode</BSW-MODULE-ENTRY-REF>
            </BSW-MODULE-ENTRY-REF-CONDITIONAL>
					  [!ENDIF!][!//
					  [!IF "$EthTrcvGetCableDiagnosticsResultApi_Enable = 'true'"!][!//
            <BSW-MODULE-ENTRY-REF-CONDITIONAL S="EthTrcv_GetCableDiagnosticsResult">
              <BSW-MODULE-ENTRY-REF DEST="BSW-MODULE-ENTRY">/EthTrcv_TI_AM263Px_C/EthTrcv_ModuleEntry/EthTrcv_GetCableDiagnosticsResult</BSW-MODULE-ENTRY-REF>
            </BSW-MODULE-ENTRY-REF-CONDITIONAL>
					  [!ENDIF!][!//
					  [!IF "$EthTrcvGetPhyIdentifierApi_Enable = 'true'"!][!//
            <BSW-MODULE-ENTRY-REF-CONDITIONAL S="EthTrcv_GetPhyIdentifier">
              <BSW-MODULE-ENTRY-REF DEST="BSW-MODULE-ENTRY">/EthTrcv_TI_AM263Px_C/EthTrcv_ModuleEntry/EthTrcv_GetPhyIdentifier</BSW-MODULE-ENTRY-REF>
            </BSW-MODULE-ENTRY-REF-CONDITIONAL>
					  [!ENDIF!][!//
					  [!IF "$EthTrcvSetPhyTestModeApi_Enable = 'true'"!][!//
            <BSW-MODULE-ENTRY-REF-CONDITIONAL S="EthTrcv_SetPhyTestMode">
              <BSW-MODULE-ENTRY-REF DEST="BSW-MODULE-ENTRY">/EthTrcv_TI_AM263Px_C/EthTrcv_ModuleEntry/EthTrcv_SetPhyTestMode</BSW-MODULE-ENTRY-REF>
            </BSW-MODULE-ENTRY-REF-CONDITIONAL>
					  [!ENDIF!][!//
					  [!IF "$EthTrcvGetPhySignalQualityApi_Enable = 'true'"!][!//
            <BSW-MODULE-ENTRY-REF-CONDITIONAL S="EthTrcv_GetPhySignalQuality">
              <BSW-MODULE-ENTRY-REF DEST="BSW-MODULE-ENTRY">/EthTrcv_TI_AM263Px_C/EthTrcv_ModuleEntry/EthTrcv_GetPhySignalQuality</BSW-MODULE-ENTRY-REF>
            </BSW-MODULE-ENTRY-REF-CONDITIONAL>
					  [!ENDIF!][!//
					  [!IF "$EthTrcv_SetPhyLoopbackMode_Enable = 'true'"!][!//
            <BSW-MODULE-ENTRY-REF-CONDITIONAL S="EthTrcv_SetPhyLoopbackMode">
              <BSW-MODULE-ENTRY-REF DEST="BSW-MODULE-ENTRY">/EthTrcv_TI_AM263Px_C/EthTrcv_ModuleEntry/EthTrcv_SetPhyLoopbackMode</BSW-MODULE-ENTRY-REF>
            </BSW-MODULE-ENTRY-REF-CONDITIONAL>
					  [!ENDIF!][!//
            <BSW-MODULE-ENTRY-REF-CONDITIONAL S="EthTrcv_ReadMiiIndication">
              <BSW-MODULE-ENTRY-REF DEST="BSW-MODULE-ENTRY">/EthTrcv_TI_AM263Px_C/EthTrcv_ModuleEntry/EthTrcv_ReadMiiIndication</BSW-MODULE-ENTRY-REF>
            </BSW-MODULE-ENTRY-REF-CONDITIONAL>
            <BSW-MODULE-ENTRY-REF-CONDITIONAL S="EthTrcv_WriteMiiIndication">
              <BSW-MODULE-ENTRY-REF DEST="BSW-MODULE-ENTRY">/EthTrcv_TI_AM263Px_C/EthTrcv_ModuleEntry/EthTrcv_WriteMiiIndication</BSW-MODULE-ENTRY-REF>
            </BSW-MODULE-ENTRY-REF-CONDITIONAL>
            <BSW-MODULE-ENTRY-REF-CONDITIONAL S="EthTrcv_MainFunction">
              <BSW-MODULE-ENTRY-REF DEST="BSW-MODULE-ENTRY">/EthTrcv_TI_AM263Px_C/EthTrcv_ModuleEntry/EthTrcv_MainFunction</BSW-MODULE-ENTRY-REF>
            </BSW-MODULE-ENTRY-REF-CONDITIONAL>
          </IMPLEMENTED-ENTRYS>
          <MODULE-ID>73</MODULE-ID>
          <BSW-MODULE-DEPENDENCYS>
            <BSW-MODULE-DEPENDENCY UUID="c455d691-9858-400a-ae36-c86e840a80c6">
              <SHORT-NAME>Dem</SHORT-NAME>
              <TARGET-MODULE-ID>54</TARGET-MODULE-ID>
              <TARGET-MODULE-REFS>
              <BSW-MODULE-DESCRIPTION-REF-CONDITIONAL>
                <BSW-MODULE-DESCRIPTION-REF DEST="BSW-MODULE-DESCRIPTION">/AUTOSAR_Dem/Dem</BSW-MODULE-DESCRIPTION-REF>
              </BSW-MODULE-DESCRIPTION-REF-CONDITIONAL>
              </TARGET-MODULE-REFS>
            </BSW-MODULE-DEPENDENCY>
					  <BSW-MODULE-DEPENDENCY UUID="1f7209d3-f1ed-49e2-9389-aa4f4440db17">
              <SHORT-NAME>Os</SHORT-NAME>
              <TARGET-MODULE-ID>01</TARGET-MODULE-ID>
              <TARGET-MODULE-REFS>
              <BSW-MODULE-DESCRIPTION-REF-CONDITIONAL>
                <BSW-MODULE-DESCRIPTION-REF DEST="BSW-MODULE-DESCRIPTION">/AUTOSAR_Os/Os</BSW-MODULE-DESCRIPTION-REF>
              </BSW-MODULE-DESCRIPTION-REF-CONDITIONAL>
              </TARGET-MODULE-REFS>
            </BSW-MODULE-DEPENDENCY>
            [!IF "$EthTrcvDevErrorDet_Enable = 'true'"!][!//
					  <BSW-MODULE-DEPENDENCY UUID="4307f84b-09d0-41e0-895d-110e8bea1591">
              <SHORT-NAME>Det</SHORT-NAME>
              <TARGET-MODULE-ID>15</TARGET-MODULE-ID>
              <TARGET-MODULE-REFS>
              <BSW-MODULE-DESCRIPTION-REF-CONDITIONAL>
                <BSW-MODULE-DESCRIPTION-REF DEST="BSW-MODULE-DESCRIPTION">/AUTOSAR_Det/Det</BSW-MODULE-DESCRIPTION-REF>
              </BSW-MODULE-DESCRIPTION-REF-CONDITIONAL>
              </TARGET-MODULE-REFS>
            </BSW-MODULE-DEPENDENCY>
					  [!ENDIF!][!//
          </BSW-MODULE-DEPENDENCYS>
          <INTERNAL-BEHAVIORS>
            <BSW-INTERNAL-BEHAVIOR UUID="ffc9c887-a4ba-404f-bd15-8423881d4050">
              <SHORT-NAME>EthTrcv_Behavior</SHORT-NAME>
              <EXCLUSIVE-AREAS>
                <EXCLUSIVE-AREA UUID="99b9aae2-2d95-4810-a233-cc7dab992689">
                  <SHORT-NAME>ETHTRCV_EXCLUSIVE_AREA_0</SHORT-NAME>
                </EXCLUSIVE-AREA>
              </EXCLUSIVE-AREAS>
              <ENTITYS>
                [!IF "$EthTrcvVersionInfoApi_Enable = 'true'"!][!//
						    <BSW-CALLED-ENTITY S="" UUID="a7764b4d-824c-45bf-91dc-46698507e46b">
                  <SHORT-NAME>EthTrcv_GetVersionInfo</SHORT-NAME>
                  <MINIMUM-START-INTERVAL>0.0</MINIMUM-START-INTERVAL>
                  <CALL-POINTS>
						        [!IF "$EthTrcvDevErrorDet_Enable = 'true'"!][!//
                    <BSW-DIRECT-CALL-POINT>
                      <SHORT-NAME>Det_ReportError</SHORT-NAME>
                      <CALLED-ENTRY-REF DEST="BSW-MODULE-ENTRY">/AUTOSAR_Det/BSWModuleEntry/Det_ReportError</CALLED-ENTRY-REF>
                    </BSW-DIRECT-CALL-POINT>
							      [!ENDIF!][!//
                  </CALL-POINTS>
                  <IMPLEMENTED-ENTRY-REF DEST="BSW-MODULE-ENTRY">/EthTrcv_TI_AM263Px_C/EthTrcv_ModuleEntry/EthTrcv_GetVersionInfo</IMPLEMENTED-ENTRY-REF>
                </BSW-CALLED-ENTITY>
						    [!ENDIF!][!//
                <BSW-CALLED-ENTITY UUID="4b9eab47-2798-4b6d-ab3c-7ba4b4c1428e">
                  <SHORT-NAME>EthTrcv_Init</SHORT-NAME>
						      <CAN-ENTER-EXCLUSIVE-AREA-REFS>
                    <CAN-ENTER-EXCLUSIVE-AREA-REF DEST="EXCLUSIVE-AREA">/EthTrcv_TI_AM263Px_C/EthTrcv/EthTrcv_Behavior/ETHTRCV_EXCLUSIVE_AREA_0</CAN-ENTER-EXCLUSIVE-AREA-REF>
                  </CAN-ENTER-EXCLUSIVE-AREA-REFS>
                  <MINIMUM-START-INTERVAL>0.0</MINIMUM-START-INTERVAL>
                  <REENTRANCY-LEVEL>NON-REENTRANT</REENTRANCY-LEVEL>
                  <CALL-POINTS>
						        [!IF "$EthTrcvDevErrorDet_Enable = 'true'"!][!//
                    <BSW-DIRECT-CALL-POINT>
                      <SHORT-NAME>Det_ReportError</SHORT-NAME>
                      <CALLED-ENTRY-REF DEST="BSW-MODULE-ENTRY">/AUTOSAR_Det/BSWModuleEntry/Det_ReportError</CALLED-ENTRY-REF>
                    </BSW-DIRECT-CALL-POINT>
							      [!ENDIF!][!//
							      <BSW-DIRECT-CALL-POINT>
                      <SHORT-NAME>Dem_SetEventStatus</SHORT-NAME>
                      <CALLED-ENTRY-REF DEST="BSW-MODULE-ENTRY">/AUTOSAR_Dem/BSWModuleEntry/Dem_SetEventStatus</CALLED-ENTRY-REF>
                    </BSW-DIRECT-CALL-POINT>
                    <BSW-DIRECT-CALL-POINT>
                      <SHORT-NAME>GetCounterValue</SHORT-NAME>
                      <CALLED-ENTRY-REF DEST="BSW-MODULE-ENTRY">/AUTOSAR_Os/BSWModuleEntry/GetCounterValue</CALLED-ENTRY-REF>
                    </BSW-DIRECT-CALL-POINT>
                    <BSW-DIRECT-CALL-POINT>
                      <SHORT-NAME>GetElapsedValue</SHORT-NAME>
                      <CALLED-ENTRY-REF DEST="BSW-MODULE-ENTRY">/AUTOSAR_Os/BSWModuleEntry/GetElapsedValue</CALLED-ENTRY-REF>
                    </BSW-DIRECT-CALL-POINT>
                  </CALL-POINTS>
                  <IMPLEMENTED-ENTRY-REF DEST="BSW-MODULE-ENTRY">/EthTrcv_TI_AM263Px_C/EthTrcv_ModuleEntry/EthTrcv_Init</IMPLEMENTED-ENTRY-REF>
                </BSW-CALLED-ENTITY>
                [!IF "$EthTrcvSetTransceiverModeApi_Enable = 'true'"!][!//
                <BSW-CALLED-ENTITY UUID="6e012fce-4f39-470f-9b3f-3b888e74951e">
                  <SHORT-NAME>EthTrcv_SetTransceiverMode</SHORT-NAME>
                  <CAN-ENTER-EXCLUSIVE-AREA-REFS>
                    <CAN-ENTER-EXCLUSIVE-AREA-REF DEST="EXCLUSIVE-AREA">/EthTrcv_TI_AM263Px_C/EthTrcv/EthTrcv_Behavior/ETHTRCV_EXCLUSIVE_AREA_0</CAN-ENTER-EXCLUSIVE-AREA-REF>
                  </CAN-ENTER-EXCLUSIVE-AREA-REFS>
                  <MINIMUM-START-INTERVAL>0.0</MINIMUM-START-INTERVAL>
                  <REENTRANCY-LEVEL>NON-REENTRANT</REENTRANCY-LEVEL>
                  <CALL-POINTS>
                    [!IF "$EthTrcvDevErrorDet_Enable = 'true'"!][!//
                    <BSW-DIRECT-CALL-POINT>
                      <SHORT-NAME>Det_ReportError</SHORT-NAME>
                      <CALLED-ENTRY-REF DEST="BSW-MODULE-ENTRY">/AUTOSAR_Det/BSWModuleEntry/Det_ReportError</CALLED-ENTRY-REF>
                    </BSW-DIRECT-CALL-POINT>
                    [!ENDIF!][!//
                    <BSW-DIRECT-CALL-POINT>
                      <SHORT-NAME>Dem_SetEventStatus</SHORT-NAME>
                      <CALLED-ENTRY-REF DEST="BSW-MODULE-ENTRY">/AUTOSAR_Dem/BSWModuleEntry/Dem_SetEventStatus</CALLED-ENTRY-REF>
                    </BSW-DIRECT-CALL-POINT>
                  </CALL-POINTS>
                  <IMPLEMENTED-ENTRY-REF DEST="BSW-MODULE-ENTRY">/EthTrcv_TI_AM263Px_C/EthTrcv_ModuleEntry/EthTrcv_SetTransceiverMode</IMPLEMENTED-ENTRY-REF>
                </BSW-CALLED-ENTITY>
						    [!ENDIF!][!//
                [!IF "$EthTrcvGetTransceiverModeApi_Enable = 'true'"!][!//
						    <BSW-CALLED-ENTITY UUID="b1382c5b-95fb-421c-803a-956c92e7c52f">
                  <SHORT-NAME>EthTrcv_GetTransceiverMode</SHORT-NAME>
                  <CAN-ENTER-EXCLUSIVE-AREA-REFS>
                    <CAN-ENTER-EXCLUSIVE-AREA-REF DEST="EXCLUSIVE-AREA">/EthTrcv_TI_AM263Px_C/EthTrcv/EthTrcv_Behavior/ETHTRCV_EXCLUSIVE_AREA_0</CAN-ENTER-EXCLUSIVE-AREA-REF>
                  </CAN-ENTER-EXCLUSIVE-AREA-REFS>
                  <MINIMUM-START-INTERVAL>0.0</MINIMUM-START-INTERVAL>
                  <REENTRANCY-LEVEL>NON-REENTRANT</REENTRANCY-LEVEL>
						      <CALL-POINTS>
						        [!IF "$EthTrcvDevErrorDet_Enable = 'true'"!][!//
                    <BSW-DIRECT-CALL-POINT>
                      <SHORT-NAME>Det_ReportError</SHORT-NAME>
                      <CALLED-ENTRY-REF DEST="BSW-MODULE-ENTRY">/AUTOSAR_Det/BSWModuleEntry/Det_ReportError</CALLED-ENTRY-REF>
                    </BSW-DIRECT-CALL-POINT>
							      [!ENDIF!][!//
                  </CALL-POINTS>
                  <IMPLEMENTED-ENTRY-REF DEST="BSW-MODULE-ENTRY">/EthTrcv_TI_AM263Px_C/EthTrcv_ModuleEntry/EthTrcv_GetTransceiverMode</IMPLEMENTED-ENTRY-REF>
                </BSW-CALLED-ENTITY>
						    [!ENDIF!][!//
						    [!IF "$EthTrcvWakeupSupportApi_Enable = 'true'"!][!//
                <BSW-CALLED-ENTITY UUID="83bd1254-4cee-4246-ad86-de65d2be990b">
                  <SHORT-NAME>EthTrcv_SetTransceiverWakeupMode</SHORT-NAME>
                  <CAN-ENTER-EXCLUSIVE-AREA-REFS>
                    <CAN-ENTER-EXCLUSIVE-AREA-REF DEST="EXCLUSIVE-AREA">/EthTrcv_TI_AM263Px_C/EthTrcv/EthTrcv_Behavior/ETHTRCV_EXCLUSIVE_AREA_0</CAN-ENTER-EXCLUSIVE-AREA-REF>
                  </CAN-ENTER-EXCLUSIVE-AREA-REFS>
                  <MINIMUM-START-INTERVAL>0.0</MINIMUM-START-INTERVAL>
                  <REENTRANCY-LEVEL>NON-REENTRANT</REENTRANCY-LEVEL>
                  <IMPLEMENTED-ENTRY-REF DEST="BSW-MODULE-ENTRY">/EthTrcv_TI_AM263Px_C/EthTrcv_ModuleEntry/EthTrcv_SetTransceiverWakeupMode</IMPLEMENTED-ENTRY-REF>
                </BSW-CALLED-ENTITY>
                <BSW-CALLED-ENTITY S="" UUID="3527fc4b-0ff4-4bba-91a5-aa26bfa8634c">
                  <SHORT-NAME>EthTrcv_GetTransceiverWakeupMode</SHORT-NAME>
                  <CAN-ENTER-EXCLUSIVE-AREA-REFS>
                    <CAN-ENTER-EXCLUSIVE-AREA-REF DEST="EXCLUSIVE-AREA">/EthTrcv_TI_AM263Px_C/EthTrcv/EthTrcv_Behavior/ETHTRCV_EXCLUSIVE_AREA_0</CAN-ENTER-EXCLUSIVE-AREA-REF>
                  </CAN-ENTER-EXCLUSIVE-AREA-REFS>
                  <MINIMUM-START-INTERVAL>0.0</MINIMUM-START-INTERVAL>
                  <REENTRANCY-LEVEL>NON-REENTRANT</REENTRANCY-LEVEL>
                  <IMPLEMENTED-ENTRY-REF DEST="BSW-MODULE-ENTRY">/EthTrcv_TI_AM263Px_C/EthTrcv_ModuleEntry/EthTrcv_GetTransceiverWakeupMode</IMPLEMENTED-ENTRY-REF>
                </BSW-CALLED-ENTITY>
                <BSW-CALLED-ENTITY S="" UUID="ab285815-4e23-4476-86e1-f5714b7e179f">
                  <SHORT-NAME>EthTrcv_CheckWakeup</SHORT-NAME>
                  <CAN-ENTER-EXCLUSIVE-AREA-REFS>
                    <CAN-ENTER-EXCLUSIVE-AREA-REF DEST="EXCLUSIVE-AREA">/EthTrcv_TI_AM263Px_C/EthTrcv/EthTrcv_Behavior/ETHTRCV_EXCLUSIVE_AREA_0</CAN-ENTER-EXCLUSIVE-AREA-REF>
                  </CAN-ENTER-EXCLUSIVE-AREA-REFS>
                  <MINIMUM-START-INTERVAL>0.0</MINIMUM-START-INTERVAL>
                  <IMPLEMENTED-ENTRY-REF DEST="BSW-MODULE-ENTRY">/EthTrcv_TI_AM263Px_C/EthTrcv_ModuleEntry/EthTrcv_CheckWakeup</IMPLEMENTED-ENTRY-REF>
                </BSW-CALLED-ENTITY>
						    [!ENDIF!][!//
                [!IF "$EthTrcvStartAutoNegotiationApi_Enable = 'true'"!][!//
						    <BSW-CALLED-ENTITY S="" UUID="7d01fca5-bdbf-41d2-9914-5a35b52ffff2">
                  <SHORT-NAME>EthTrcv_StartAutoNegotiation</SHORT-NAME>
                  <CAN-ENTER-EXCLUSIVE-AREA-REFS>
                    <CAN-ENTER-EXCLUSIVE-AREA-REF DEST="EXCLUSIVE-AREA">/EthTrcv_TI_AM263Px_C/EthTrcv/EthTrcv_Behavior/ETHTRCV_EXCLUSIVE_AREA_0</CAN-ENTER-EXCLUSIVE-AREA-REF>
                  </CAN-ENTER-EXCLUSIVE-AREA-REFS>
                  <MINIMUM-START-INTERVAL>0.0</MINIMUM-START-INTERVAL>
                  <REENTRANCY-LEVEL>NON-REENTRANT</REENTRANCY-LEVEL>
						      <CALL-POINTS>
						        [!IF "$EthTrcvDevErrorDet_Enable = 'true'"!][!//
                    <BSW-DIRECT-CALL-POINT>
                      <SHORT-NAME>Det_ReportError</SHORT-NAME>
                      <CALLED-ENTRY-REF DEST="BSW-MODULE-ENTRY">/AUTOSAR_Det/BSWModuleEntry/Det_ReportError</CALLED-ENTRY-REF>
                    </BSW-DIRECT-CALL-POINT>
							      [!ENDIF!][!//
							      <BSW-DIRECT-CALL-POINT>
                      <SHORT-NAME>Dem_SetEventStatus</SHORT-NAME>
                      <CALLED-ENTRY-REF DEST="BSW-MODULE-ENTRY">/AUTOSAR_Dem/BSWModuleEntry/Dem_SetEventStatus</CALLED-ENTRY-REF>
                    </BSW-DIRECT-CALL-POINT>
                    <BSW-DIRECT-CALL-POINT>
                      <SHORT-NAME>GetCounterValue</SHORT-NAME>
                      <CALLED-ENTRY-REF DEST="BSW-MODULE-ENTRY">/AUTOSAR_Os/BSWModuleEntry/GetCounterValue</CALLED-ENTRY-REF>
                    </BSW-DIRECT-CALL-POINT>
                    <BSW-DIRECT-CALL-POINT>
                      <SHORT-NAME>GetElapsedValue</SHORT-NAME>
                      <CALLED-ENTRY-REF DEST="BSW-MODULE-ENTRY">/AUTOSAR_Os/BSWModuleEntry/GetElapsedValue</CALLED-ENTRY-REF>
                    </BSW-DIRECT-CALL-POINT>
                  </CALL-POINTS>
                  <IMPLEMENTED-ENTRY-REF DEST="BSW-MODULE-ENTRY">/EthTrcv_TI_AM263Px_C/EthTrcv_ModuleEntry/EthTrcv_StartAutoNegotiation</IMPLEMENTED-ENTRY-REF>
                </BSW-CALLED-ENTITY>
						    [!ENDIF!][!//
                [!IF "$EthTrcvGetLinkStateApi_Enable = 'true'"!][!//
						    <BSW-CALLED-ENTITY S="" UUID="a3d319da-d2b2-43f6-a1e4-fb28f14608ff">
                  <SHORT-NAME>EthTrcv_GetLinkState</SHORT-NAME>
                  <CAN-ENTER-EXCLUSIVE-AREA-REFS>
                    <CAN-ENTER-EXCLUSIVE-AREA-REF DEST="EXCLUSIVE-AREA">/EthTrcv_TI_AM263Px_C/EthTrcv/EthTrcv_Behavior/ETHTRCV_EXCLUSIVE_AREA_0</CAN-ENTER-EXCLUSIVE-AREA-REF>
                  </CAN-ENTER-EXCLUSIVE-AREA-REFS>
                  <MINIMUM-START-INTERVAL>0.0</MINIMUM-START-INTERVAL>
                  <REENTRANCY-LEVEL>NON-REENTRANT</REENTRANCY-LEVEL>
						      <CALL-POINTS>
						        [!IF "$EthTrcvDevErrorDet_Enable = 'true'"!][!//
                    <BSW-DIRECT-CALL-POINT>
                      <SHORT-NAME>Det_ReportError</SHORT-NAME>
                      <CALLED-ENTRY-REF DEST="BSW-MODULE-ENTRY">/AUTOSAR_Det/BSWModuleEntry/Det_ReportError</CALLED-ENTRY-REF>
                    </BSW-DIRECT-CALL-POINT>
							      [!ENDIF!][!//
                    <BSW-DIRECT-CALL-POINT>
                      <SHORT-NAME>GetCounterValue</SHORT-NAME>
                      <CALLED-ENTRY-REF DEST="BSW-MODULE-ENTRY">/AUTOSAR_Os/BSWModuleEntry/GetCounterValue</CALLED-ENTRY-REF>
                    </BSW-DIRECT-CALL-POINT>
                    <BSW-DIRECT-CALL-POINT>
                      <SHORT-NAME>GetElapsedValue</SHORT-NAME>
                      <CALLED-ENTRY-REF DEST="BSW-MODULE-ENTRY">/AUTOSAR_Os/BSWModuleEntry/GetElapsedValue</CALLED-ENTRY-REF>
                    </BSW-DIRECT-CALL-POINT>
                  </CALL-POINTS>
                  <IMPLEMENTED-ENTRY-REF DEST="BSW-MODULE-ENTRY">/EthTrcv_TI_AM263Px_C/EthTrcv_ModuleEntry/EthTrcv_GetLinkState</IMPLEMENTED-ENTRY-REF>
                </BSW-CALLED-ENTITY>
						    [!ENDIF!][!//
                [!IF "$EthTrcvGetBaudRateApi_Enable = 'true'"!][!//
						    <BSW-CALLED-ENTITY S="" UUID="50cd63d5-6c08-48ab-915e-337aaa5a9c42">
                  <SHORT-NAME>EthTrcv_GetBaudRate</SHORT-NAME>
                  <CAN-ENTER-EXCLUSIVE-AREA-REFS>
                    <CAN-ENTER-EXCLUSIVE-AREA-REF DEST="EXCLUSIVE-AREA">/EthTrcv_TI_AM263Px_C/EthTrcv/EthTrcv_Behavior/ETHTRCV_EXCLUSIVE_AREA_0</CAN-ENTER-EXCLUSIVE-AREA-REF>
                  </CAN-ENTER-EXCLUSIVE-AREA-REFS>
                  <MINIMUM-START-INTERVAL>0.0</MINIMUM-START-INTERVAL>
                  <REENTRANCY-LEVEL>NON-REENTRANT</REENTRANCY-LEVEL>
						      <CALL-POINTS>
						        [!IF "$EthTrcvDevErrorDet_Enable = 'true'"!][!//
                    <BSW-DIRECT-CALL-POINT>
                      <SHORT-NAME>Det_ReportError</SHORT-NAME>
                      <CALLED-ENTRY-REF DEST="BSW-MODULE-ENTRY">/AUTOSAR_Det/BSWModuleEntry/Det_ReportError</CALLED-ENTRY-REF>
                    </BSW-DIRECT-CALL-POINT>
							      [!ENDIF!][!//
							      <BSW-DIRECT-CALL-POINT>
                      <SHORT-NAME>Dem_SetEventStatus</SHORT-NAME>
                      <CALLED-ENTRY-REF DEST="BSW-MODULE-ENTRY">/AUTOSAR_Dem/BSWModuleEntry/Dem_SetEventStatus</CALLED-ENTRY-REF>
                    </BSW-DIRECT-CALL-POINT>
                  </CALL-POINTS>
                  <IMPLEMENTED-ENTRY-REF DEST="BSW-MODULE-ENTRY">/EthTrcv_TI_AM263Px_C/EthTrcv_ModuleEntry/EthTrcv_GetBaudRate</IMPLEMENTED-ENTRY-REF>
                </BSW-CALLED-ENTITY>
						    [!ENDIF!][!//
                [!IF "$EthTrcvGetDuplexModeApi_Enable = 'true'"!][!//
						    <BSW-CALLED-ENTITY S="" UUID="5fd5262b-4d36-4820-acc6-20bf779cf203">
                  <SHORT-NAME>EthTrcv_GetDuplexMode</SHORT-NAME>
                  <CAN-ENTER-EXCLUSIVE-AREA-REFS>
                    <CAN-ENTER-EXCLUSIVE-AREA-REF DEST="EXCLUSIVE-AREA">/EthTrcv_TI_AM263Px_C/EthTrcv/EthTrcv_Behavior/ETHTRCV_EXCLUSIVE_AREA_0</CAN-ENTER-EXCLUSIVE-AREA-REF>
                  </CAN-ENTER-EXCLUSIVE-AREA-REFS>
                  <MINIMUM-START-INTERVAL>0.0</MINIMUM-START-INTERVAL>
                  <REENTRANCY-LEVEL>NON-REENTRANT</REENTRANCY-LEVEL>
						      <CALL-POINTS>
						        [!IF "$EthTrcvDevErrorDet_Enable = 'true'"!][!//
                    <BSW-DIRECT-CALL-POINT>
                      <SHORT-NAME>Det_ReportError</SHORT-NAME>
                      <CALLED-ENTRY-REF DEST="BSW-MODULE-ENTRY">/AUTOSAR_Det/BSWModuleEntry/Det_ReportError</CALLED-ENTRY-REF>
                    </BSW-DIRECT-CALL-POINT>
							      [!ENDIF!][!//
							      <BSW-DIRECT-CALL-POINT>
                      <SHORT-NAME>Dem_SetEventStatus</SHORT-NAME>
                      <CALLED-ENTRY-REF DEST="BSW-MODULE-ENTRY">/AUTOSAR_Dem/BSWModuleEntry/Dem_SetEventStatus</CALLED-ENTRY-REF>
                    </BSW-DIRECT-CALL-POINT>
                  </CALL-POINTS>
                  <IMPLEMENTED-ENTRY-REF DEST="BSW-MODULE-ENTRY">/EthTrcv_TI_AM263Px_C/EthTrcv_ModuleEntry/EthTrcv_GetDuplexMode</IMPLEMENTED-ENTRY-REF>
                </BSW-CALLED-ENTITY>
						    [!ENDIF!][!//
						    [!IF "$EthTrcvSetPhyTxModeApi_Enable = 'true'"!][!//
						    <BSW-CALLED-ENTITY S="" UUID="16867ea7-3aa6-4c00-8400-50a39090e231">
                  <SHORT-NAME>EthTrcv_SetPhyTxMode</SHORT-NAME>
                  <CAN-ENTER-EXCLUSIVE-AREA-REFS>
                    <CAN-ENTER-EXCLUSIVE-AREA-REF DEST="EXCLUSIVE-AREA">/EthTrcv_TI_AM263Px_C/EthTrcv/EthTrcv_Behavior/ETHTRCV_EXCLUSIVE_AREA_0</CAN-ENTER-EXCLUSIVE-AREA-REF>
                  </CAN-ENTER-EXCLUSIVE-AREA-REFS>
                  <MINIMUM-START-INTERVAL>0.0</MINIMUM-START-INTERVAL>
                  <REENTRANCY-LEVEL>NON-REENTRANT</REENTRANCY-LEVEL>
						      <CALL-POINTS>
						        [!IF "$EthTrcvDevErrorDet_Enable = 'true'"!][!//
                    <BSW-DIRECT-CALL-POINT>
                      <SHORT-NAME>Det_ReportError</SHORT-NAME>
                      <CALLED-ENTRY-REF DEST="BSW-MODULE-ENTRY">/AUTOSAR_Det/BSWModuleEntry/Det_ReportError</CALLED-ENTRY-REF>
                    </BSW-DIRECT-CALL-POINT>
							      [!ENDIF!][!//
							      <BSW-DIRECT-CALL-POINT>
                      <SHORT-NAME>Dem_SetEventStatus</SHORT-NAME>
                      <CALLED-ENTRY-REF DEST="BSW-MODULE-ENTRY">/AUTOSAR_Dem/BSWModuleEntry/Dem_SetEventStatus</CALLED-ENTRY-REF>
                    </BSW-DIRECT-CALL-POINT>
                  </CALL-POINTS>
                  <IMPLEMENTED-ENTRY-REF DEST="BSW-MODULE-ENTRY">/EthTrcv_TI_AM263Px_C/EthTrcv_ModuleEntry/EthTrcv_SetPhyTxMode</IMPLEMENTED-ENTRY-REF>
                </BSW-CALLED-ENTITY>
						    [!ENDIF!][!//
						    [!IF "$EthTrcvGetCableDiagnosticsResultApi_Enable = 'true'"!][!//
						    <BSW-CALLED-ENTITY S="" UUID="36faebaa-f9cd-4ead-be16-2e3f8a4ff7dd">
                  <SHORT-NAME>EthTrcv_GetCableDiagnosticsResult</SHORT-NAME>
                  <CAN-ENTER-EXCLUSIVE-AREA-REFS>
                    <CAN-ENTER-EXCLUSIVE-AREA-REF DEST="EXCLUSIVE-AREA">/EthTrcv_TI_AM263Px_C/EthTrcv/EthTrcv_Behavior/ETHTRCV_EXCLUSIVE_AREA_0</CAN-ENTER-EXCLUSIVE-AREA-REF>
                  </CAN-ENTER-EXCLUSIVE-AREA-REFS>
                  <MINIMUM-START-INTERVAL>0.0</MINIMUM-START-INTERVAL>
                  <REENTRANCY-LEVEL>NON-REENTRANT</REENTRANCY-LEVEL>
						      <CALL-POINTS>
						        [!IF "$EthTrcvDevErrorDet_Enable = 'true'"!][!//
                    <BSW-DIRECT-CALL-POINT>
                      <SHORT-NAME>Det_ReportError</SHORT-NAME>
                      <CALLED-ENTRY-REF DEST="BSW-MODULE-ENTRY">/AUTOSAR_Det/BSWModuleEntry/Det_ReportError</CALLED-ENTRY-REF>
                    </BSW-DIRECT-CALL-POINT>
							      [!ENDIF!][!//
							      <BSW-DIRECT-CALL-POINT>
                      <SHORT-NAME>Dem_SetEventStatus</SHORT-NAME>
                      <CALLED-ENTRY-REF DEST="BSW-MODULE-ENTRY">/AUTOSAR_Dem/BSWModuleEntry/Dem_SetEventStatus</CALLED-ENTRY-REF>
                    </BSW-DIRECT-CALL-POINT>
                  </CALL-POINTS>
                  <IMPLEMENTED-ENTRY-REF DEST="BSW-MODULE-ENTRY">/EthTrcv_TI_AM263Px_C/EthTrcv_ModuleEntry/EthTrcv_GetCableDiagnosticsResult</IMPLEMENTED-ENTRY-REF>
                </BSW-CALLED-ENTITY>
						    [!ENDIF!][!//
						    [!IF "$EthTrcvGetPhyIdentifierApi_Enable = 'true'"!][!//
						    <BSW-CALLED-ENTITY S="" UUID="0e2c592c-e4bf-4e9e-889f-75da0f010fde">
                  <SHORT-NAME>EthTrcv_GetPhyIdentifier</SHORT-NAME>
                  <CAN-ENTER-EXCLUSIVE-AREA-REFS>
                    <CAN-ENTER-EXCLUSIVE-AREA-REF DEST="EXCLUSIVE-AREA">/EthTrcv_TI_AM263Px_C/EthTrcv/EthTrcv_Behavior/ETHTRCV_EXCLUSIVE_AREA_0</CAN-ENTER-EXCLUSIVE-AREA-REF>
                  </CAN-ENTER-EXCLUSIVE-AREA-REFS>
                  <MINIMUM-START-INTERVAL>0.0</MINIMUM-START-INTERVAL>
                  <REENTRANCY-LEVEL>NON-REENTRANT</REENTRANCY-LEVEL>
						      <CALL-POINTS>
						        [!IF "$EthTrcvDevErrorDet_Enable = 'true'"!][!//
                    <BSW-DIRECT-CALL-POINT>
                      <SHORT-NAME>Det_ReportError</SHORT-NAME>
                      <CALLED-ENTRY-REF DEST="BSW-MODULE-ENTRY">/AUTOSAR_Det/BSWModuleEntry/Det_ReportError</CALLED-ENTRY-REF>
                    </BSW-DIRECT-CALL-POINT>
							      [!ENDIF!][!//
                  </CALL-POINTS>
                  <IMPLEMENTED-ENTRY-REF DEST="BSW-MODULE-ENTRY">/EthTrcv_TI_AM263Px_C/EthTrcv_ModuleEntry/EthTrcv_GetPhyIdentifier</IMPLEMENTED-ENTRY-REF>
                </BSW-CALLED-ENTITY>
						    [!ENDIF!][!//
						    [!IF "$EthTrcvSetPhyTestModeApi_Enable = 'true'"!][!//
						    <BSW-CALLED-ENTITY S="" UUID="2b304267-9c36-4e9f-b426-953756f9593d">
                  <SHORT-NAME>EthTrcv_SetPhyTestMode</SHORT-NAME>
                  <CAN-ENTER-EXCLUSIVE-AREA-REFS>
                    <CAN-ENTER-EXCLUSIVE-AREA-REF DEST="EXCLUSIVE-AREA">/EthTrcv_TI_AM263Px_C/EthTrcv/EthTrcv_Behavior/ETHTRCV_EXCLUSIVE_AREA_0</CAN-ENTER-EXCLUSIVE-AREA-REF>
                  </CAN-ENTER-EXCLUSIVE-AREA-REFS>
                  <MINIMUM-START-INTERVAL>0.0</MINIMUM-START-INTERVAL>
                  <REENTRANCY-LEVEL>NON-REENTRANT</REENTRANCY-LEVEL>
						      <CALL-POINTS>
						        [!IF "$EthTrcvDevErrorDet_Enable = 'true'"!][!//
                    <BSW-DIRECT-CALL-POINT>
                      <SHORT-NAME>Det_ReportError</SHORT-NAME>
                      <CALLED-ENTRY-REF DEST="BSW-MODULE-ENTRY">/AUTOSAR_Det/BSWModuleEntry/Det_ReportError</CALLED-ENTRY-REF>
                    </BSW-DIRECT-CALL-POINT>
							      [!ENDIF!][!//
							      <BSW-DIRECT-CALL-POINT>
                      <SHORT-NAME>Dem_SetEventStatus</SHORT-NAME>
                      <CALLED-ENTRY-REF DEST="BSW-MODULE-ENTRY">/AUTOSAR_Dem/BSWModuleEntry/Dem_SetEventStatus</CALLED-ENTRY-REF>
                    </BSW-DIRECT-CALL-POINT>
                  </CALL-POINTS>
                  <IMPLEMENTED-ENTRY-REF DEST="BSW-MODULE-ENTRY">/EthTrcv_TI_AM263Px_C/EthTrcv_ModuleEntry/EthTrcv_SetPhyTestMode</IMPLEMENTED-ENTRY-REF>
                </BSW-CALLED-ENTITY>
						    [!ENDIF!][!//
						    [!IF "$EthTrcvGetTransceiverWakeupModeApi_Enable = 'true'"!][!//
						    <BSW-CALLED-ENTITY S="" UUID="fb0b921f-1abc-4711-bb48-c00bd673148e">
                  <SHORT-NAME>EthTrcv_GetTransceiverWakeupMode</SHORT-NAME>
                  <CAN-ENTER-EXCLUSIVE-AREA-REFS>
                    <CAN-ENTER-EXCLUSIVE-AREA-REF DEST="EXCLUSIVE-AREA">/EthTrcv_TI_AM263Px_C/EthTrcv/EthTrcv_Behavior/ETHTRCV_EXCLUSIVE_AREA_0</CAN-ENTER-EXCLUSIVE-AREA-REF>
                  </CAN-ENTER-EXCLUSIVE-AREA-REFS>
                  <MINIMUM-START-INTERVAL>0.0</MINIMUM-START-INTERVAL>
                  <REENTRANCY-LEVEL>NON-REENTRANT</REENTRANCY-LEVEL>
                  <IMPLEMENTED-ENTRY-REF DEST="BSW-MODULE-ENTRY">/EthTrcv_TI_AM263Px_C/EthTrcv_ModuleEntry/EthTrcv_GetTransceiverWakeupMode</IMPLEMENTED-ENTRY-REF>
                </BSW-CALLED-ENTITY>
						    [!ENDIF!][!//
						    [!IF "$EthTrcvGetPhySignalQualityApi_Enable = 'true'"!][!//
						    <BSW-CALLED-ENTITY S="" UUID="f0876f5b-b0aa-4e19-80e3-a2b9208858f6">
                  <SHORT-NAME>EthTrcv_GetPhySignalQuality</SHORT-NAME>
                  <CAN-ENTER-EXCLUSIVE-AREA-REFS>
                    <CAN-ENTER-EXCLUSIVE-AREA-REF DEST="EXCLUSIVE-AREA">/EthTrcv_TI_AM263Px_C/EthTrcv/EthTrcv_Behavior/ETHTRCV_EXCLUSIVE_AREA_0</CAN-ENTER-EXCLUSIVE-AREA-REF>
                  </CAN-ENTER-EXCLUSIVE-AREA-REFS>
                  <MINIMUM-START-INTERVAL>0.0</MINIMUM-START-INTERVAL>
                  <REENTRANCY-LEVEL>NON-REENTRANT</REENTRANCY-LEVEL>
                  <IMPLEMENTED-ENTRY-REF DEST="BSW-MODULE-ENTRY">/EthTrcv_TI_AM263Px_C/EthTrcv_ModuleEntry/EthTrcv_GetPhySignalQuality</IMPLEMENTED-ENTRY-REF>
                </BSW-CALLED-ENTITY>
						    [!ENDIF!][!//
						    [!IF "$EthTrcv_SetPhyLoopbackMode_Enable = 'true'"!][!//
						    <BSW-CALLED-ENTITY S="" UUID="6a7d5365-4477-486f-9c87-00aa0432825b">
                  <SHORT-NAME>EthTrcv_SetPhyLoopbackMode</SHORT-NAME>
                  <CAN-ENTER-EXCLUSIVE-AREA-REFS>
                    <CAN-ENTER-EXCLUSIVE-AREA-REF DEST="EXCLUSIVE-AREA">/EthTrcv_TI_AM263Px_C/EthTrcv/EthTrcv_Behavior/ETHTRCV_EXCLUSIVE_AREA_0</CAN-ENTER-EXCLUSIVE-AREA-REF>
                  </CAN-ENTER-EXCLUSIVE-AREA-REFS>
                  <MINIMUM-START-INTERVAL>0.0</MINIMUM-START-INTERVAL>
                  <REENTRANCY-LEVEL>NON-REENTRANT</REENTRANCY-LEVEL>
						      <CALL-POINTS>
						        [!IF "$EthTrcvDevErrorDet_Enable = 'true'"!][!//
                    <BSW-DIRECT-CALL-POINT>
                      <SHORT-NAME>Det_ReportError</SHORT-NAME>
                      <CALLED-ENTRY-REF DEST="BSW-MODULE-ENTRY">/AUTOSAR_Det/BSWModuleEntry/Det_ReportError</CALLED-ENTRY-REF>
                    </BSW-DIRECT-CALL-POINT>
							      [!ENDIF!][!//
							      <BSW-DIRECT-CALL-POINT>
                      <SHORT-NAME>Dem_SetEventStatus</SHORT-NAME>
                      <CALLED-ENTRY-REF DEST="BSW-MODULE-ENTRY">/AUTOSAR_Dem/BSWModuleEntry/Dem_SetEventStatus</CALLED-ENTRY-REF>
                    </BSW-DIRECT-CALL-POINT>
                  </CALL-POINTS>
                  <IMPLEMENTED-ENTRY-REF DEST="BSW-MODULE-ENTRY">/EthTrcv_TI_AM263Px_C/EthTrcv_ModuleEntry/EthTrcv_SetPhyLoopbackMode</IMPLEMENTED-ENTRY-REF>
                </BSW-CALLED-ENTITY>
						    [!ENDIF!][!//
                <BSW-CALLED-ENTITY S="" UUID="18bf9847-c24b-4fb9-adf3-b9ace7326894">
                  <SHORT-NAME>EthTrcv_ReadMiiIndication</SHORT-NAME>
                  <MINIMUM-START-INTERVAL>0.0</MINIMUM-START-INTERVAL>
                  <REENTRANCY-LEVEL>NON-REENTRANT</REENTRANCY-LEVEL>
                  <IMPLEMENTED-ENTRY-REF DEST="BSW-MODULE-ENTRY">/EthTrcv_TI_AM263Px_C/EthTrcv_ModuleEntry/EthTrcv_ReadMiiIndication</IMPLEMENTED-ENTRY-REF>
                </BSW-CALLED-ENTITY>
                <BSW-CALLED-ENTITY S="" UUID="a7b2c030-9372-4bf0-a74d-4b03bab496b9">
                  <SHORT-NAME>EthTrcv_WriteMiiIndication</SHORT-NAME>
                  <MINIMUM-START-INTERVAL>0.0</MINIMUM-START-INTERVAL>
                  <REENTRANCY-LEVEL>NON-REENTRANT</REENTRANCY-LEVEL>
                  <IMPLEMENTED-ENTRY-REF DEST="BSW-MODULE-ENTRY">/EthTrcv_TI_AM263Px_C/EthTrcv_ModuleEntry/EthTrcv_WriteMiiIndication</IMPLEMENTED-ENTRY-REF>
                </BSW-CALLED-ENTITY>
                <BSW-SCHEDULABLE-ENTITY UUID="b4b3b6ba-7b09-4d1f-85e7-e8fbb84d4ceb">
                  <SHORT-NAME>EthTrcv_MainFunction</SHORT-NAME>
                  <CAN-ENTER-EXCLUSIVE-AREA-REFS>
                    <CAN-ENTER-EXCLUSIVE-AREA-REF DEST="EXCLUSIVE-AREA">/EthTrcv_TI_AM263Px_C/EthTrcv/EthTrcv_Behavior/ETHTRCV_EXCLUSIVE_AREA_0</CAN-ENTER-EXCLUSIVE-AREA-REF>
                  </CAN-ENTER-EXCLUSIVE-AREA-REFS>
                  <MINIMUM-START-INTERVAL>0.0</MINIMUM-START-INTERVAL>
                  <REENTRANCY-LEVEL>SINGLE-CORE-REENTRANT</REENTRANCY-LEVEL>
                  <CALL-POINTS>
                    [!IF "$EthTrcvDevErrorDet_Enable = 'true'"!][!//
                    <BSW-DIRECT-CALL-POINT>
                      <SHORT-NAME>Det_ReportError</SHORT-NAME>
                      <CALLED-ENTRY-REF DEST="BSW-MODULE-ENTRY">/AUTOSAR_Det/BSWModuleEntry/Det_ReportError</CALLED-ENTRY-REF>
                    </BSW-DIRECT-CALL-POINT>
                    [!ENDIF!][!//
                    <BSW-DIRECT-CALL-POINT>
                      <SHORT-NAME>EthIf_TrcvModeIndication</SHORT-NAME>
                      <CALLED-ENTRY-REF DEST="BSW-MODULE-ENTRY">/AUTOSAR/EthIf/BswModuleEntries/EthIf_TrcvModeIndication</CALLED-ENTRY-REF>
                    </BSW-DIRECT-CALL-POINT>
                    <BSW-DIRECT-CALL-POINT>
                      <SHORT-NAME>Dem_SetEventStatus</SHORT-NAME>
                      <CALLED-ENTRY-REF DEST="BSW-MODULE-ENTRY">/AUTOSAR_Dem/BSWModuleEntry/Dem_SetEventStatus</CALLED-ENTRY-REF>
                    </BSW-DIRECT-CALL-POINT>
                  </CALL-POINTS>
                  <IMPLEMENTED-ENTRY-REF DEST="BSW-MODULE-ENTRY">/EthTrcv_TI_AM263Px_C/EthTrcv_ModuleEntry/EthTrcv_MainFunction</IMPLEMENTED-ENTRY-REF>
                </BSW-SCHEDULABLE-ENTITY>
              </ENTITYS>
              <EVENTS>
                <BSW-TIMING-EVENT S="" UUID="f2fb8be2-e63c-4a1c-8b4b-7c0deb70076a">
                  <SHORT-NAME>EthTrcvTimingEvent_MainFunction</SHORT-NAME>
                  <STARTS-ON-EVENT-REF DEST="BSW-SCHEDULABLE-ENTITY">/EthTrcv_TI_AM263Px_C/EthTrcv/EthTrcv_Behavior/EthTrcv_MainFunction</STARTS-ON-EVENT-REF>
                  <PERIOD>0.005</PERIOD>
						    </BSW-TIMING-EVENT>
              </EVENTS>
            </BSW-INTERNAL-BEHAVIOR>
          </INTERNAL-BEHAVIORS>
        </BSW-MODULE-DESCRIPTION>
        <BSW-IMPLEMENTATION UUID="97346460-3973-4407-b052-a6f7007175e2">
          <SHORT-NAME>EthTrcv_Impl</SHORT-NAME>
          <CODE-DESCRIPTORS>
            <CODE UUID="6255802f-9840-4d9c-aac4-81eed4624899">
              <SHORT-NAME>Files</SHORT-NAME>
              <ARTIFACT-DESCRIPTORS>
                <AUTOSAR-ENGINEERING-OBJECT S="">
                  <SHORT-LABEL>include::EthTrcv_Cfg.h</SHORT-LABEL>
                  <CATEGORY>SWHDR</CATEGORY>
                </AUTOSAR-ENGINEERING-OBJECT>
                <AUTOSAR-ENGINEERING-OBJECT S="">
                  <SHORT-LABEL>src::EthTrcv_Cfg.c</SHORT-LABEL>
                  <CATEGORY>SWSRC</CATEGORY>
                </AUTOSAR-ENGINEERING-OBJECT>
                <AUTOSAR-ENGINEERING-OBJECT S="">
                  <SHORT-LABEL>src::EthTrcv_Lcfg.c</SHORT-LABEL>
                  <CATEGORY>SWSRC</CATEGORY>
                </AUTOSAR-ENGINEERING-OBJECT>
                <AUTOSAR-ENGINEERING-OBJECT S="">
                  <SHORT-LABEL>src::EthTrcv_PBcfg.c</SHORT-LABEL>
                  <CATEGORY>SWSRC</CATEGORY>
                </AUTOSAR-ENGINEERING-OBJECT>
                <AUTOSAR-ENGINEERING-OBJECT S="">
                  <SHORT-LABEL>include::EthTrcv_Types.h</SHORT-LABEL>
                  <CATEGORY>SWHDR</CATEGORY>
                </AUTOSAR-ENGINEERING-OBJECT>
                <AUTOSAR-ENGINEERING-OBJECT S="">
                  <SHORT-LABEL>src::EthTrcv.c</SHORT-LABEL>
                  <CATEGORY>SWSRC</CATEGORY>
                </AUTOSAR-ENGINEERING-OBJECT>
                <AUTOSAR-ENGINEERING-OBJECT S="">
                  <SHORT-LABEL>include::EthTrcv.h</SHORT-LABEL>
                  <CATEGORY>SWHDR</CATEGORY>
                </AUTOSAR-ENGINEERING-OBJECT>
                <AUTOSAR-ENGINEERING-OBJECT S="">
                  <SHORT-LABEL>V0::EthTrcv_Priv.c</SHORT-LABEL>
                  <CATEGORY>SWSRC</CATEGORY>
                </AUTOSAR-ENGINEERING-OBJECT>
                <AUTOSAR-ENGINEERING-OBJECT S="">
                  <SHORT-LABEL>V0::EthTrcv_Priv.h</SHORT-LABEL>
                  <CATEGORY>SWHDR</CATEGORY>
                </AUTOSAR-ENGINEERING-OBJECT>
              </ARTIFACT-DESCRIPTORS>
            </CODE>
          </CODE-DESCRIPTORS>
          <COMPILERS>
            <COMPILER UUID="28814b2a-b0cb-44f5-b1bc-b49e6e584245">
              <SHORT-NAME>tiarmclang</SHORT-NAME>
              <NAME>TI ARM Clang</NAME>
              <OPTIONS>-mcpu=cortex-r5  -mfpu=vfpv3-d16  -mfloat-abi=hard  -c  -mlittle-endian  -ffunction-sections  -gdwarf-3  -Werror -Os  -x  -save-temps  -mthumb  -DAM263PX_SIP_PACKAGE  -DAM263PX_PLATFORM -DAM263PX_R_PACKAGE -DAM263PX_C_PACKAGE </OPTIONS>
              <VENDOR>Texas Instruments</VENDOR>
              <VERSION>4.0.0</VERSION>
            </COMPILER>
          </COMPILERS>
          <LINKERS>
            <LINKER UUID="17185c63-bb1b-4b4c-a052-33d53ec02621">
              <SHORT-NAME>tiarmlnk</SHORT-NAME>
              <NAME>TI ARM Clang Linker</NAME>
              <OPTIONS>-mcpu=cortex-r5  -Wl,--ram_model  -Wl,--reread_libs  -Wl,--warn_sections  -qq -Wl,--emit_warnings_as_errors --diag_suppress=10068 --diag_suppress=10063 </OPTIONS>
              <VENDOR>Texas Instruments</VENDOR>
              <VERSION>4.0.0</VERSION>
            </LINKER>
          </LINKERS>
          <PROGRAMMING-LANGUAGE>C</PROGRAMMING-LANGUAGE>
          <RESOURCE-CONSUMPTION UUID="4e90daf2-42d5-4e58-9023-f3315d428667">
            <SHORT-NAME>ResourceConsumption</SHORT-NAME>
            <MEMORY-SECTIONS>
              <MEMORY-SECTION UUID="94b6cb36-cd65-49a7-b7b5-24d38cca7811">
                <SHORT-NAME>ETHTRCV_CODE</SHORT-NAME>
                <SW-ADDRMETHOD-REF DEST="SW-ADDR-METHOD">/AUTOSAR_MemMap/SwAddrMethods/CODE</SW-ADDRMETHOD-REF>
                <SYMBOL>CODE</SYMBOL>
              </MEMORY-SECTION>
              <MEMORY-SECTION UUID="17f8e24a-b8ef-4b0b-9053-cfd637034399">
                <SHORT-NAME>ETHTRCV_CONFIG_DATA</SHORT-NAME>
                <ALIGNMENT>UNSPECIFIED</ALIGNMENT>
                <SW-ADDRMETHOD-REF DEST="SW-ADDR-METHOD">/AUTOSAR_MemMap/SwAddrMethods/CONFIG_DATA</SW-ADDRMETHOD-REF>
                <SYMBOL>CONFIG_DATA</SYMBOL>
              </MEMORY-SECTION>
              <MEMORY-SECTION UUID="fc4d6972-8879-4bac-a345-54cdf7ca97cd">
                <SHORT-NAME>ETHTRCV_VAR_INIT_32</SHORT-NAME>
                <ALIGNMENT>32</ALIGNMENT>
                <SW-ADDRMETHOD-REF DEST="SW-ADDR-METHOD">/AUTOSAR_MemMap/SwAddrMethods/VAR_INIT</SW-ADDRMETHOD-REF>
                <SYMBOL>VAR_INIT_32</SYMBOL>
              </MEMORY-SECTION>
              <MEMORY-SECTION UUID="232d3fea-5e79-4cdc-8c41-667ac9b78a9b">
                <SHORT-NAME>ETHTRCV_VAR_INIT_UNSPECIFIED</SHORT-NAME>
                <ALIGNMENT>UNSPECIFIED</ALIGNMENT>
                <SW-ADDRMETHOD-REF DEST="SW-ADDR-METHOD">/AUTOSAR_MemMap/SwAddrMethods/VAR_INIT</SW-ADDRMETHOD-REF>
                <SYMBOL>VAR_INIT_UNSPECIFIED</SYMBOL>
              </MEMORY-SECTION>
              <MEMORY-SECTION UUID="52e33ed0-5d3e-40a5-a2f4-333bd85a7222">
                <SHORT-NAME>ETHTRCV_VAR_NO_INIT_16</SHORT-NAME>
                <ALIGNMENT>16</ALIGNMENT>
                <SW-ADDRMETHOD-REF DEST="SW-ADDR-METHOD">/AUTOSAR_MemMap/SwAddrMethods/VAR_NO_INIT</SW-ADDRMETHOD-REF>
                <SYMBOL>VAR_NO_INIT_16</SYMBOL>
              </MEMORY-SECTION>
              <MEMORY-SECTION UUID="23655e8e-cbaa-4120-a50f-96c6ac1c482f">
                <SHORT-NAME>ETHTRCV_VAR_NO_INIT_UNSPECIFIED</SHORT-NAME>
                <ALIGNMENT>UNSPECIFIED</ALIGNMENT>
                <SW-ADDRMETHOD-REF DEST="SW-ADDR-METHOD">/AUTOSAR_MemMap/SwAddrMethods/VAR_NO_INIT</SW-ADDRMETHOD-REF>
                <SYMBOL>VAR_NO_INIT_UNSPECIFIED</SYMBOL>
              </MEMORY-SECTION>
            </MEMORY-SECTIONS>
          </RESOURCE-CONSUMPTION>
          <SW-VERSION>10.01.00</SW-VERSION>
          <VENDOR-ID>44</VENDOR-ID>
          <AR-RELEASE-VERSION>4.3.1</AR-RELEASE-VERSION>
          <BEHAVIOR-REF DEST="BSW-INTERNAL-BEHAVIOR">/EthTrcv_TI_AM263Px_C/EthTrcv/EthTrcv_Behavior</BEHAVIOR-REF>
          <VENDOR-SPECIFIC-MODULE-DEF-REFS>
            <VENDOR-SPECIFIC-MODULE-DEF-REF DEST="ECUC-MODULE-DEF">/TI_AM263Px_C/EthTrcv</VENDOR-SPECIFIC-MODULE-DEF-REF>
          </VENDOR-SPECIFIC-MODULE-DEF-REFS>
        </BSW-IMPLEMENTATION>
      </ELEMENTS>
      <AR-PACKAGES>
        <AR-PACKAGE UUID="ca7cdb58-6e5c-4a2f-b4ac-b1494a434260">
          <SHORT-NAME>EthTrcv_ModuleEntry</SHORT-NAME>
          <ELEMENTS>
            <BSW-MODULE-ENTRY UUID="f6d44b33-50db-4158-ae8a-8d9150658eaf">
              <SHORT-NAME>EthTrcv_GetVersionInfo</SHORT-NAME>
              <SHORT-NAME-PATTERN />
              <SERVICE-ID>0x0b</SERVICE-ID>
              <IS-REENTRANT>true</IS-REENTRANT>
              <IS-SYNCHRONOUS>true</IS-SYNCHRONOUS>
              <CALL-TYPE>REGULAR</CALL-TYPE>
              <EXECUTION-CONTEXT>UNSPECIFIED</EXECUTION-CONTEXT>
              <SW-SERVICE-IMPL-POLICY>STANDARD</SW-SERVICE-IMPL-POLICY>
              <BSW-ENTRY-KIND>CONCRETE</BSW-ENTRY-KIND>
            </BSW-MODULE-ENTRY>
            <BSW-MODULE-ENTRY S="" UUID="d1980e94-e9d2-4543-89ed-ba8662750bd6">
              <SHORT-NAME>EthTrcv_Init</SHORT-NAME>
              <SERVICE-ID>0x01</SERVICE-ID>
              <IS-REENTRANT>false</IS-REENTRANT>
              <IS-SYNCHRONOUS>true</IS-SYNCHRONOUS>
              <CALL-TYPE>REGULAR</CALL-TYPE>
              <EXECUTION-CONTEXT>UNSPECIFIED</EXECUTION-CONTEXT>
              <SW-SERVICE-IMPL-POLICY>STANDARD</SW-SERVICE-IMPL-POLICY>
              <BSW-ENTRY-KIND>CONCRETE</BSW-ENTRY-KIND>
            </BSW-MODULE-ENTRY>
            <BSW-MODULE-ENTRY UUID="32e6018e-b36f-4eec-8f58-abbde0c89ece">
              <SHORT-NAME>EthTrcv_SetTransceiverMode</SHORT-NAME>
              <SHORT-NAME-PATTERN />
              <SERVICE-ID>0x03</SERVICE-ID>
              <IS-REENTRANT>false</IS-REENTRANT>
              <IS-SYNCHRONOUS>false</IS-SYNCHRONOUS>
              <CALL-TYPE>REGULAR</CALL-TYPE>
              <EXECUTION-CONTEXT>UNSPECIFIED</EXECUTION-CONTEXT>
              <SW-SERVICE-IMPL-POLICY>STANDARD</SW-SERVICE-IMPL-POLICY>
              <BSW-ENTRY-KIND>CONCRETE</BSW-ENTRY-KIND>
            </BSW-MODULE-ENTRY>
            <BSW-MODULE-ENTRY UUID="218b075f-68cb-4d22-a660-c4221780f9ca">
              <SHORT-NAME>EthTrcv_GetTransceiverMode</SHORT-NAME>
              <SHORT-NAME-PATTERN />
              <SERVICE-ID>0x04</SERVICE-ID>
              <IS-REENTRANT>false</IS-REENTRANT>
              <IS-SYNCHRONOUS>true</IS-SYNCHRONOUS>
              <CALL-TYPE>REGULAR</CALL-TYPE>
              <EXECUTION-CONTEXT>UNSPECIFIED</EXECUTION-CONTEXT>
              <SW-SERVICE-IMPL-POLICY>STANDARD</SW-SERVICE-IMPL-POLICY>
              <BSW-ENTRY-KIND>CONCRETE</BSW-ENTRY-KIND>
            </BSW-MODULE-ENTRY>
            <BSW-MODULE-ENTRY UUID="9201aaca-cbf9-4202-95f4-e8d415146891">
              <SHORT-NAME>EthTrcv_SetTransceiverWakeupMode</SHORT-NAME>
              <SHORT-NAME-PATTERN />
              <SERVICE-ID>0x0d</SERVICE-ID>
              <IS-REENTRANT>false</IS-REENTRANT>
              <IS-SYNCHRONOUS>true</IS-SYNCHRONOUS>
              <CALL-TYPE>REGULAR</CALL-TYPE>
              <EXECUTION-CONTEXT>UNSPECIFIED</EXECUTION-CONTEXT>
              <SW-SERVICE-IMPL-POLICY>STANDARD</SW-SERVICE-IMPL-POLICY>
              <BSW-ENTRY-KIND>CONCRETE</BSW-ENTRY-KIND>
            </BSW-MODULE-ENTRY>
            <BSW-MODULE-ENTRY UUID="28483c61-5809-4d1b-9002-24014db80633">
              <SHORT-NAME>EthTrcv_GetTransceiverWakeupMode</SHORT-NAME>
              <SHORT-NAME-PATTERN />
              <SERVICE-ID>0x0e</SERVICE-ID>
              <IS-REENTRANT>false</IS-REENTRANT>
              <IS-SYNCHRONOUS>true</IS-SYNCHRONOUS>
              <CALL-TYPE>REGULAR</CALL-TYPE>
              <EXECUTION-CONTEXT>UNSPECIFIED</EXECUTION-CONTEXT>
              <SW-SERVICE-IMPL-POLICY>STANDARD</SW-SERVICE-IMPL-POLICY>
              <BSW-ENTRY-KIND>CONCRETE</BSW-ENTRY-KIND>
            </BSW-MODULE-ENTRY>
            <BSW-MODULE-ENTRY UUID="e2436b1e-8b39-4951-8852-10d735be0a60">
              <SHORT-NAME>EthTrcv_CheckWakeup</SHORT-NAME>
              <SHORT-NAME-PATTERN />
              <SERVICE-ID>0x0f</SERVICE-ID>
              <IS-REENTRANT>true</IS-REENTRANT>
              <IS-SYNCHRONOUS>true</IS-SYNCHRONOUS>
              <CALL-TYPE>REGULAR</CALL-TYPE>
              <EXECUTION-CONTEXT>UNSPECIFIED</EXECUTION-CONTEXT>
              <SW-SERVICE-IMPL-POLICY>STANDARD</SW-SERVICE-IMPL-POLICY>
              <BSW-ENTRY-KIND>CONCRETE</BSW-ENTRY-KIND>
            </BSW-MODULE-ENTRY>
            <BSW-MODULE-ENTRY UUID="3aa567af-f67a-4242-83d2-fb449c151bf6">
              <SHORT-NAME>EthTrcv_StartAutoNegotiation</SHORT-NAME>
              <SHORT-NAME-PATTERN />
              <SERVICE-ID>0x05</SERVICE-ID>
              <IS-REENTRANT>false</IS-REENTRANT>
              <IS-SYNCHRONOUS>true</IS-SYNCHRONOUS>
              <CALL-TYPE>REGULAR</CALL-TYPE>
              <EXECUTION-CONTEXT>UNSPECIFIED</EXECUTION-CONTEXT>
              <SW-SERVICE-IMPL-POLICY>STANDARD</SW-SERVICE-IMPL-POLICY>
              <BSW-ENTRY-KIND>CONCRETE</BSW-ENTRY-KIND>
            </BSW-MODULE-ENTRY>
            <BSW-MODULE-ENTRY UUID="19f465ca-93cc-4158-8b60-756def8c38a2">
              <SHORT-NAME>EthTrcv_GetLinkState</SHORT-NAME>
              <SHORT-NAME-PATTERN />
              <SERVICE-ID>0x06</SERVICE-ID>
              <IS-REENTRANT>false</IS-REENTRANT>
              <IS-SYNCHRONOUS>true</IS-SYNCHRONOUS>
              <CALL-TYPE>REGULAR</CALL-TYPE>
              <EXECUTION-CONTEXT>UNSPECIFIED</EXECUTION-CONTEXT>
              <SW-SERVICE-IMPL-POLICY>STANDARD</SW-SERVICE-IMPL-POLICY>
              <BSW-ENTRY-KIND>CONCRETE</BSW-ENTRY-KIND>
            </BSW-MODULE-ENTRY>
            <BSW-MODULE-ENTRY UUID="5b76727b-377d-480e-93b4-093cc6324ed6">
              <SHORT-NAME>EthTrcv_GetBaudRate</SHORT-NAME>
              <SHORT-NAME-PATTERN />
              <SERVICE-ID>0x07</SERVICE-ID>
              <IS-REENTRANT>false</IS-REENTRANT>
              <IS-SYNCHRONOUS>true</IS-SYNCHRONOUS>
              <CALL-TYPE>REGULAR</CALL-TYPE>
              <EXECUTION-CONTEXT>UNSPECIFIED</EXECUTION-CONTEXT>
              <SW-SERVICE-IMPL-POLICY>STANDARD</SW-SERVICE-IMPL-POLICY>
              <BSW-ENTRY-KIND>CONCRETE</BSW-ENTRY-KIND>
            </BSW-MODULE-ENTRY>
            <BSW-MODULE-ENTRY UUID="4a428a17-a30d-401e-9e59-b0eb9f147197">
              <SHORT-NAME>EthTrcv_GetDuplexMode</SHORT-NAME>
              <SHORT-NAME-PATTERN />
              <SERVICE-ID>0x08</SERVICE-ID>
              <IS-REENTRANT>false</IS-REENTRANT>
              <IS-SYNCHRONOUS>true</IS-SYNCHRONOUS>
              <CALL-TYPE>REGULAR</CALL-TYPE>
              <EXECUTION-CONTEXT>UNSPECIFIED</EXECUTION-CONTEXT>
              <SW-SERVICE-IMPL-POLICY>STANDARD</SW-SERVICE-IMPL-POLICY>
              <BSW-ENTRY-KIND>CONCRETE</BSW-ENTRY-KIND>
            </BSW-MODULE-ENTRY>
            <BSW-MODULE-ENTRY UUID="63f081b7-461e-45dd-a831-e6affc3d5d5d">
              <SHORT-NAME>EthTrcv_SetPhyTestMode</SHORT-NAME>
              <SHORT-NAME-PATTERN />
              <SERVICE-ID>0x11</SERVICE-ID>
              <IS-REENTRANT>false</IS-REENTRANT>
              <IS-SYNCHRONOUS>true</IS-SYNCHRONOUS>
              <CALL-TYPE>REGULAR</CALL-TYPE>
              <EXECUTION-CONTEXT>UNSPECIFIED</EXECUTION-CONTEXT>
              <SW-SERVICE-IMPL-POLICY>STANDARD</SW-SERVICE-IMPL-POLICY>
              <BSW-ENTRY-KIND>CONCRETE</BSW-ENTRY-KIND>
            </BSW-MODULE-ENTRY>
            <BSW-MODULE-ENTRY UUID="8b12d3cf-8035-4084-899e-c5baf67453b6">
              <SHORT-NAME>EthTrcv_SetPhyLoopbackMode</SHORT-NAME>
              <SHORT-NAME-PATTERN />
              <SERVICE-ID>0x12</SERVICE-ID>
              <IS-REENTRANT>false</IS-REENTRANT>
              <IS-SYNCHRONOUS>true</IS-SYNCHRONOUS>
              <CALL-TYPE>REGULAR</CALL-TYPE>
              <EXECUTION-CONTEXT>UNSPECIFIED</EXECUTION-CONTEXT>
              <SW-SERVICE-IMPL-POLICY>STANDARD</SW-SERVICE-IMPL-POLICY>
              <BSW-ENTRY-KIND>CONCRETE</BSW-ENTRY-KIND>
            </BSW-MODULE-ENTRY>
            <BSW-MODULE-ENTRY UUID="7f300eaa-4ff6-4809-a212-aa1d9495d243">
              <SHORT-NAME>EthTrcv_GetPhySignalQuality</SHORT-NAME>
              <SHORT-NAME-PATTERN />
              <SERVICE-ID>0x10</SERVICE-ID>
              <IS-REENTRANT>false</IS-REENTRANT>
              <IS-SYNCHRONOUS>true</IS-SYNCHRONOUS>
              <CALL-TYPE>REGULAR</CALL-TYPE>
              <EXECUTION-CONTEXT>UNSPECIFIED</EXECUTION-CONTEXT>
              <SW-SERVICE-IMPL-POLICY>STANDARD</SW-SERVICE-IMPL-POLICY>
              <BSW-ENTRY-KIND>CONCRETE</BSW-ENTRY-KIND>
            </BSW-MODULE-ENTRY>
            <BSW-MODULE-ENTRY UUID="ce0bd13e-d859-46f0-8b38-e4f9e345c675">
              <SHORT-NAME>EthTrcv_SetPhyTxMode</SHORT-NAME>
              <SHORT-NAME-PATTERN />
              <SERVICE-ID>0x13</SERVICE-ID>
              <IS-REENTRANT>false</IS-REENTRANT>
              <IS-SYNCHRONOUS>true</IS-SYNCHRONOUS>
              <CALL-TYPE>REGULAR</CALL-TYPE>
              <EXECUTION-CONTEXT>UNSPECIFIED</EXECUTION-CONTEXT>
              <SW-SERVICE-IMPL-POLICY>STANDARD</SW-SERVICE-IMPL-POLICY>
              <BSW-ENTRY-KIND>CONCRETE</BSW-ENTRY-KIND>
            </BSW-MODULE-ENTRY>
            <BSW-MODULE-ENTRY UUID="498acc17-c44e-4adb-9f64-3c672982dd13">
              <SHORT-NAME>EthTrcv_GetCableDiagnosticsResult</SHORT-NAME>
              <SHORT-NAME-PATTERN />
              <SERVICE-ID>0x14</SERVICE-ID>
              <IS-REENTRANT>false</IS-REENTRANT>
              <IS-SYNCHRONOUS>true</IS-SYNCHRONOUS>
              <CALL-TYPE>REGULAR</CALL-TYPE>
              <EXECUTION-CONTEXT>UNSPECIFIED</EXECUTION-CONTEXT>
              <SW-SERVICE-IMPL-POLICY>STANDARD</SW-SERVICE-IMPL-POLICY>
              <BSW-ENTRY-KIND>CONCRETE</BSW-ENTRY-KIND>
            </BSW-MODULE-ENTRY>
            <BSW-MODULE-ENTRY UUID="928a2c6c-9ec3-4984-9776-b790e2601f7f">
              <SHORT-NAME>EthTrcv_GetPhyIdentifier</SHORT-NAME>
              <SHORT-NAME-PATTERN />
              <SERVICE-ID>0x15</SERVICE-ID>
              <IS-REENTRANT>false</IS-REENTRANT>
              <IS-SYNCHRONOUS>true</IS-SYNCHRONOUS>
              <CALL-TYPE>REGULAR</CALL-TYPE>
              <EXECUTION-CONTEXT>UNSPECIFIED</EXECUTION-CONTEXT>
              <SW-SERVICE-IMPL-POLICY>STANDARD</SW-SERVICE-IMPL-POLICY>
              <BSW-ENTRY-KIND>CONCRETE</BSW-ENTRY-KIND>
            </BSW-MODULE-ENTRY>
            <BSW-MODULE-ENTRY UUID="dcc6b7d9-ce4e-4ea9-bf8d-1c2463b1643c">
              <SHORT-NAME>EthTrcv_ReadMiiIndication</SHORT-NAME>
              <SHORT-NAME-PATTERN />
              <SERVICE-ID>0x09</SERVICE-ID>
              <IS-REENTRANT>false</IS-REENTRANT>
              <IS-SYNCHRONOUS>true</IS-SYNCHRONOUS>
              <CALL-TYPE>REGULAR</CALL-TYPE>
              <EXECUTION-CONTEXT>UNSPECIFIED</EXECUTION-CONTEXT>
              <SW-SERVICE-IMPL-POLICY>STANDARD</SW-SERVICE-IMPL-POLICY>
              <BSW-ENTRY-KIND>CONCRETE</BSW-ENTRY-KIND>
            </BSW-MODULE-ENTRY>
            <BSW-MODULE-ENTRY UUID="049d44a2-9238-4175-8b32-1936b1583602">
              <SHORT-NAME>EthTrcv_WriteMiiIndication</SHORT-NAME>
              <SHORT-NAME-PATTERN />
              <SERVICE-ID>0x0a</SERVICE-ID>
              <IS-REENTRANT>false</IS-REENTRANT>
              <IS-SYNCHRONOUS>true</IS-SYNCHRONOUS>
              <CALL-TYPE>REGULAR</CALL-TYPE>
              <EXECUTION-CONTEXT>UNSPECIFIED</EXECUTION-CONTEXT>
              <SW-SERVICE-IMPL-POLICY>STANDARD</SW-SERVICE-IMPL-POLICY>
              <BSW-ENTRY-KIND>CONCRETE</BSW-ENTRY-KIND>
            </BSW-MODULE-ENTRY>
            <BSW-MODULE-ENTRY UUID="74599029-869b-4dc4-af70-af3966554b10">
              <SHORT-NAME>EthTrcv_MainFunction</SHORT-NAME>
              <SHORT-NAME-PATTERN />
              <SERVICE-ID>0x0c</SERVICE-ID>
              <IS-REENTRANT>false</IS-REENTRANT>
              <IS-SYNCHRONOUS>true</IS-SYNCHRONOUS>
              <CALL-TYPE>SCHEDULED</CALL-TYPE>
              <EXECUTION-CONTEXT>TASK</EXECUTION-CONTEXT>
              <SW-SERVICE-IMPL-POLICY>STANDARD</SW-SERVICE-IMPL-POLICY>
              <BSW-ENTRY-KIND>CONCRETE</BSW-ENTRY-KIND>
            </BSW-MODULE-ENTRY>
          </ELEMENTS>
        </AR-PACKAGE>
      </AR-PACKAGES>
    </AR-PACKAGE>
  </AR-PACKAGES>
[!ENDSELECT!]
</AUTOSAR>
