[!VAR "Txpolling" = "'0'"!][!//
[!VAR "Rxpolling" = "'0'"!][!//
[!VAR "BusOffpolling" = "'0'"!][!//
[!VAR "WakeUppolling" = "'0'"!][!//
[!LOOP "as:modconf('Can')[1]/CanConfigSet/CanController/*"!][!//
[!IF "CanRxProcessing = 'POLLING' or CanRxProcessing = 'MIXED' "!][!//
[!VAR "Rxpolling" = "$Rxpolling+1"!][!//
[!ENDIF!][!//
[!IF "CanTxProcessing = 'POLLING' or CanTxProcessing = 'MIXED' "!][!//
[!VAR "Txpolling" = "$Txpolling+1"!][!//
[!ENDIF!][!//
[!IF "CanBusoffProcessing = 'POLLING' "!][!//
[!VAR "BusOffpolling" = "$BusOffpolling+1"!][!//
[!ENDIF!][!//
[!IF "CanWakeupProcessing = 'POLLING' "!][!//
[!VAR "WakeUppolling" = "$WakeUppolling+1"!][!//
[!ENDIF!][!//
[!ENDLOOP!][!//
<?xml version="1.0" encoding="UTF-8"?>
[!AUTOSPACING!][!//
<AUTOSAR xmlns="http://autosar.org/schema/r4.0" xmlns:xsi="http://www.w3.org/2001/XMLSchema-instance" xsi:schemaLocation="http://autosar.org/schema/r4.0 AUTOSAR_00044.xsd">
  <AR-PACKAGES>
    <AR-PACKAGE UUID="2da4a9c6-dcb8-4a7d-91a0-3970a368b2ae">
      <SHORT-NAME>Can_TI_AM263Px</SHORT-NAME>
      <ELEMENTS>
        <BSW-MODULE-DESCRIPTION UUID="f10365d7-7bbc-479a-8d68-b489f92a46d9">
          <SHORT-NAME>Can</SHORT-NAME>
          <CATEGORY>BSW_MODULE</CATEGORY>
          <IMPLEMENTED-ENTRYS>
          [!LOOP "as:modconf('Can')[1]/CanConfigSet/CanController/*"!][!//
          [!IF "CanControllerInstance = 'MCAN0'"!][!//
            <BSW-MODULE-ENTRY-REF-CONDITIONAL>
              <BSW-MODULE-ENTRY-REF DEST="BSW-MODULE-ENTRY">/Can_TI_AM263Px/Can_ModuleEntry/Can_0_Int0ISR</BSW-MODULE-ENTRY-REF>
            </BSW-MODULE-ENTRY-REF-CONDITIONAL>
          [!ENDIF!][!//
          [!IF "CanControllerInstance = 'MCAN1'"!][!//
            <BSW-MODULE-ENTRY-REF-CONDITIONAL>
              <BSW-MODULE-ENTRY-REF DEST="BSW-MODULE-ENTRY">/Can_TI_AM263Px/Can_ModuleEntry/Can_1_Int0ISR</BSW-MODULE-ENTRY-REF>
            </BSW-MODULE-ENTRY-REF-CONDITIONAL>
          [!ENDIF!][!//
          [!IF "CanControllerInstance = 'MCAN2'"!][!//
            <BSW-MODULE-ENTRY-REF-CONDITIONAL>
              <BSW-MODULE-ENTRY-REF DEST="BSW-MODULE-ENTRY">/Can_TI_AM263Px/Can_ModuleEntry/Can_2_Int0ISR</BSW-MODULE-ENTRY-REF>
            </BSW-MODULE-ENTRY-REF-CONDITIONAL>
          [!ENDIF!][!//
          [!IF "CanControllerInstance = 'MCAN3'"!][!//
            <BSW-MODULE-ENTRY-REF-CONDITIONAL>
              <BSW-MODULE-ENTRY-REF DEST="BSW-MODULE-ENTRY">/Can_TI_AM263Px/Can_ModuleEntry/Can_3_Int0ISR</BSW-MODULE-ENTRY-REF>
            </BSW-MODULE-ENTRY-REF-CONDITIONAL>
          [!ENDIF!][!//
          [!IF "CanControllerInstance = 'MCAN4'"!][!//
            <BSW-MODULE-ENTRY-REF-CONDITIONAL>
              <BSW-MODULE-ENTRY-REF DEST="BSW-MODULE-ENTRY">/Can_TI_AM263Px/Can_ModuleEntry/Can_4_Int0ISR</BSW-MODULE-ENTRY-REF>
            </BSW-MODULE-ENTRY-REF-CONDITIONAL>
          [!ENDIF!][!//
          [!IF "CanControllerInstance = 'MCAN5'"!][!//
            <BSW-MODULE-ENTRY-REF-CONDITIONAL>
              <BSW-MODULE-ENTRY-REF DEST="BSW-MODULE-ENTRY">/Can_TI_AM263Px/Can_ModuleEntry/Can_5_Int0ISR</BSW-MODULE-ENTRY-REF>
            </BSW-MODULE-ENTRY-REF-CONDITIONAL>
          [!ENDIF!][!//
          [!IF "CanControllerInstance = 'MCAN6'"!][!//
            <BSW-MODULE-ENTRY-REF-CONDITIONAL>
              <BSW-MODULE-ENTRY-REF DEST="BSW-MODULE-ENTRY">/Can_TI_AM263Px/Can_ModuleEntry/Can_6_Int0ISR</BSW-MODULE-ENTRY-REF>
            </BSW-MODULE-ENTRY-REF-CONDITIONAL>
          [!ENDIF!][!//
          [!IF "CanControllerInstance = 'MCAN7'"!][!//
            <BSW-MODULE-ENTRY-REF-CONDITIONAL>
              <BSW-MODULE-ENTRY-REF DEST="BSW-MODULE-ENTRY">/Can_TI_AM263Px/Can_ModuleEntry/Can_7_Int0ISR</BSW-MODULE-ENTRY-REF>
            </BSW-MODULE-ENTRY-REF-CONDITIONAL>
          [!ENDIF!][!//
          [!ENDLOOP!][!//
          [!IF "count(as:modconf('Can')[1]/CanConfigSet/CanController/*[CanWakeupFunctionalityAPI = 'true']) > 0"!][!//
            <BSW-MODULE-ENTRY-REF-CONDITIONAL>
              <BSW-MODULE-ENTRY-REF DEST="BSW-MODULE-ENTRY">/Can_TI_AM263Px/Can_ModuleEntry/Can_CheckWakeup</BSW-MODULE-ENTRY-REF>
            </BSW-MODULE-ENTRY-REF-CONDITIONAL>
          [!ENDIF!][!//
          [!IF "as:modconf('Can')[1]/CanGeneral/CanDeInitApi = 'true'"!][!//
            <BSW-MODULE-ENTRY-REF-CONDITIONAL>
              <BSW-MODULE-ENTRY-REF DEST="BSW-MODULE-ENTRY">/Can_TI_AM263Px/Can_ModuleEntry/Can_DeInit</BSW-MODULE-ENTRY-REF>
            </BSW-MODULE-ENTRY-REF-CONDITIONAL>
          [!ENDIF!][!//
            <BSW-MODULE-ENTRY-REF-CONDITIONAL>
              <BSW-MODULE-ENTRY-REF DEST="BSW-MODULE-ENTRY">/Can_TI_AM263Px/Can_ModuleEntry/Can_DisableControllerInterrupts</BSW-MODULE-ENTRY-REF>
            </BSW-MODULE-ENTRY-REF-CONDITIONAL>
            <BSW-MODULE-ENTRY-REF-CONDITIONAL>
              <BSW-MODULE-ENTRY-REF DEST="BSW-MODULE-ENTRY">/Can_TI_AM263Px/Can_ModuleEntry/Can_EnableControllerInterrupts</BSW-MODULE-ENTRY-REF>
            </BSW-MODULE-ENTRY-REF-CONDITIONAL>
            <BSW-MODULE-ENTRY-REF-CONDITIONAL>
              <BSW-MODULE-ENTRY-REF DEST="BSW-MODULE-ENTRY">/Can_TI_AM263Px/Can_ModuleEntry/Can_GetControllerErrorState</BSW-MODULE-ENTRY-REF>
            </BSW-MODULE-ENTRY-REF-CONDITIONAL>
            <BSW-MODULE-ENTRY-REF-CONDITIONAL>
              <BSW-MODULE-ENTRY-REF DEST="BSW-MODULE-ENTRY">/Can_TI_AM263Px/Can_ModuleEntry/Can_GetControllerMode</BSW-MODULE-ENTRY-REF>
            </BSW-MODULE-ENTRY-REF-CONDITIONAL>
          [!IF "as:modconf('Can')[1]/CanGeneral/CanVersionInfoApi = 'true'"!][!//
            <BSW-MODULE-ENTRY-REF-CONDITIONAL>
              <BSW-MODULE-ENTRY-REF DEST="BSW-MODULE-ENTRY">/Can_TI_AM263Px/Can_ModuleEntry/Can_GetVersionInfo</BSW-MODULE-ENTRY-REF>
            </BSW-MODULE-ENTRY-REF-CONDITIONAL>
          [!ENDIF!][!//
            <BSW-MODULE-ENTRY-REF-CONDITIONAL>
              <BSW-MODULE-ENTRY-REF DEST="BSW-MODULE-ENTRY">/Can_TI_AM263Px/Can_ModuleEntry/Can_Init</BSW-MODULE-ENTRY-REF>
            </BSW-MODULE-ENTRY-REF-CONDITIONAL>
          [!IF "$BusOffpolling != num:i(0)"!][!//
            <BSW-MODULE-ENTRY-REF-CONDITIONAL>
              <BSW-MODULE-ENTRY-REF DEST="BSW-MODULE-ENTRY">/Can_TI_AM263Px/Can_ModuleEntry/Can_MainFunction_BusOff</BSW-MODULE-ENTRY-REF>
            </BSW-MODULE-ENTRY-REF-CONDITIONAL>
          [!ENDIF!][!//
            <BSW-MODULE-ENTRY-REF-CONDITIONAL>
              <BSW-MODULE-ENTRY-REF DEST="BSW-MODULE-ENTRY">/Can_TI_AM263Px/Can_ModuleEntry/Can_MainFunction_Mode</BSW-MODULE-ENTRY-REF>
            </BSW-MODULE-ENTRY-REF-CONDITIONAL>
          [!IF "$Rxpolling != num:i(0)"!][!//
            <BSW-MODULE-ENTRY-REF-CONDITIONAL>
              <BSW-MODULE-ENTRY-REF DEST="BSW-MODULE-ENTRY">/Can_TI_AM263Px/Can_ModuleEntry/Can_MainFunction_Read</BSW-MODULE-ENTRY-REF>
            </BSW-MODULE-ENTRY-REF-CONDITIONAL>
          [!ENDIF!][!//
          [!IF "$WakeUppolling != num:i(0)"!][!//
            <BSW-MODULE-ENTRY-REF-CONDITIONAL>
              <BSW-MODULE-ENTRY-REF DEST="BSW-MODULE-ENTRY">/Can_TI_AM263Px/Can_ModuleEntry/Can_MainFunction_Wakeup</BSW-MODULE-ENTRY-REF>
            </BSW-MODULE-ENTRY-REF-CONDITIONAL>
          [!ENDIF!][!//
          [!IF "$Txpolling != num:i(0)"!][!//
            <BSW-MODULE-ENTRY-REF-CONDITIONAL>
              <BSW-MODULE-ENTRY-REF DEST="BSW-MODULE-ENTRY">/Can_TI_AM263Px/Can_ModuleEntry/Can_MainFunction_Write</BSW-MODULE-ENTRY-REF>
            </BSW-MODULE-ENTRY-REF-CONDITIONAL>
          [!ENDIF!][!//
          [!IF "as:modconf('Can')[1]/CanGeneral/CanRegisterReadbackAPI = 'true'"!][!//
            <BSW-MODULE-ENTRY-REF-CONDITIONAL>
              <BSW-MODULE-ENTRY-REF DEST="BSW-MODULE-ENTRY">/Can_TI_AM263Px/Can_ModuleEntry/Can_RegisterReadback</BSW-MODULE-ENTRY-REF>
            </BSW-MODULE-ENTRY-REF-CONDITIONAL>
          [!ENDIF!][!//
          [!IF "as:modconf('Can')[1]/CanGeneral/CanSetBaudrateApi = 'true'"!][!//
            <BSW-MODULE-ENTRY-REF-CONDITIONAL>
              <BSW-MODULE-ENTRY-REF DEST="BSW-MODULE-ENTRY">/Can_TI_AM263Px/Can_ModuleEntry/Can_SetBaudrate</BSW-MODULE-ENTRY-REF>
            </BSW-MODULE-ENTRY-REF-CONDITIONAL>
          [!ENDIF!][!//
            <BSW-MODULE-ENTRY-REF-CONDITIONAL>
              <BSW-MODULE-ENTRY-REF DEST="BSW-MODULE-ENTRY">/Can_TI_AM263Px/Can_ModuleEntry/Can_SetControllerMode</BSW-MODULE-ENTRY-REF>
            </BSW-MODULE-ENTRY-REF-CONDITIONAL>
          [!IF "as:modconf('Can')[1]/CanGeneral/CanLoopBackTest_Enable = 'true'"!][!//
            <BSW-MODULE-ENTRY-REF-CONDITIONAL>
              <BSW-MODULE-ENTRY-REF DEST="BSW-MODULE-ENTRY">/Can_TI_AM263Px/Can_ModuleEntry/Can_TestLoopBackModeDisable</BSW-MODULE-ENTRY-REF>
            </BSW-MODULE-ENTRY-REF-CONDITIONAL>
            <BSW-MODULE-ENTRY-REF-CONDITIONAL>
              <BSW-MODULE-ENTRY-REF DEST="BSW-MODULE-ENTRY">/Can_TI_AM263Px/Can_ModuleEntry/Can_TestLoopBackModeEnable</BSW-MODULE-ENTRY-REF>
            </BSW-MODULE-ENTRY-REF-CONDITIONAL>
          [!ENDIF!][!//
            <BSW-MODULE-ENTRY-REF-CONDITIONAL>
              <BSW-MODULE-ENTRY-REF DEST="BSW-MODULE-ENTRY">/Can_TI_AM263Px/Can_ModuleEntry/Can_Write</BSW-MODULE-ENTRY-REF>
            </BSW-MODULE-ENTRY-REF-CONDITIONAL>
          </IMPLEMENTED-ENTRYS>
          <MODULE-ID>80</MODULE-ID>
          <BSW-MODULE-DEPENDENCYS>
            <BSW-MODULE-DEPENDENCY UUID="ed6d0c22-58ff-45dd-9f2b-66aa5b33b39b">
              <SHORT-NAME>CanIf</SHORT-NAME>
              <TARGET-MODULE-ID>60</TARGET-MODULE-ID>
              <TARGET-MODULE-REFS>
                <BSW-MODULE-DESCRIPTION-REF-CONDITIONAL>
                  <BSW-MODULE-DESCRIPTION-REF DEST="BSW-MODULE-DESCRIPTION">/AUTOSAR_CanIf/CanIf</BSW-MODULE-DESCRIPTION-REF>
                </BSW-MODULE-DESCRIPTION-REF-CONDITIONAL>
              </TARGET-MODULE-REFS>
            </BSW-MODULE-DEPENDENCY>
            <BSW-MODULE-DEPENDENCY UUID="921299a5-07e4-4bc5-a5e0-695e1b1c1ba6">
              <SHORT-NAME>Dem</SHORT-NAME>
              <TARGET-MODULE-ID>54</TARGET-MODULE-ID>
              <TARGET-MODULE-REFS>
                <BSW-MODULE-DESCRIPTION-REF-CONDITIONAL>
                  <BSW-MODULE-DESCRIPTION-REF DEST="BSW-MODULE-DESCRIPTION">/AUTOSAR_Dem/Dem</BSW-MODULE-DESCRIPTION-REF>
                </BSW-MODULE-DESCRIPTION-REF-CONDITIONAL>
              </TARGET-MODULE-REFS>
            </BSW-MODULE-DEPENDENCY>
            <BSW-MODULE-DEPENDENCY UUID="921299a5-07e4-4bc5-a5e0-695e1b1c1ba5">
              <SHORT-NAME>Det</SHORT-NAME>
              <TARGET-MODULE-ID>15</TARGET-MODULE-ID>
              <TARGET-MODULE-REFS>
                <BSW-MODULE-DESCRIPTION-REF-CONDITIONAL>
                  <BSW-MODULE-DESCRIPTION-REF DEST="BSW-MODULE-DESCRIPTION">/AUTOSAR_Det/Det</BSW-MODULE-DESCRIPTION-REF>
                </BSW-MODULE-DESCRIPTION-REF-CONDITIONAL>
              </TARGET-MODULE-REFS>
            </BSW-MODULE-DEPENDENCY>
          </BSW-MODULE-DEPENDENCYS>
          <INTERNAL-BEHAVIORS>
            <BSW-INTERNAL-BEHAVIOR UUID="08c7871b-5e99-4611-9a00-06a369df7e86">
              <SHORT-NAME>Can_Behavior</SHORT-NAME>
              <EXCLUSIVE-AREAS>
                <EXCLUSIVE-AREA UUID="4fc38db4-f789-41ad-baac-f5c8fc007188">
                  <SHORT-NAME>CAN_EXCLUSIVE_AREA_0</SHORT-NAME>
                </EXCLUSIVE-AREA>
              </EXCLUSIVE-AREAS>
              <ENTITYS>
              [!LOOP "as:modconf('Can')[1]/CanConfigSet/CanController/*"!][!//
              [!IF "CanControllerInstance = 'MCAN0'"!][!//
                <BSW-INTERRUPT-ENTITY UUID="6e81150d-4167-46a0-8ebe-3ae8210e9ba9">
                  <SHORT-NAME>Can_0_Int0ISR</SHORT-NAME>
                  <MINIMUM-START-INTERVAL>0.0</MINIMUM-START-INTERVAL>
                  <REENTRANCY-LEVEL>NON-REENTRANT</REENTRANCY-LEVEL>
                  <CALL-POINTS>
                    <BSW-DIRECT-CALL-POINT>
                      <SHORT-NAME>CanIf_TxConfirmation</SHORT-NAME>
                      <CALLED-ENTRY-REF DEST="BSW-MODULE-ENTRY">/AUTOSAR_CanIf/BSWModuleEntry/CanIf_TxConfirmation</CALLED-ENTRY-REF>
                    </BSW-DIRECT-CALL-POINT>
                    <BSW-DIRECT-CALL-POINT>
                      <SHORT-NAME>CanIf_RxIndication</SHORT-NAME>
                      <CALLED-ENTRY-REF DEST="BSW-MODULE-ENTRY">/AUTOSAR_CanIf/BSWModuleEntry/CanIf_RxIndication</CALLED-ENTRY-REF>
                    </BSW-DIRECT-CALL-POINT>
                    <BSW-DIRECT-CALL-POINT>
                      <SHORT-NAME>CanIf_ControllerBusOff</SHORT-NAME>
                      <CALLED-ENTRY-REF DEST="BSW-MODULE-ENTRY">/AUTOSAR_CanIf/BSWModuleEntry/CanIf_ControllerBusOff</CALLED-ENTRY-REF>
                    </BSW-DIRECT-CALL-POINT>
                    <BSW-DIRECT-CALL-POINT>
                      <SHORT-NAME>Dem_SetEventStatus</SHORT-NAME>
                      <CALLED-ENTRY-REF DEST="BSW-MODULE-ENTRY">/AUTOSAR_Dem/BSWModuleEntry/Dem_SetEventStatus</CALLED-ENTRY-REF>
                    </BSW-DIRECT-CALL-POINT>
                  [!IF "as:modconf('Can')[1]/CanGeneral/CanDevErrorDetect = 'true'"!][!//
                    <BSW-DIRECT-CALL-POINT>
                      <SHORT-NAME>Det_ReportRuntimeError</SHORT-NAME>
                      <CALLED-ENTRY-REF DEST="BSW-MODULE-ENTRY">/AUTOSAR_Det/BSWModuleEntry/Det_ReportRuntimeError</CALLED-ENTRY-REF>
                    </BSW-DIRECT-CALL-POINT>
                  [!ENDIF!][!//
                  </CALL-POINTS>
                  <IMPLEMENTED-ENTRY-REF DEST="BSW-MODULE-ENTRY">/Can_TI_AM263Px/Can_ModuleEntry/Can_0_Int0ISR</IMPLEMENTED-ENTRY-REF>
                  [!IF "as:modconf('Can')[1]/CanGeneral/CanTypeofInterruptFunction = 'CAN_ISR_CAT2'"!][!//
                  <INTERRUPT-CATEGORY>CAT-2</INTERRUPT-CATEGORY>
                  [!ELSE!][!//
                  <INTERRUPT-CATEGORY>CAT-1</INTERRUPT-CATEGORY>
                  [!ENDIF!][!//
                  <INTERRUPT-SOURCE>Hardware</INTERRUPT-SOURCE>
                </BSW-INTERRUPT-ENTITY>
              [!ENDIF!][!//
              [!IF "CanControllerInstance = 'MCAN1'"!][!//
                <BSW-INTERRUPT-ENTITY UUID="ac14fa3b-a94f-4fcc-97ce-afe493122c22">
                  <SHORT-NAME>Can_1_Int0ISR</SHORT-NAME>
                  <MINIMUM-START-INTERVAL>0.0</MINIMUM-START-INTERVAL>
                  <REENTRANCY-LEVEL>NON-REENTRANT</REENTRANCY-LEVEL>
                  <CALL-POINTS>
                    <BSW-DIRECT-CALL-POINT>
                      <SHORT-NAME>CanIf_TxConfirmation</SHORT-NAME>
                      <CALLED-ENTRY-REF DEST="BSW-MODULE-ENTRY">/AUTOSAR_CanIf/BSWModuleEntry/CanIf_TxConfirmation</CALLED-ENTRY-REF>
                    </BSW-DIRECT-CALL-POINT>
                    <BSW-DIRECT-CALL-POINT>
                      <SHORT-NAME>CanIf_RxIndication</SHORT-NAME>
                      <CALLED-ENTRY-REF DEST="BSW-MODULE-ENTRY">/AUTOSAR_CanIf/BSWModuleEntry/CanIf_RxIndication</CALLED-ENTRY-REF>
                    </BSW-DIRECT-CALL-POINT>
                    <BSW-DIRECT-CALL-POINT>
                      <SHORT-NAME>CanIf_ControllerBusOff</SHORT-NAME>
                      <CALLED-ENTRY-REF DEST="BSW-MODULE-ENTRY">/AUTOSAR_CanIf/BSWModuleEntry/CanIf_ControllerBusOff</CALLED-ENTRY-REF>
                    </BSW-DIRECT-CALL-POINT>
                    <BSW-DIRECT-CALL-POINT>
                      <SHORT-NAME>Dem_SetEventStatus</SHORT-NAME>
                      <CALLED-ENTRY-REF DEST="BSW-MODULE-ENTRY">/AUTOSAR_Dem/BSWModuleEntry/Dem_SetEventStatus</CALLED-ENTRY-REF>
                    </BSW-DIRECT-CALL-POINT>
                  [!IF "as:modconf('Can')[1]/CanGeneral/CanDevErrorDetect = 'true'"!][!//
                    <BSW-DIRECT-CALL-POINT>
                      <SHORT-NAME>Det_ReportRuntimeError</SHORT-NAME>
                      <CALLED-ENTRY-REF DEST="BSW-MODULE-ENTRY">/AUTOSAR_Det/BSWModuleEntry/Det_ReportRuntimeError</CALLED-ENTRY-REF>
                    </BSW-DIRECT-CALL-POINT>
                  [!ENDIF!][!//
                  </CALL-POINTS>
                  <IMPLEMENTED-ENTRY-REF DEST="BSW-MODULE-ENTRY">/Can_TI_AM263Px/Can_ModuleEntry/Can_1_Int0ISR</IMPLEMENTED-ENTRY-REF>
                  [!IF "as:modconf('Can')[1]/CanGeneral/CanTypeofInterruptFunction = 'CAN_ISR_CAT2'"!][!//
                  <INTERRUPT-CATEGORY>CAT-2</INTERRUPT-CATEGORY>
                  [!ELSE!][!//
                  <INTERRUPT-CATEGORY>CAT-1</INTERRUPT-CATEGORY>
                  [!ENDIF!][!//
                  <INTERRUPT-SOURCE>Hardware</INTERRUPT-SOURCE>
                </BSW-INTERRUPT-ENTITY>
              [!ENDIF!][!//
              [!IF "CanControllerInstance = 'MCAN2'"!][!//
                <BSW-INTERRUPT-ENTITY UUID="32fdacd4-223c-401d-9c48-02a701a26926">
                  <SHORT-NAME>Can_2_Int0ISR</SHORT-NAME>
                  <MINIMUM-START-INTERVAL>0.0</MINIMUM-START-INTERVAL>
                  <REENTRANCY-LEVEL>NON-REENTRANT</REENTRANCY-LEVEL>
                  <CALL-POINTS>
                    <BSW-DIRECT-CALL-POINT>
                      <SHORT-NAME>CanIf_TxConfirmation</SHORT-NAME>
                      <CALLED-ENTRY-REF DEST="BSW-MODULE-ENTRY">/AUTOSAR_CanIf/BSWModuleEntry/CanIf_TxConfirmation</CALLED-ENTRY-REF>
                    </BSW-DIRECT-CALL-POINT>
                    <BSW-DIRECT-CALL-POINT>
                      <SHORT-NAME>CanIf_RxIndication</SHORT-NAME>
                      <CALLED-ENTRY-REF DEST="BSW-MODULE-ENTRY">/AUTOSAR_CanIf/BSWModuleEntry/CanIf_RxIndication</CALLED-ENTRY-REF>
                    </BSW-DIRECT-CALL-POINT>
                    <BSW-DIRECT-CALL-POINT>
                      <SHORT-NAME>CanIf_ControllerBusOff</SHORT-NAME>
                      <CALLED-ENTRY-REF DEST="BSW-MODULE-ENTRY">/AUTOSAR_CanIf/BSWModuleEntry/CanIf_ControllerBusOff</CALLED-ENTRY-REF>
                    </BSW-DIRECT-CALL-POINT>
                    <BSW-DIRECT-CALL-POINT>
                      <SHORT-NAME>Dem_SetEventStatus</SHORT-NAME>
                      <CALLED-ENTRY-REF DEST="BSW-MODULE-ENTRY">/AUTOSAR_Dem/BSWModuleEntry/Dem_SetEventStatus</CALLED-ENTRY-REF>
                    </BSW-DIRECT-CALL-POINT>
                  [!IF "as:modconf('Can')[1]/CanGeneral/CanDevErrorDetect = 'true'"!][!//
                    <BSW-DIRECT-CALL-POINT>
                      <SHORT-NAME>Det_ReportRuntimeError</SHORT-NAME>
                      <CALLED-ENTRY-REF DEST="BSW-MODULE-ENTRY">/AUTOSAR_Det/BSWModuleEntry/Det_ReportRuntimeError</CALLED-ENTRY-REF>
                    </BSW-DIRECT-CALL-POINT>
                  [!ENDIF!][!//
                  </CALL-POINTS>
                  <IMPLEMENTED-ENTRY-REF DEST="BSW-MODULE-ENTRY">/Can_TI_AM263Px/Can_ModuleEntry/Can_2_Int0ISR</IMPLEMENTED-ENTRY-REF>
                  [!IF "as:modconf('Can')[1]/CanGeneral/CanTypeofInterruptFunction = 'CAN_ISR_CAT2'"!][!//
                  <INTERRUPT-CATEGORY>CAT-2</INTERRUPT-CATEGORY>
                  [!ELSE!][!//
                  <INTERRUPT-CATEGORY>CAT-1</INTERRUPT-CATEGORY>
                  [!ENDIF!][!//
                  <INTERRUPT-SOURCE>Hardware</INTERRUPT-SOURCE>
                </BSW-INTERRUPT-ENTITY>
              [!ENDIF!][!//
              [!IF "CanControllerInstance = 'MCAN3'"!][!//
                <BSW-INTERRUPT-ENTITY UUID="6e272686-e112-422a-a1ad-682919b2637b">
                  <SHORT-NAME>Can_3_Int0ISR</SHORT-NAME>
                  <MINIMUM-START-INTERVAL>0.0</MINIMUM-START-INTERVAL>
                  <REENTRANCY-LEVEL>NON-REENTRANT</REENTRANCY-LEVEL>
                  <CALL-POINTS>
                    <BSW-DIRECT-CALL-POINT>
                      <SHORT-NAME>CanIf_TxConfirmation</SHORT-NAME>
                      <CALLED-ENTRY-REF DEST="BSW-MODULE-ENTRY">/AUTOSAR_CanIf/BSWModuleEntry/CanIf_TxConfirmation</CALLED-ENTRY-REF>
                    </BSW-DIRECT-CALL-POINT>
                    <BSW-DIRECT-CALL-POINT>
                      <SHORT-NAME>CanIf_RxIndication</SHORT-NAME>
                      <CALLED-ENTRY-REF DEST="BSW-MODULE-ENTRY">/AUTOSAR_CanIf/BSWModuleEntry/CanIf_RxIndication</CALLED-ENTRY-REF>
                    </BSW-DIRECT-CALL-POINT>
                    <BSW-DIRECT-CALL-POINT>
                      <SHORT-NAME>CanIf_ControllerBusOff</SHORT-NAME>
                      <CALLED-ENTRY-REF DEST="BSW-MODULE-ENTRY">/AUTOSAR_CanIf/BSWModuleEntry/CanIf_ControllerBusOff</CALLED-ENTRY-REF>
                    </BSW-DIRECT-CALL-POINT>
                    <BSW-DIRECT-CALL-POINT>
                      <SHORT-NAME>Dem_SetEventStatus</SHORT-NAME>
                      <CALLED-ENTRY-REF DEST="BSW-MODULE-ENTRY">/AUTOSAR_Dem/BSWModuleEntry/Dem_SetEventStatus</CALLED-ENTRY-REF>
                    </BSW-DIRECT-CALL-POINT>
                  [!IF "as:modconf('Can')[1]/CanGeneral/CanDevErrorDetect = 'true'"!][!//
                    <BSW-DIRECT-CALL-POINT>
                      <SHORT-NAME>Det_ReportRuntimeError</SHORT-NAME>
                      <CALLED-ENTRY-REF DEST="BSW-MODULE-ENTRY">/AUTOSAR_Det/BSWModuleEntry/Det_ReportRuntimeError</CALLED-ENTRY-REF>
                    </BSW-DIRECT-CALL-POINT>
                  [!ENDIF!][!//
                  </CALL-POINTS>
                  <IMPLEMENTED-ENTRY-REF DEST="BSW-MODULE-ENTRY">/Can_TI_AM263Px/Can_ModuleEntry/Can_3_Int0ISR</IMPLEMENTED-ENTRY-REF>
                  [!IF "as:modconf('Can')[1]/CanGeneral/CanTypeofInterruptFunction = 'CAN_ISR_CAT2'"!][!//
                  <INTERRUPT-CATEGORY>CAT-2</INTERRUPT-CATEGORY>
                  [!ELSE!][!//
                  <INTERRUPT-CATEGORY>CAT-1</INTERRUPT-CATEGORY>
                  [!ENDIF!][!//
                  <INTERRUPT-SOURCE>Hardware</INTERRUPT-SOURCE>
                </BSW-INTERRUPT-ENTITY>
              [!ENDIF!][!//
              [!IF "CanControllerInstance = 'MCAN4'"!][!//
                <BSW-INTERRUPT-ENTITY UUID="889c192f-0aea-4f6d-8f8b-c7822151d5f3">
                  <SHORT-NAME>Can_4_Int0ISR</SHORT-NAME>
                  <MINIMUM-START-INTERVAL>0.0</MINIMUM-START-INTERVAL>
                  <REENTRANCY-LEVEL>NON-REENTRANT</REENTRANCY-LEVEL>
                  <CALL-POINTS>
                    <BSW-DIRECT-CALL-POINT>
                      <SHORT-NAME>CanIf_TxConfirmation</SHORT-NAME>
                      <CALLED-ENTRY-REF DEST="BSW-MODULE-ENTRY">/AUTOSAR_CanIf/BSWModuleEntry/CanIf_TxConfirmation</CALLED-ENTRY-REF>
                    </BSW-DIRECT-CALL-POINT>
                    <BSW-DIRECT-CALL-POINT>
                      <SHORT-NAME>CanIf_RxIndication</SHORT-NAME>
                      <CALLED-ENTRY-REF DEST="BSW-MODULE-ENTRY">/AUTOSAR_CanIf/BSWModuleEntry/CanIf_RxIndication</CALLED-ENTRY-REF>
                    </BSW-DIRECT-CALL-POINT>
                    <BSW-DIRECT-CALL-POINT>
                      <SHORT-NAME>CanIf_ControllerBusOff</SHORT-NAME>
                      <CALLED-ENTRY-REF DEST="BSW-MODULE-ENTRY">/AUTOSAR_CanIf/BSWModuleEntry/CanIf_ControllerBusOff</CALLED-ENTRY-REF>
                    </BSW-DIRECT-CALL-POINT>
                    <BSW-DIRECT-CALL-POINT>
                      <SHORT-NAME>Dem_SetEventStatus</SHORT-NAME>
                      <CALLED-ENTRY-REF DEST="BSW-MODULE-ENTRY">/AUTOSAR_Dem/BSWModuleEntry/Dem_SetEventStatus</CALLED-ENTRY-REF>
                    </BSW-DIRECT-CALL-POINT>
                  [!IF "as:modconf('Can')[1]/CanGeneral/CanDevErrorDetect = 'true'"!][!//
                    <BSW-DIRECT-CALL-POINT>
                      <SHORT-NAME>Det_ReportRuntimeError</SHORT-NAME>
                      <CALLED-ENTRY-REF DEST="BSW-MODULE-ENTRY">/AUTOSAR_Det/BSWModuleEntry/Det_ReportRuntimeError</CALLED-ENTRY-REF>
                    </BSW-DIRECT-CALL-POINT>
                  [!ENDIF!][!//
                  </CALL-POINTS>
                  <IMPLEMENTED-ENTRY-REF DEST="BSW-MODULE-ENTRY">/Can_TI_AM263Px/Can_ModuleEntry/Can_4_Int0ISR</IMPLEMENTED-ENTRY-REF>
                  [!IF "as:modconf('Can')[1]/CanGeneral/CanTypeofInterruptFunction = 'CAN_ISR_CAT2'"!][!//
                  <INTERRUPT-CATEGORY>CAT-2</INTERRUPT-CATEGORY>
                  [!ELSE!][!//
                  <INTERRUPT-CATEGORY>CAT-1</INTERRUPT-CATEGORY>
                  [!ENDIF!][!//
                  <INTERRUPT-SOURCE>Hardware</INTERRUPT-SOURCE>
                </BSW-INTERRUPT-ENTITY>
              [!ENDIF!][!//
              [!IF "CanControllerInstance = 'MCAN5'"!][!//
                <BSW-INTERRUPT-ENTITY UUID="6c71d80f-bb87-4566-9141-84d581f9110e">
                  <SHORT-NAME>Can_5_Int0ISR</SHORT-NAME>
                  <MINIMUM-START-INTERVAL>0.0</MINIMUM-START-INTERVAL>
                  <REENTRANCY-LEVEL>NON-REENTRANT</REENTRANCY-LEVEL>
                  <CALL-POINTS>
                    <BSW-DIRECT-CALL-POINT>
                      <SHORT-NAME>CanIf_TxConfirmation</SHORT-NAME>
                      <CALLED-ENTRY-REF DEST="BSW-MODULE-ENTRY">/AUTOSAR_CanIf/BSWModuleEntry/CanIf_TxConfirmation</CALLED-ENTRY-REF>
                    </BSW-DIRECT-CALL-POINT>
                    <BSW-DIRECT-CALL-POINT>
                      <SHORT-NAME>CanIf_RxIndication</SHORT-NAME>
                      <CALLED-ENTRY-REF DEST="BSW-MODULE-ENTRY">/AUTOSAR_CanIf/BSWModuleEntry/CanIf_RxIndication</CALLED-ENTRY-REF>
                    </BSW-DIRECT-CALL-POINT>
                    <BSW-DIRECT-CALL-POINT>
                      <SHORT-NAME>CanIf_ControllerBusOff</SHORT-NAME>
                      <CALLED-ENTRY-REF DEST="BSW-MODULE-ENTRY">/AUTOSAR_CanIf/BSWModuleEntry/CanIf_ControllerBusOff</CALLED-ENTRY-REF>
                    </BSW-DIRECT-CALL-POINT>
                    <BSW-DIRECT-CALL-POINT>
                      <SHORT-NAME>Dem_SetEventStatus</SHORT-NAME>
                      <CALLED-ENTRY-REF DEST="BSW-MODULE-ENTRY">/AUTOSAR_Dem/BSWModuleEntry/Dem_SetEventStatus</CALLED-ENTRY-REF>
                    </BSW-DIRECT-CALL-POINT>
                  [!IF "as:modconf('Can')[1]/CanGeneral/CanDevErrorDetect = 'true'"!][!//
                    <BSW-DIRECT-CALL-POINT>
                      <SHORT-NAME>Det_ReportRuntimeError</SHORT-NAME>
                      <CALLED-ENTRY-REF DEST="BSW-MODULE-ENTRY">/AUTOSAR_Det/BSWModuleEntry/Det_ReportRuntimeError</CALLED-ENTRY-REF>
                    </BSW-DIRECT-CALL-POINT>
                  [!ENDIF!][!//
                  </CALL-POINTS>
                  <IMPLEMENTED-ENTRY-REF DEST="BSW-MODULE-ENTRY">/Can_TI_AM263Px/Can_ModuleEntry/Can_5_Int0ISR</IMPLEMENTED-ENTRY-REF>
                  [!IF "as:modconf('Can')[1]/CanGeneral/CanTypeofInterruptFunction = 'CAN_ISR_CAT2'"!][!//
                  <INTERRUPT-CATEGORY>CAT-2</INTERRUPT-CATEGORY>
                  [!ELSE!][!//
                  <INTERRUPT-CATEGORY>CAT-1</INTERRUPT-CATEGORY>
                  [!ENDIF!][!//
                  <INTERRUPT-SOURCE>Hardware</INTERRUPT-SOURCE>
                </BSW-INTERRUPT-ENTITY>
              [!ENDIF!][!//
              [!IF "CanControllerInstance = 'MCAN6'"!][!//
                <BSW-INTERRUPT-ENTITY UUID="37c15542-a251-43d5-a1ee-3d2457db5a51">
                  <SHORT-NAME>Can_6_Int0ISR</SHORT-NAME>
                  <MINIMUM-START-INTERVAL>0.0</MINIMUM-START-INTERVAL>
                  <REENTRANCY-LEVEL>NON-REENTRANT</REENTRANCY-LEVEL>
                  <CALL-POINTS>
                    <BSW-DIRECT-CALL-POINT>
                      <SHORT-NAME>CanIf_TxConfirmation</SHORT-NAME>
                      <CALLED-ENTRY-REF DEST="BSW-MODULE-ENTRY">/AUTOSAR_CanIf/BSWModuleEntry/CanIf_TxConfirmation</CALLED-ENTRY-REF>
                    </BSW-DIRECT-CALL-POINT>
                    <BSW-DIRECT-CALL-POINT>
                      <SHORT-NAME>CanIf_RxIndication</SHORT-NAME>
                      <CALLED-ENTRY-REF DEST="BSW-MODULE-ENTRY">/AUTOSAR_CanIf/BSWModuleEntry/CanIf_RxIndication</CALLED-ENTRY-REF>
                    </BSW-DIRECT-CALL-POINT>
                    <BSW-DIRECT-CALL-POINT>
                      <SHORT-NAME>CanIf_ControllerBusOff</SHORT-NAME>
                      <CALLED-ENTRY-REF DEST="BSW-MODULE-ENTRY">/AUTOSAR_CanIf/BSWModuleEntry/CanIf_ControllerBusOff</CALLED-ENTRY-REF>
                    </BSW-DIRECT-CALL-POINT>
                    <BSW-DIRECT-CALL-POINT>
                      <SHORT-NAME>Dem_SetEventStatus</SHORT-NAME>
                      <CALLED-ENTRY-REF DEST="BSW-MODULE-ENTRY">/AUTOSAR_Dem/BSWModuleEntry/Dem_SetEventStatus</CALLED-ENTRY-REF>
                    </BSW-DIRECT-CALL-POINT>
                  [!IF "as:modconf('Can')[1]/CanGeneral/CanDevErrorDetect = 'true'"!][!//
                    <BSW-DIRECT-CALL-POINT>
                      <SHORT-NAME>Det_ReportRuntimeError</SHORT-NAME>
                      <CALLED-ENTRY-REF DEST="BSW-MODULE-ENTRY">/AUTOSAR_Det/BSWModuleEntry/Det_ReportRuntimeError</CALLED-ENTRY-REF>
                    </BSW-DIRECT-CALL-POINT>
                  [!ENDIF!][!//
                  </CALL-POINTS>
                  <IMPLEMENTED-ENTRY-REF DEST="BSW-MODULE-ENTRY">/Can_TI_AM263Px/Can_ModuleEntry/Can_6_Int0ISR</IMPLEMENTED-ENTRY-REF>
                  [!IF "as:modconf('Can')[1]/CanGeneral/CanTypeofInterruptFunction = 'CAN_ISR_CAT2'"!][!//
                  <INTERRUPT-CATEGORY>CAT-2</INTERRUPT-CATEGORY>
                  [!ELSE!][!//
                  <INTERRUPT-CATEGORY>CAT-1</INTERRUPT-CATEGORY>
                  [!ENDIF!][!//
                  <INTERRUPT-SOURCE>Hardware</INTERRUPT-SOURCE>
                </BSW-INTERRUPT-ENTITY>
              [!ENDIF!][!//
              [!IF "CanControllerInstance = 'MCAN7'"!][!//
                <BSW-INTERRUPT-ENTITY UUID="381cfaaa-da71-423a-954d-4033962e4390">
                  <SHORT-NAME>Can_7_Int0ISR</SHORT-NAME>
                  <MINIMUM-START-INTERVAL>0.0</MINIMUM-START-INTERVAL>
                  <REENTRANCY-LEVEL>NON-REENTRANT</REENTRANCY-LEVEL>
                  <CALL-POINTS>
                    <BSW-DIRECT-CALL-POINT>
                      <SHORT-NAME>CanIf_TxConfirmation</SHORT-NAME>
                      <CALLED-ENTRY-REF DEST="BSW-MODULE-ENTRY">/AUTOSAR_CanIf/BSWModuleEntry/CanIf_TxConfirmation</CALLED-ENTRY-REF>
                    </BSW-DIRECT-CALL-POINT>
                    <BSW-DIRECT-CALL-POINT>
                      <SHORT-NAME>CanIf_RxIndication</SHORT-NAME>
                      <CALLED-ENTRY-REF DEST="BSW-MODULE-ENTRY">/AUTOSAR_CanIf/BSWModuleEntry/CanIf_RxIndication</CALLED-ENTRY-REF>
                    </BSW-DIRECT-CALL-POINT>
                    <BSW-DIRECT-CALL-POINT>
                      <SHORT-NAME>CanIf_ControllerBusOff</SHORT-NAME>
                      <CALLED-ENTRY-REF DEST="BSW-MODULE-ENTRY">/AUTOSAR_CanIf/BSWModuleEntry/CanIf_ControllerBusOff</CALLED-ENTRY-REF>
                    </BSW-DIRECT-CALL-POINT>
                    <BSW-DIRECT-CALL-POINT>
                      <SHORT-NAME>Dem_SetEventStatus</SHORT-NAME>
                      <CALLED-ENTRY-REF DEST="BSW-MODULE-ENTRY">/AUTOSAR_Dem/BSWModuleEntry/Dem_SetEventStatus</CALLED-ENTRY-REF>
                    </BSW-DIRECT-CALL-POINT>
                  [!IF "as:modconf('Can')[1]/CanGeneral/CanDevErrorDetect = 'true'"!][!//
                    <BSW-DIRECT-CALL-POINT>
                      <SHORT-NAME>Det_ReportRuntimeError</SHORT-NAME>
                      <CALLED-ENTRY-REF DEST="BSW-MODULE-ENTRY">/AUTOSAR_Det/BSWModuleEntry/Det_ReportRuntimeError</CALLED-ENTRY-REF>
                    </BSW-DIRECT-CALL-POINT>
                  [!ENDIF!][!//
                  </CALL-POINTS>
                  <IMPLEMENTED-ENTRY-REF DEST="BSW-MODULE-ENTRY">/Can_TI_AM263Px/Can_ModuleEntry/Can_7_Int0ISR</IMPLEMENTED-ENTRY-REF>
                  [!IF "as:modconf('Can')[1]/CanGeneral/CanTypeofInterruptFunction = 'CAN_ISR_CAT2'"!][!//
                  <INTERRUPT-CATEGORY>CAT-2</INTERRUPT-CATEGORY>
                  [!ELSE!][!//
                  <INTERRUPT-CATEGORY>CAT-1</INTERRUPT-CATEGORY>
                  [!ENDIF!][!//
                  <INTERRUPT-SOURCE>Hardware</INTERRUPT-SOURCE>
                </BSW-INTERRUPT-ENTITY>
              [!ENDIF!][!//
              [!ENDLOOP!][!//
              [!IF "count(as:modconf('Can')[1]/CanConfigSet/CanController/*[CanWakeupFunctionalityAPI = 'true']) > 0"!][!//
                <BSW-CALLED-ENTITY UUID="b408a098-acf2-44a0-a0d9-7568d9678b62">
                  <SHORT-NAME>Can_CheckWakeup</SHORT-NAME>
                  <MINIMUM-START-INTERVAL>0.0</MINIMUM-START-INTERVAL>
                  <REENTRANCY-LEVEL>NON-REENTRANT</REENTRANCY-LEVEL>
                  <IMPLEMENTED-ENTRY-REF DEST="BSW-MODULE-ENTRY">/Can_TI_AM263Px/Can_ModuleEntry/Can_CheckWakeup</IMPLEMENTED-ENTRY-REF>
                </BSW-CALLED-ENTITY>
              [!ENDIF!][!//
              [!IF "as:modconf('Can')[1]/CanGeneral/CanDeInitApi = 'true'"!][!//
                <BSW-CALLED-ENTITY UUID="651bbd50-7d63-4d59-965e-17dff3fd0f04">
                  <SHORT-NAME>Can_DeInit</SHORT-NAME>
                  <MINIMUM-START-INTERVAL>0.0</MINIMUM-START-INTERVAL>
                  <REENTRANCY-LEVEL>NON-REENTRANT</REENTRANCY-LEVEL>
                  <CALL-POINTS>
                    <BSW-DIRECT-CALL-POINT>
                      <SHORT-NAME>Dem_SetEventStatus</SHORT-NAME>
                      <CALLED-ENTRY-REF DEST="BSW-MODULE-ENTRY">/AUTOSAR_Dem/BSWModuleEntry/Dem_SetEventStatus</CALLED-ENTRY-REF>
                    </BSW-DIRECT-CALL-POINT>
                  [!IF "as:modconf('Can')[1]/CanGeneral/CanDevErrorDetect = 'true'"!][!//
                    <BSW-DIRECT-CALL-POINT>
                      <SHORT-NAME>Det_ReportError</SHORT-NAME>
                      <CALLED-ENTRY-REF DEST="BSW-MODULE-ENTRY">/AUTOSAR_Det/BSWModuleEntry/Det_ReportError</CALLED-ENTRY-REF>
                    </BSW-DIRECT-CALL-POINT>
                  [!ENDIF!][!//
                  </CALL-POINTS>
                  <IMPLEMENTED-ENTRY-REF DEST="BSW-MODULE-ENTRY">/Can_TI_AM263Px/Can_ModuleEntry/Can_DeInit</IMPLEMENTED-ENTRY-REF>
                </BSW-CALLED-ENTITY>
              [!ENDIF!][!//
                <BSW-CALLED-ENTITY UUID="5ecc9ae5-238e-4a6c-bfa1-6ee4bf44b997">
                  <SHORT-NAME>Can_DisableControllerInterrupts</SHORT-NAME>
                  <CAN-ENTER-EXCLUSIVE-AREA-REFS>
                    <CAN-ENTER-EXCLUSIVE-AREA-REF DEST="EXCLUSIVE-AREA">/Can_TI_AM263Px/Can/Can_Behavior/CAN_EXCLUSIVE_AREA_0</CAN-ENTER-EXCLUSIVE-AREA-REF>
                  </CAN-ENTER-EXCLUSIVE-AREA-REFS>
                  <MINIMUM-START-INTERVAL>0.0</MINIMUM-START-INTERVAL>
                  <REENTRANCY-LEVEL>SINGLE-CORE-REENTRANT</REENTRANCY-LEVEL>
                  <CALL-POINTS>
                  [!IF "as:modconf('Can')[1]/CanGeneral/CanDevErrorDetect = 'true'"!][!//
                    <BSW-DIRECT-CALL-POINT>
                      <SHORT-NAME>Det_ReportError</SHORT-NAME>
                      <CALLED-ENTRY-REF DEST="BSW-MODULE-ENTRY">/AUTOSAR_Det/BSWModuleEntry/Det_ReportError</CALLED-ENTRY-REF>
                    </BSW-DIRECT-CALL-POINT>
                  [!ENDIF!][!//
                  </CALL-POINTS>
                  <IMPLEMENTED-ENTRY-REF DEST="BSW-MODULE-ENTRY">/Can_TI_AM263Px/Can_ModuleEntry/Can_DisableControllerInterrupts</IMPLEMENTED-ENTRY-REF>
                </BSW-CALLED-ENTITY>
                <BSW-CALLED-ENTITY UUID="9d8c8d20-eda8-4c53-8ab5-ac8b80c04faa">
                  <SHORT-NAME>Can_EnableControllerInterrupts</SHORT-NAME>
                  <CAN-ENTER-EXCLUSIVE-AREA-REFS>
                    <CAN-ENTER-EXCLUSIVE-AREA-REF DEST="EXCLUSIVE-AREA">/Can_TI_AM263Px/Can/Can_Behavior/CAN_EXCLUSIVE_AREA_0</CAN-ENTER-EXCLUSIVE-AREA-REF>
                  </CAN-ENTER-EXCLUSIVE-AREA-REFS>
                  <MINIMUM-START-INTERVAL>0.0</MINIMUM-START-INTERVAL>
                  <REENTRANCY-LEVEL>SINGLE-CORE-REENTRANT</REENTRANCY-LEVEL>
                  <CALL-POINTS>
                  [!IF "as:modconf('Can')[1]/CanGeneral/CanDevErrorDetect = 'true'"!][!//
                    <BSW-DIRECT-CALL-POINT>
                      <SHORT-NAME>Det_ReportError</SHORT-NAME>
                      <CALLED-ENTRY-REF DEST="BSW-MODULE-ENTRY">/AUTOSAR_Det/BSWModuleEntry/Det_ReportError</CALLED-ENTRY-REF>
                    </BSW-DIRECT-CALL-POINT>
                  [!ENDIF!][!//
                  </CALL-POINTS>
                  <IMPLEMENTED-ENTRY-REF DEST="BSW-MODULE-ENTRY">/Can_TI_AM263Px/Can_ModuleEntry/Can_EnableControllerInterrupts</IMPLEMENTED-ENTRY-REF>
                </BSW-CALLED-ENTITY>
                <BSW-CALLED-ENTITY UUID="ad08af1d-2dd8-4551-a036-3dd706a08933">
                  <SHORT-NAME>Can_GetControllerErrorState</SHORT-NAME>
                  <MINIMUM-START-INTERVAL>0.0</MINIMUM-START-INTERVAL>
                  <REENTRANCY-LEVEL>NON-REENTRANT</REENTRANCY-LEVEL>
                  <CALL-POINTS>
                  [!IF "as:modconf('Can')[1]/CanGeneral/CanDevErrorDetect = 'true'"!][!//
                    <BSW-DIRECT-CALL-POINT>
                      <SHORT-NAME>Det_ReportError</SHORT-NAME>
                      <CALLED-ENTRY-REF DEST="BSW-MODULE-ENTRY">/AUTOSAR_Det/BSWModuleEntry/Det_ReportError</CALLED-ENTRY-REF>
                    </BSW-DIRECT-CALL-POINT>
                  [!ENDIF!][!//
                  </CALL-POINTS>
                  <IMPLEMENTED-ENTRY-REF DEST="BSW-MODULE-ENTRY">/Can_TI_AM263Px/Can_ModuleEntry/Can_GetControllerErrorState</IMPLEMENTED-ENTRY-REF>
                </BSW-CALLED-ENTITY>
                <BSW-CALLED-ENTITY UUID="ff8af45f-9327-43ec-a2c3-d836793c5dfa">
                  <SHORT-NAME>Can_GetControllerMode</SHORT-NAME>
                  <MINIMUM-START-INTERVAL>0.0</MINIMUM-START-INTERVAL>
                  <REENTRANCY-LEVEL>NON-REENTRANT</REENTRANCY-LEVEL>
                  <CALL-POINTS>
                [!IF "as:modconf('Can')[1]/CanGeneral/CanDevErrorDetect = 'true'"!][!//
                    <BSW-DIRECT-CALL-POINT>
                      <SHORT-NAME>Det_ReportError</SHORT-NAME>
                      <CALLED-ENTRY-REF DEST="BSW-MODULE-ENTRY">/AUTOSAR_Det/BSWModuleEntry/Det_ReportError</CALLED-ENTRY-REF>
                    </BSW-DIRECT-CALL-POINT>
                  [!ENDIF!][!//
                  </CALL-POINTS>
                  <IMPLEMENTED-ENTRY-REF DEST="BSW-MODULE-ENTRY">/Can_TI_AM263Px/Can_ModuleEntry/Can_GetControllerMode</IMPLEMENTED-ENTRY-REF>
                </BSW-CALLED-ENTITY>
              [!IF "as:modconf('Can')[1]/CanGeneral/CanVersionInfoApi = 'true'"!][!//
                <BSW-CALLED-ENTITY UUID="12cf18e0-9183-4e55-839b-57fe386a0627">
                  <SHORT-NAME>Can_GetVersionInfo</SHORT-NAME>
                  <MINIMUM-START-INTERVAL>0.0</MINIMUM-START-INTERVAL>
                  <REENTRANCY-LEVEL>NON-REENTRANT</REENTRANCY-LEVEL>
                  <CALL-POINTS>
                  [!IF "as:modconf('Can')[1]/CanGeneral/CanDevErrorDetect = 'true'"!][!//
                    <BSW-DIRECT-CALL-POINT>
                      <SHORT-NAME>Det_ReportError</SHORT-NAME>
                      <CALLED-ENTRY-REF DEST="BSW-MODULE-ENTRY">/AUTOSAR_Det/BSWModuleEntry/Det_ReportError</CALLED-ENTRY-REF>
                    </BSW-DIRECT-CALL-POINT>
                  [!ENDIF!][!//
                  </CALL-POINTS>
                  <IMPLEMENTED-ENTRY-REF DEST="BSW-MODULE-ENTRY">/Can_TI_AM263Px/Can_ModuleEntry/Can_GetVersionInfo</IMPLEMENTED-ENTRY-REF>
                </BSW-CALLED-ENTITY>
              [!ENDIF!][!//
                <BSW-CALLED-ENTITY UUID="08bd6605-9162-4248-b0c7-bf7ddd98d4ed">
                  <SHORT-NAME>Can_Init</SHORT-NAME>
                  <MINIMUM-START-INTERVAL>0.0</MINIMUM-START-INTERVAL>
                  <REENTRANCY-LEVEL>NON-REENTRANT</REENTRANCY-LEVEL>
                  <CALL-POINTS>
                    <BSW-DIRECT-CALL-POINT>
                      <SHORT-NAME>Dem_SetEventStatus</SHORT-NAME>
                      <CALLED-ENTRY-REF DEST="BSW-MODULE-ENTRY">/AUTOSAR_Dem/BSWModuleEntry/Dem_SetEventStatus</CALLED-ENTRY-REF>
                    </BSW-DIRECT-CALL-POINT>
                  [!IF "as:modconf('Can')[1]/CanGeneral/CanDevErrorDetect = 'true'"!][!//
                    <BSW-DIRECT-CALL-POINT>
                      <SHORT-NAME>Det_ReportError</SHORT-NAME>
                      <CALLED-ENTRY-REF DEST="BSW-MODULE-ENTRY">/AUTOSAR_Det/BSWModuleEntry/Det_ReportError</CALLED-ENTRY-REF>
                    </BSW-DIRECT-CALL-POINT>
                  [!ENDIF!][!//
                  </CALL-POINTS>
                  <IMPLEMENTED-ENTRY-REF DEST="BSW-MODULE-ENTRY">/Can_TI_AM263Px/Can_ModuleEntry/Can_Init</IMPLEMENTED-ENTRY-REF>
                </BSW-CALLED-ENTITY>
              [!IF "$BusOffpolling != num:i(0)"!][!//
                <BSW-SCHEDULABLE-ENTITY UUID="56f13e65-9681-41d1-b229-5d431b8ea428">
                  <SHORT-NAME>Can_MainFunction_BusOff</SHORT-NAME>
                  <MINIMUM-START-INTERVAL>0.0</MINIMUM-START-INTERVAL>
                  <REENTRANCY-LEVEL>NON-REENTRANT</REENTRANCY-LEVEL>
                  <CALL-POINTS>
                    <BSW-DIRECT-CALL-POINT>
                      <SHORT-NAME>CanIf_ControllerBusOff</SHORT-NAME>
                      <CALLED-ENTRY-REF DEST="BSW-MODULE-ENTRY">/AUTOSAR_CanIf/BSWModuleEntry/CanIf_ControllerBusOff</CALLED-ENTRY-REF>
                    </BSW-DIRECT-CALL-POINT>
                    <BSW-DIRECT-CALL-POINT>
                      <SHORT-NAME>Dem_SetEventStatus</SHORT-NAME>
                      <CALLED-ENTRY-REF DEST="BSW-MODULE-ENTRY">/AUTOSAR_Dem/BSWModuleEntry/Dem_SetEventStatus</CALLED-ENTRY-REF>
                    </BSW-DIRECT-CALL-POINT>
                  </CALL-POINTS>
                  <IMPLEMENTED-ENTRY-REF DEST="BSW-MODULE-ENTRY">/Can_TI_AM263Px/Can_ModuleEntry/Can_MainFunction_BusOff</IMPLEMENTED-ENTRY-REF>
                </BSW-SCHEDULABLE-ENTITY>
              [!ENDIF!][!//
                <BSW-SCHEDULABLE-ENTITY UUID="d9235562-da17-48d5-8b38-e41334a85fd4">
                  <SHORT-NAME>Can_MainFunction_Mode</SHORT-NAME>
                  <MINIMUM-START-INTERVAL>0.0</MINIMUM-START-INTERVAL>
                  <REENTRANCY-LEVEL>NON-REENTRANT</REENTRANCY-LEVEL>
                  <CALL-POINTS>
                    <BSW-DIRECT-CALL-POINT>
                      <SHORT-NAME>CanIf_ControllerModeIndication</SHORT-NAME>
                      <CALLED-ENTRY-REF DEST="BSW-MODULE-ENTRY">/AUTOSAR_CanIf/BSWModuleEntry/CanIf_ControllerModeIndication</CALLED-ENTRY-REF>
                    </BSW-DIRECT-CALL-POINT>
                  </CALL-POINTS>
                  <IMPLEMENTED-ENTRY-REF DEST="BSW-MODULE-ENTRY">/Can_TI_AM263Px/Can_ModuleEntry/Can_MainFunction_Mode</IMPLEMENTED-ENTRY-REF>
                </BSW-SCHEDULABLE-ENTITY>
              [!IF "$Rxpolling != num:i(0)"!][!//
                <BSW-SCHEDULABLE-ENTITY UUID="a50ae042-e807-421a-82cf-ee9285af7c5f">
                  <SHORT-NAME>Can_MainFunction_Read</SHORT-NAME>
                  <CAN-ENTER-EXCLUSIVE-AREA-REFS>
                    <CAN-ENTER-EXCLUSIVE-AREA-REF DEST="EXCLUSIVE-AREA">/Can_TI_AM263Px/Can/Can_Behavior/CAN_EXCLUSIVE_AREA_0</CAN-ENTER-EXCLUSIVE-AREA-REF>
                  </CAN-ENTER-EXCLUSIVE-AREA-REFS>
                  <MINIMUM-START-INTERVAL>0.0</MINIMUM-START-INTERVAL>
                  <REENTRANCY-LEVEL>SINGLE-CORE-REENTRANT</REENTRANCY-LEVEL>
                  <CALL-POINTS>
                    <BSW-DIRECT-CALL-POINT>
                      <SHORT-NAME>CanIf_RxIndication</SHORT-NAME>
                      <CALLED-ENTRY-REF DEST="BSW-MODULE-ENTRY">/AUTOSAR_CanIf/BSWModuleEntry/CanIf_RxIndication</CALLED-ENTRY-REF>
                    </BSW-DIRECT-CALL-POINT>
                  </CALL-POINTS>
                  <IMPLEMENTED-ENTRY-REF DEST="BSW-MODULE-ENTRY">/Can_TI_AM263Px/Can_ModuleEntry/Can_MainFunction_Read</IMPLEMENTED-ENTRY-REF>
                </BSW-SCHEDULABLE-ENTITY>
              [!ENDIF!][!//
              [!IF "$WakeUppolling != num:i(0)"!][!//
                <BSW-SCHEDULABLE-ENTITY UUID="27c74c06-9ee0-49c7-b3cc-1c92233dcdd0">
                  <SHORT-NAME>Can_MainFunction_Wakeup</SHORT-NAME>
                  <MINIMUM-START-INTERVAL>0.0</MINIMUM-START-INTERVAL>
                  <REENTRANCY-LEVEL>NON-REENTRANT</REENTRANCY-LEVEL>
                  <IMPLEMENTED-ENTRY-REF DEST="BSW-MODULE-ENTRY">/Can_TI_AM263Px/Can_ModuleEntry/Can_MainFunction_Wakeup</IMPLEMENTED-ENTRY-REF>
                </BSW-SCHEDULABLE-ENTITY>
              [!ENDIF!][!//
              [!IF "$Txpolling != num:i(0)"!][!//
                <BSW-SCHEDULABLE-ENTITY UUID="e53bcf0f-515b-47d7-a0c6-ec18548c1432">
                  <SHORT-NAME>Can_MainFunction_Write</SHORT-NAME>
                  <CAN-ENTER-EXCLUSIVE-AREA-REFS>
                    <CAN-ENTER-EXCLUSIVE-AREA-REF DEST="EXCLUSIVE-AREA">/Can_TI_AM263Px/Can/Can_Behavior/CAN_EXCLUSIVE_AREA_0</CAN-ENTER-EXCLUSIVE-AREA-REF>
                  </CAN-ENTER-EXCLUSIVE-AREA-REFS>
                  <MINIMUM-START-INTERVAL>0.0</MINIMUM-START-INTERVAL>
                  <REENTRANCY-LEVEL>SINGLE-CORE-REENTRANT</REENTRANCY-LEVEL>
                  <CALL-POINTS>
                    <BSW-DIRECT-CALL-POINT>
                      <SHORT-NAME>CanIf_TxConfirmation</SHORT-NAME>
                      <CALLED-ENTRY-REF DEST="BSW-MODULE-ENTRY">/AUTOSAR_CanIf/BSWModuleEntry/CanIf_TxConfirmation</CALLED-ENTRY-REF>
                    </BSW-DIRECT-CALL-POINT>
                  </CALL-POINTS>
                  <IMPLEMENTED-ENTRY-REF DEST="BSW-MODULE-ENTRY">/Can_TI_AM263Px/Can_ModuleEntry/Can_MainFunction_Write</IMPLEMENTED-ENTRY-REF>
                </BSW-SCHEDULABLE-ENTITY>
              [!ENDIF!][!//
              [!IF "as:modconf('Can')[1]/CanGeneral/CanRegisterReadbackAPI = 'true'"!][!//
                <BSW-CALLED-ENTITY UUID="b7e65624-4264-42b7-bb2d-30488e58248e">
                  <SHORT-NAME>Can_RegisterReadback</SHORT-NAME>
                  <MINIMUM-START-INTERVAL>0.0</MINIMUM-START-INTERVAL>
                  <REENTRANCY-LEVEL>NON-REENTRANT</REENTRANCY-LEVEL>
                  <CALL-POINTS>
                  [!IF "as:modconf('Can')[1]/CanGeneral/CanDevErrorDetect = 'true'"!][!//
                    <BSW-DIRECT-CALL-POINT>
                      <SHORT-NAME>Det_ReportError</SHORT-NAME>
                      <CALLED-ENTRY-REF DEST="BSW-MODULE-ENTRY">/AUTOSAR_Det/BSWModuleEntry/Det_ReportError</CALLED-ENTRY-REF>
                    </BSW-DIRECT-CALL-POINT>
                  [!ENDIF!][!//
                  </CALL-POINTS>
                  <IMPLEMENTED-ENTRY-REF DEST="BSW-MODULE-ENTRY">/Can_TI_AM263Px/Can_ModuleEntry/Can_RegisterReadback</IMPLEMENTED-ENTRY-REF>
                </BSW-CALLED-ENTITY>
              [!ENDIF!][!//
              [!IF "as:modconf('Can')[1]/CanGeneral/CanSetBaudrateApi = 'true'"!][!//
                <BSW-CALLED-ENTITY UUID="22b574ad-51da-4567-bfe3-0639a985f25e">
                  <SHORT-NAME>Can_SetBaudrate</SHORT-NAME>
                  <CAN-ENTER-EXCLUSIVE-AREA-REFS>
                    <CAN-ENTER-EXCLUSIVE-AREA-REF DEST="EXCLUSIVE-AREA">/Can_TI_AM263Px/Can/Can_Behavior/CAN_EXCLUSIVE_AREA_0</CAN-ENTER-EXCLUSIVE-AREA-REF>
                  </CAN-ENTER-EXCLUSIVE-AREA-REFS>
                  <MINIMUM-START-INTERVAL>0.0</MINIMUM-START-INTERVAL>
                  <REENTRANCY-LEVEL>SINGLE-CORE-REENTRANT</REENTRANCY-LEVEL>
                  <CALL-POINTS>
                  [!IF "as:modconf('Can')[1]/CanGeneral/CanDevErrorDetect = 'true'"!][!//
                    <BSW-DIRECT-CALL-POINT>
                      <SHORT-NAME>Det_ReportError</SHORT-NAME>
                      <CALLED-ENTRY-REF DEST="BSW-MODULE-ENTRY">/AUTOSAR_Det/BSWModuleEntry/Det_ReportError</CALLED-ENTRY-REF>
                    </BSW-DIRECT-CALL-POINT>
                  [!ENDIF!][!//
                  </CALL-POINTS>
                  <IMPLEMENTED-ENTRY-REF DEST="BSW-MODULE-ENTRY">/Can_TI_AM263Px/Can_ModuleEntry/Can_SetBaudrate</IMPLEMENTED-ENTRY-REF>
                </BSW-CALLED-ENTITY>
              [!ENDIF!][!//
                <BSW-CALLED-ENTITY UUID="6240e756-c91d-4d38-8566-949c17afe46d">
                  <SHORT-NAME>Can_SetControllerMode</SHORT-NAME>
                  <MINIMUM-START-INTERVAL>0.0</MINIMUM-START-INTERVAL>
                  <REENTRANCY-LEVEL>NON-REENTRANT</REENTRANCY-LEVEL>
                  <CALL-POINTS>
                    <BSW-DIRECT-CALL-POINT>
                      <SHORT-NAME>CanIf_ControllerModeIndication</SHORT-NAME>
                      <CALLED-ENTRY-REF DEST="BSW-MODULE-ENTRY">/AUTOSAR_CanIf/BSWModuleEntry/CanIf_ControllerModeIndication</CALLED-ENTRY-REF>
                    </BSW-DIRECT-CALL-POINT>
                    <BSW-DIRECT-CALL-POINT>
                      <SHORT-NAME>Dem_ReportErrorStatus</SHORT-NAME>
                      <CALLED-ENTRY-REF DEST="BSW-MODULE-ENTRY">/AUTOSAR_Dem/BSWModuleEntry/Dem_ReportErrorStatus</CALLED-ENTRY-REF>
                    </BSW-DIRECT-CALL-POINT>
                    <BSW-DIRECT-CALL-POINT>
                      <SHORT-NAME>Dem_SetEventStatus</SHORT-NAME>
                      <CALLED-ENTRY-REF DEST="BSW-MODULE-ENTRY">/AUTOSAR_Dem/BSWModuleEntry/Dem_SetEventStatus</CALLED-ENTRY-REF>
                    </BSW-DIRECT-CALL-POINT>
                  [!IF "as:modconf('Can')[1]/CanGeneral/CanDevErrorDetect = 'true'"!][!//
                    <BSW-DIRECT-CALL-POINT>
                      <SHORT-NAME>Det_ReportError</SHORT-NAME>
                      <CALLED-ENTRY-REF DEST="BSW-MODULE-ENTRY">/AUTOSAR_Det/BSWModuleEntry/Det_ReportError</CALLED-ENTRY-REF>
                    </BSW-DIRECT-CALL-POINT>
                  [!ENDIF!][!//
                  </CALL-POINTS>
                  <IMPLEMENTED-ENTRY-REF DEST="BSW-MODULE-ENTRY">/Can_TI_AM263Px/Can_ModuleEntry/Can_SetControllerMode</IMPLEMENTED-ENTRY-REF>
                </BSW-CALLED-ENTITY>
              [!IF "as:modconf('Can')[1]/CanGeneral/CanLoopBackTest_Enable = 'true'"!][!//
                <BSW-CALLED-ENTITY UUID="79ee34eb-e9fc-4d69-8e7d-cf268b448e91">
                  <SHORT-NAME>Can_TestLoopBackModeDisable</SHORT-NAME>
                  <MINIMUM-START-INTERVAL>0.0</MINIMUM-START-INTERVAL>
                  <REENTRANCY-LEVEL>NON-REENTRANT</REENTRANCY-LEVEL>
                  <CALL-POINTS>
                    <BSW-DIRECT-CALL-POINT>
                      <SHORT-NAME>Dem_SetEventStatus</SHORT-NAME>
                      <CALLED-ENTRY-REF DEST="BSW-MODULE-ENTRY">/AUTOSAR_Dem/BSWModuleEntry/Dem_SetEventStatus</CALLED-ENTRY-REF>
                    </BSW-DIRECT-CALL-POINT>
                  </CALL-POINTS>
                  <IMPLEMENTED-ENTRY-REF DEST="BSW-MODULE-ENTRY">/Can_TI_AM263Px/Can_ModuleEntry/Can_TestLoopBackModeDisable</IMPLEMENTED-ENTRY-REF>
                </BSW-CALLED-ENTITY>
                <BSW-CALLED-ENTITY UUID="6ea07d2b-ad3f-48ca-8d79-e119f35e85c1">
                  <SHORT-NAME>Can_TestLoopBackModeEnable</SHORT-NAME>
                  <MINIMUM-START-INTERVAL>0.0</MINIMUM-START-INTERVAL>
                  <REENTRANCY-LEVEL>NON-REENTRANT</REENTRANCY-LEVEL>
                  <CALL-POINTS>
                    <BSW-DIRECT-CALL-POINT>
                      <SHORT-NAME>Dem_SetEventStatus</SHORT-NAME>
                      <CALLED-ENTRY-REF DEST="BSW-MODULE-ENTRY">/AUTOSAR_Dem/BSWModuleEntry/Dem_SetEventStatus</CALLED-ENTRY-REF>
                    </BSW-DIRECT-CALL-POINT>
                  </CALL-POINTS>
                  <IMPLEMENTED-ENTRY-REF DEST="BSW-MODULE-ENTRY">/Can_TI_AM263Px/Can_ModuleEntry/Can_TestLoopBackModeEnable</IMPLEMENTED-ENTRY-REF>
                </BSW-CALLED-ENTITY>
              [!ENDIF!][!//
                <BSW-CALLED-ENTITY UUID="d8fc5289-1682-47a8-97fa-be6fbb3515ce">
                  <SHORT-NAME>Can_Write</SHORT-NAME>
                  <CAN-ENTER-EXCLUSIVE-AREA-REFS>
                    <CAN-ENTER-EXCLUSIVE-AREA-REF DEST="EXCLUSIVE-AREA">/Can_TI_AM263Px/Can/Can_Behavior/CAN_EXCLUSIVE_AREA_0</CAN-ENTER-EXCLUSIVE-AREA-REF>
                  </CAN-ENTER-EXCLUSIVE-AREA-REFS>
                  <MINIMUM-START-INTERVAL>0.0</MINIMUM-START-INTERVAL>
                  <REENTRANCY-LEVEL>SINGLE-CORE-REENTRANT</REENTRANCY-LEVEL>
                  <CALL-POINTS>
                    <BSW-DIRECT-CALL-POINT>
                      <SHORT-NAME>CanIf_TriggerTransmit</SHORT-NAME>
                      <CALLED-ENTRY-REF DEST="BSW-MODULE-ENTRY">/AUTOSAR_CanIf/BSWModuleEntry/CanIf_TriggerTransmit</CALLED-ENTRY-REF>
                    </BSW-DIRECT-CALL-POINT>
                  [!IF "as:modconf('Can')[1]/CanGeneral/CanDevErrorDetect = 'true'"!][!//
                    <BSW-DIRECT-CALL-POINT>
                      <SHORT-NAME>Det_ReportError</SHORT-NAME>
                      <CALLED-ENTRY-REF DEST="BSW-MODULE-ENTRY">/AUTOSAR_Det/BSWModuleEntry/Det_ReportError</CALLED-ENTRY-REF>
                    </BSW-DIRECT-CALL-POINT>
                  [!ENDIF!][!//
                  </CALL-POINTS>
                  <IMPLEMENTED-ENTRY-REF DEST="BSW-MODULE-ENTRY">/Can_TI_AM263Px/Can_ModuleEntry/Can_Write</IMPLEMENTED-ENTRY-REF>
                </BSW-CALLED-ENTITY>
              </ENTITYS>
              <EVENTS>
              [!IF "$BusOffpolling != num:i(0)"!][!//
                <BSW-TIMING-EVENT UUID="35ea8b2e-e764-4486-adeb-56757b7be741">
                  <SHORT-NAME>Can_MainFunctionTimingEvent_BusOff</SHORT-NAME>
                  <STARTS-ON-EVENT-REF DEST="BSW-SCHEDULABLE-ENTITY">/Can_TI_AM263Px/Can/Can_Behavior/Can_MainFunction_BusOff</STARTS-ON-EVENT-REF>
                  <PERIOD>[!"num:f(as:modconf('Can')[1]/CanGeneral/CanMainFunctionBusoffPeriod)"!]</PERIOD>
                </BSW-TIMING-EVENT>
              [!ENDIF!][!//
                <BSW-TIMING-EVENT UUID="04cd4bb0-cb81-452f-92cf-623e46acc15c">
                  <SHORT-NAME>Can_MainFunctionTimingEvent_Mode</SHORT-NAME>
                  <STARTS-ON-EVENT-REF DEST="BSW-SCHEDULABLE-ENTITY">/Can_TI_AM263Px/Can/Can_Behavior/Can_MainFunction_Mode</STARTS-ON-EVENT-REF>
                  <PERIOD>[!"num:f(as:modconf('Can')[1]/CanGeneral/CanMainFunctionModePeriod)"!]</PERIOD>
                </BSW-TIMING-EVENT>
              [!IF "$Rxpolling != num:i(0)"!][!//
                <BSW-TIMING-EVENT UUID="2e755435-7e91-43fd-9317-15a5b1265faf">
                  <SHORT-NAME>Can_MainFunctionTimingEvent_Read</SHORT-NAME>
                  <STARTS-ON-EVENT-REF DEST="BSW-SCHEDULABLE-ENTITY">/Can_TI_AM263Px/Can/Can_Behavior/Can_MainFunction_Read</STARTS-ON-EVENT-REF>
                  <PERIOD>[!"num:f(as:modconf('Can')[1]/CanGeneral/CanMainFunctionReadPeriod)"!]</PERIOD>
                </BSW-TIMING-EVENT>
              [!ENDIF!][!//
              [!IF "$WakeUppolling != num:i(0)"!][!//
                <BSW-TIMING-EVENT UUID="8b5dd1a5-2776-4eef-b311-aef69f165068">
                  <SHORT-NAME>Can_MainFunctionTimingEvent_Wakeup</SHORT-NAME>
                  <STARTS-ON-EVENT-REF DEST="BSW-SCHEDULABLE-ENTITY">/Can_TI_AM263Px/Can/Can_Behavior/Can_MainFunction_Wakeup</STARTS-ON-EVENT-REF>
                  <PERIOD>0.01</PERIOD>
                </BSW-TIMING-EVENT>
              [!ENDIF!][!//
              [!IF "$Txpolling != num:i(0)"!][!//
                <BSW-TIMING-EVENT UUID="79bcde40-5b40-4bb9-a4b7-5251a30dbbf8">
                  <SHORT-NAME>Can_MainFunctionTimingEvent_Write</SHORT-NAME>
                  <STARTS-ON-EVENT-REF DEST="BSW-SCHEDULABLE-ENTITY">/Can_TI_AM263Px/Can/Can_Behavior/Can_MainFunction_Write</STARTS-ON-EVENT-REF>
                  <PERIOD>[!"num:f(as:modconf('Can')[1]/CanGeneral/CanMainFunctionWritePeriod)"!]</PERIOD>
                </BSW-TIMING-EVENT>
              [!ENDIF!][!//
              </EVENTS>
            </BSW-INTERNAL-BEHAVIOR>
          </INTERNAL-BEHAVIORS>
        </BSW-MODULE-DESCRIPTION>
        <BSW-IMPLEMENTATION UUID="68fab167-6a0d-4a08-9015-4767e4cc68a5">
          <SHORT-NAME>Can_Impl</SHORT-NAME>
          <CODE-DESCRIPTORS>
            <CODE UUID="e4253ecc-4d3a-4d4c-a08b-835c4c19fb3a">
              <SHORT-NAME>Files</SHORT-NAME>
              <ARTIFACT-DESCRIPTORS>
                <AUTOSAR-ENGINEERING-OBJECT>
                  <SHORT-LABEL>generate::include::Can_Cfg.h</SHORT-LABEL>
                  <CATEGORY>SWHDR</CATEGORY>
                </AUTOSAR-ENGINEERING-OBJECT>
                <AUTOSAR-ENGINEERING-OBJECT>
                  <SHORT-LABEL>generate::src::Can_Cfg.c</SHORT-LABEL>
                  <CATEGORY>SWSRC</CATEGORY>
                </AUTOSAR-ENGINEERING-OBJECT>
                <AUTOSAR-ENGINEERING-OBJECT>
                  <SHORT-LABEL>generate::src::Can_PBcfg.c</SHORT-LABEL>
                  <CATEGORY>SWSRC</CATEGORY>
                </AUTOSAR-ENGINEERING-OBJECT>
                <AUTOSAR-ENGINEERING-OBJECT>
                  <SHORT-LABEL>include::Can.h</SHORT-LABEL>
                  <CATEGORY>SWHDR</CATEGORY>
                </AUTOSAR-ENGINEERING-OBJECT>
                <AUTOSAR-ENGINEERING-OBJECT>
                  <SHORT-LABEL>include::Can_Irq.h</SHORT-LABEL>
                  <CATEGORY>SWHDR</CATEGORY>
                </AUTOSAR-ENGINEERING-OBJECT>
                <AUTOSAR-ENGINEERING-OBJECT>
                  <SHORT-LABEL>src::Can.c</SHORT-LABEL>
                  <CATEGORY>SWSRC</CATEGORY>
                </AUTOSAR-ENGINEERING-OBJECT>
                <AUTOSAR-ENGINEERING-OBJECT>
                  <SHORT-LABEL>src::Can_Irq.c</SHORT-LABEL>
                  <CATEGORY>SWSRC</CATEGORY>
                </AUTOSAR-ENGINEERING-OBJECT>
                <AUTOSAR-ENGINEERING-OBJECT>
                  <SHORT-LABEL>V0::Can_Mcan.c</SHORT-LABEL>
                  <CATEGORY>SWSRC</CATEGORY>
                </AUTOSAR-ENGINEERING-OBJECT>
                <AUTOSAR-ENGINEERING-OBJECT>
                  <SHORT-LABEL>V0::Can_Priv.c</SHORT-LABEL>
                  <CATEGORY>SWSRC</CATEGORY>
                </AUTOSAR-ENGINEERING-OBJECT>
                <AUTOSAR-ENGINEERING-OBJECT>
                  <SHORT-LABEL>V0::Can_Priv.h</SHORT-LABEL>
                  <CATEGORY>SWHDR</CATEGORY>
                </AUTOSAR-ENGINEERING-OBJECT>
                <AUTOSAR-ENGINEERING-OBJECT>
                  <SHORT-LABEL>V0::mcan.c</SHORT-LABEL>
                  <CATEGORY>SWSRC</CATEGORY>
                </AUTOSAR-ENGINEERING-OBJECT>
                <AUTOSAR-ENGINEERING-OBJECT>
                  <SHORT-LABEL>V0::mcan.h</SHORT-LABEL>
                  <CATEGORY>SWHDR</CATEGORY>
                </AUTOSAR-ENGINEERING-OBJECT>
              </ARTIFACT-DESCRIPTORS>
            </CODE>
          </CODE-DESCRIPTORS>
          <COMPILERS>
            <COMPILER UUID="5b252f7d-33c9-466f-9573-9877d7f656ec">
              <SHORT-NAME>tiarmclang</SHORT-NAME>
              <NAME>TI ARM Clang</NAME>
              <OPTIONS>-mcpu=cortex-r5  -mfpu=vfpv3-d16  -mfloat-abi=hard  -c  -mlittle-endian  -ffunction-sections  -gdwarf-3  -Werror -Os  -x  -save-temps  -mthumb  -DAM263PX_SIP_PACKAGE  -DAM263PX_PLATFORM -DAM263PX_R_PACKAGE -DAM263PX_C_PACKAGE </OPTIONS>
              <VENDOR>Texas Instruments</VENDOR>
              <VERSION>4.0.0</VERSION>
            </COMPILER>
          </COMPILERS>
          <LINKERS>
            <LINKER UUID="2fee982e-243e-4f73-b7df-edf8c9b26e85">
              <SHORT-NAME>tiarmlnk</SHORT-NAME>
              <NAME>TI ARM Clang Linker</NAME>
              <OPTIONS>-mcpu=cortex-r5  -Wl,--ram_model  -Wl,--reread_libs  -Wl,--warn_sections  -qq -Wl,--emit_warnings_as_errors --diag_suppress=10068 --diag_suppress=10063 </OPTIONS>
              <VENDOR>Texas Instruments</VENDOR>
              <VERSION>4.0.0</VERSION>
            </LINKER>
          </LINKERS>
          <PROGRAMMING-LANGUAGE>C</PROGRAMMING-LANGUAGE>
          <RESOURCE-CONSUMPTION UUID="014cc1bb-df57-4463-ac65-9a6716333457">
            <SHORT-NAME>ResourceConsumption</SHORT-NAME>
            <MEMORY-SECTIONS>
              <MEMORY-SECTION UUID="46032e93-30dc-4f81-ba38-7f5f4ffabdb5">
                <SHORT-NAME>CAN_CODE</SHORT-NAME>
                <ALIGNMENT>UNSPECIFIED</ALIGNMENT>
                <SW-ADDRMETHOD-REF DEST="SW-ADDR-METHOD">/AUTOSAR_MemMap/SwAddrMethods/CODE</SW-ADDRMETHOD-REF>
                <SYMBOL>CODE</SYMBOL>
              </MEMORY-SECTION>
              <MEMORY-SECTION UUID="098b7980-8967-4297-97df-2e4034d02f05">
                <SHORT-NAME>CAN_CONFIG_DATA</SHORT-NAME>
                <ALIGNMENT>UNSPECIFIED</ALIGNMENT>
                <SW-ADDRMETHOD-REF DEST="SW-ADDR-METHOD">/AUTOSAR_MemMap/SwAddrMethods/CONFIG_DATA</SW-ADDRMETHOD-REF>
                <SYMBOL>CONFIG_DATA</SYMBOL>
              </MEMORY-SECTION>
              <MEMORY-SECTION UUID="ba479406-8b46-4cb5-b878-bea6b0db925b">
                <SHORT-NAME>CAN_ISR_CODE</SHORT-NAME>
                <ALIGNMENT>UNSPECIFIED</ALIGNMENT>
                <SW-ADDRMETHOD-REF DEST="SW-ADDR-METHOD">/AUTOSAR_MemMap/SwAddrMethods/CODE</SW-ADDRMETHOD-REF>
                <SYMBOL>ISR_CODE</SYMBOL>
              </MEMORY-SECTION>
              <MEMORY-SECTION UUID="098b7980-8967-4297-97df-2e4034d02f07">
                <SHORT-NAME>CAN_VAR_INIT_32</SHORT-NAME>
                <ALIGNMENT>32</ALIGNMENT>
                <SW-ADDRMETHOD-REF DEST="SW-ADDR-METHOD">/AUTOSAR_MemMap/SwAddrMethods/VAR_INIT</SW-ADDRMETHOD-REF>
                <SYMBOL>VAR_INIT_32</SYMBOL>
              </MEMORY-SECTION>
              <MEMORY-SECTION UUID="b41d052a-ccf3-4af2-9a8b-613565486687">
                <SHORT-NAME>CAN_VAR_INIT_8</SHORT-NAME>
                <ALIGNMENT>8</ALIGNMENT>
                <SW-ADDRMETHOD-REF DEST="SW-ADDR-METHOD">/AUTOSAR_MemMap/SwAddrMethods/VAR_INIT</SW-ADDRMETHOD-REF>
                <SYMBOL>VAR_INIT_8</SYMBOL>
              </MEMORY-SECTION>
              <MEMORY-SECTION UUID="033cbb55-6fc5-4ea7-b252-5ad222f66393">
                <SHORT-NAME>CAN_VAR_INIT_UNSPECIFIED</SHORT-NAME>
                <ALIGNMENT>UNSPECIFIED</ALIGNMENT>
                <SW-ADDRMETHOD-REF DEST="SW-ADDR-METHOD">/AUTOSAR_MemMap/SwAddrMethods/VAR_INIT</SW-ADDRMETHOD-REF>
                <SYMBOL>VAR_INIT_UNSPECIFIED</SYMBOL>
              </MEMORY-SECTION>
              <MEMORY-SECTION UUID="098b7980-8967-4297-97df-2e4034d02f06">
                <SHORT-NAME>CAN_VAR_NO_INIT_UNSPECIFIED</SHORT-NAME>
                <ALIGNMENT>UNSPECIFIED</ALIGNMENT>
                <SW-ADDRMETHOD-REF DEST="SW-ADDR-METHOD">/AUTOSAR_MemMap/SwAddrMethods/VAR_NO_INIT</SW-ADDRMETHOD-REF>
                <SYMBOL>VAR_NO_INIT_UNSPECIFIED</SYMBOL>
              </MEMORY-SECTION>
              <MEMORY-SECTION UUID="fd2efb6f-c84a-4918-9ee4-c398af3889d3">
                <SHORT-NAME>CAN_CONST_UNSPECIFIED</SHORT-NAME>
                <ALIGNMENT>UNSPECIFIED</ALIGNMENT>
                <SW-ADDRMETHOD-REF DEST="SW-ADDR-METHOD">/AUTOSAR_MemMap/SwAddrMethods/CONST</SW-ADDRMETHOD-REF>
                <SYMBOL>CONST_UNSPECIFIED</SYMBOL>
              </MEMORY-SECTION>
              <MEMORY-SECTION UUID="046098f6-e1d3-4a39-9dbf-645cf21ecede">
                <SHORT-NAME>CAN_CONST_8</SHORT-NAME>
                <ALIGNMENT>UNSPECIFIED</ALIGNMENT>
                <SW-ADDRMETHOD-REF DEST="SW-ADDR-METHOD">/AUTOSAR_MemMap/SwAddrMethods/CONST</SW-ADDRMETHOD-REF>
                <SYMBOL>CONST_8</SYMBOL>
              </MEMORY-SECTION>
              <MEMORY-SECTION UUID="7eaee02c-912d-4fed-8750-833986386601">
                <SHORT-NAME>CAN_CONST_32</SHORT-NAME>
                <ALIGNMENT>UNSPECIFIED</ALIGNMENT>
                <SW-ADDRMETHOD-REF DEST="SW-ADDR-METHOD">/AUTOSAR_MemMap/SwAddrMethods/CONST</SW-ADDRMETHOD-REF>
                <SYMBOL>CONST_32</SYMBOL>
              </MEMORY-SECTION>
            </MEMORY-SECTIONS>
          </RESOURCE-CONSUMPTION>
          <SW-VERSION>10.01.00</SW-VERSION>
          <VENDOR-ID>44</VENDOR-ID>
          <AR-RELEASE-VERSION>4.3.1</AR-RELEASE-VERSION>
          <BEHAVIOR-REF DEST="BSW-INTERNAL-BEHAVIOR">/Can_TI_AM263Px/Can/Can_Behavior</BEHAVIOR-REF>
          <VENDOR-SPECIFIC-MODULE-DEF-REFS>
            <VENDOR-SPECIFIC-MODULE-DEF-REF DEST="ECUC-MODULE-DEF">/TI_AM263Px/Can</VENDOR-SPECIFIC-MODULE-DEF-REF>
          </VENDOR-SPECIFIC-MODULE-DEF-REFS>
        </BSW-IMPLEMENTATION>
      </ELEMENTS>
      <AR-PACKAGES>
        <AR-PACKAGE UUID="1566c979-f45e-487c-bc3b-f53f40dd5feb">
          <SHORT-NAME>Can_ModuleEntry</SHORT-NAME>
          <ELEMENTS>
            <BSW-MODULE-ENTRY UUID="256d92ab-20ff-41f9-841f-2ff30b48a8fa">
              <SHORT-NAME>Can_0_Int0ISR</SHORT-NAME>
              <IS-REENTRANT>false</IS-REENTRANT>
              <IS-SYNCHRONOUS>true</IS-SYNCHRONOUS>
              <CALL-TYPE>INTERRUPT</CALL-TYPE>
              [!IF "as:modconf('Can')[1]/CanGeneral/CanTypeofInterruptFunction = 'CAN_ISR_CAT2'"!][!//
              <EXECUTION-CONTEXT>INTERRUPT-CAT-2</EXECUTION-CONTEXT>
              [!ELSE!][!//
              <EXECUTION-CONTEXT>INTERRUPT-CAT-1</EXECUTION-CONTEXT>
              [!ENDIF!][!//
              <SW-SERVICE-IMPL-POLICY>STANDARD</SW-SERVICE-IMPL-POLICY>
              <BSW-ENTRY-KIND>CONCRETE</BSW-ENTRY-KIND>
            </BSW-MODULE-ENTRY>
            <BSW-MODULE-ENTRY UUID="ac9b1175-0f8f-4a13-b59f-3c34d4c2f6fe">
              <SHORT-NAME>Can_1_Int0ISR</SHORT-NAME>
              <IS-REENTRANT>false</IS-REENTRANT>
              <IS-SYNCHRONOUS>true</IS-SYNCHRONOUS>
              <CALL-TYPE>INTERRUPT</CALL-TYPE>
              [!IF "as:modconf('Can')[1]/CanGeneral/CanTypeofInterruptFunction = 'CAN_ISR_CAT2'"!][!//
              <EXECUTION-CONTEXT>INTERRUPT-CAT-2</EXECUTION-CONTEXT>
              [!ELSE!][!//
              <EXECUTION-CONTEXT>INTERRUPT-CAT-1</EXECUTION-CONTEXT>
              [!ENDIF!][!//
              <SW-SERVICE-IMPL-POLICY>STANDARD</SW-SERVICE-IMPL-POLICY>
              <BSW-ENTRY-KIND>CONCRETE</BSW-ENTRY-KIND>
            </BSW-MODULE-ENTRY>
            <BSW-MODULE-ENTRY UUID="4e461087-68ee-40c6-961c-c3ee9c75b456">
              <SHORT-NAME>Can_2_Int0ISR</SHORT-NAME>
              <IS-REENTRANT>false</IS-REENTRANT>
              <IS-SYNCHRONOUS>true</IS-SYNCHRONOUS>
              <CALL-TYPE>INTERRUPT</CALL-TYPE>
              [!IF "as:modconf('Can')[1]/CanGeneral/CanTypeofInterruptFunction = 'CAN_ISR_CAT2'"!][!//
              <EXECUTION-CONTEXT>INTERRUPT-CAT-2</EXECUTION-CONTEXT>
              [!ELSE!][!//
              <EXECUTION-CONTEXT>INTERRUPT-CAT-1</EXECUTION-CONTEXT>
              [!ENDIF!][!//
              <SW-SERVICE-IMPL-POLICY>STANDARD</SW-SERVICE-IMPL-POLICY>
              <BSW-ENTRY-KIND>CONCRETE</BSW-ENTRY-KIND>
            </BSW-MODULE-ENTRY>
            <BSW-MODULE-ENTRY UUID="f15d8caa-e4d6-4e42-9e8a-cf4535f47ad0">
              <SHORT-NAME>Can_3_Int0ISR</SHORT-NAME>
              <IS-REENTRANT>false</IS-REENTRANT>
              <IS-SYNCHRONOUS>true</IS-SYNCHRONOUS>
              <CALL-TYPE>INTERRUPT</CALL-TYPE>
              [!IF "as:modconf('Can')[1]/CanGeneral/CanTypeofInterruptFunction = 'CAN_ISR_CAT2'"!][!//
              <EXECUTION-CONTEXT>INTERRUPT-CAT-2</EXECUTION-CONTEXT>
              [!ELSE!][!//
              <EXECUTION-CONTEXT>INTERRUPT-CAT-1</EXECUTION-CONTEXT>
              [!ENDIF!][!//
              <SW-SERVICE-IMPL-POLICY>STANDARD</SW-SERVICE-IMPL-POLICY>
              <BSW-ENTRY-KIND>CONCRETE</BSW-ENTRY-KIND>
            </BSW-MODULE-ENTRY>
            <BSW-MODULE-ENTRY UUID="ecdac919-94b0-42d6-aa10-074fd80312ad">
              <SHORT-NAME>Can_4_Int0ISR</SHORT-NAME>
              <IS-REENTRANT>false</IS-REENTRANT>
              <IS-SYNCHRONOUS>true</IS-SYNCHRONOUS>
              <CALL-TYPE>INTERRUPT</CALL-TYPE>
              [!IF "as:modconf('Can')[1]/CanGeneral/CanTypeofInterruptFunction = 'CAN_ISR_CAT2'"!][!//
              <EXECUTION-CONTEXT>INTERRUPT-CAT-2</EXECUTION-CONTEXT>
              [!ELSE!][!//
              <EXECUTION-CONTEXT>INTERRUPT-CAT-1</EXECUTION-CONTEXT>
              [!ENDIF!][!//
              <SW-SERVICE-IMPL-POLICY>STANDARD</SW-SERVICE-IMPL-POLICY>
              <BSW-ENTRY-KIND>CONCRETE</BSW-ENTRY-KIND>
            </BSW-MODULE-ENTRY>
            <BSW-MODULE-ENTRY UUID="cf881b7b-acd5-4c7d-a5a6-8350b90ce33b">
              <SHORT-NAME>Can_5_Int0ISR</SHORT-NAME>
              <IS-REENTRANT>false</IS-REENTRANT>
              <IS-SYNCHRONOUS>true</IS-SYNCHRONOUS>
              <CALL-TYPE>INTERRUPT</CALL-TYPE>
              [!IF "as:modconf('Can')[1]/CanGeneral/CanTypeofInterruptFunction = 'CAN_ISR_CAT2'"!][!//
              <EXECUTION-CONTEXT>INTERRUPT-CAT-2</EXECUTION-CONTEXT>
              [!ELSE!][!//
              <EXECUTION-CONTEXT>INTERRUPT-CAT-1</EXECUTION-CONTEXT>
              [!ENDIF!][!//
              <SW-SERVICE-IMPL-POLICY>STANDARD</SW-SERVICE-IMPL-POLICY>
              <BSW-ENTRY-KIND>CONCRETE</BSW-ENTRY-KIND>
            </BSW-MODULE-ENTRY>
            <BSW-MODULE-ENTRY UUID="2b312353-fee7-472a-9a3e-92861c1b8aa5">
              <SHORT-NAME>Can_6_Int0ISR</SHORT-NAME>
              <IS-REENTRANT>false</IS-REENTRANT>
              <IS-SYNCHRONOUS>true</IS-SYNCHRONOUS>
              <CALL-TYPE>INTERRUPT</CALL-TYPE>
              [!IF "as:modconf('Can')[1]/CanGeneral/CanTypeofInterruptFunction = 'CAN_ISR_CAT2'"!][!//
              <EXECUTION-CONTEXT>INTERRUPT-CAT-2</EXECUTION-CONTEXT>
              [!ELSE!][!//
              <EXECUTION-CONTEXT>INTERRUPT-CAT-1</EXECUTION-CONTEXT>
              [!ENDIF!][!//
              <SW-SERVICE-IMPL-POLICY>STANDARD</SW-SERVICE-IMPL-POLICY>
              <BSW-ENTRY-KIND>CONCRETE</BSW-ENTRY-KIND>
            </BSW-MODULE-ENTRY>
            <BSW-MODULE-ENTRY UUID="b7038bcf-ed43-46ec-a16f-9d33efed18e9">
              <SHORT-NAME>Can_7_Int0ISR</SHORT-NAME>
              <IS-REENTRANT>false</IS-REENTRANT>
              <IS-SYNCHRONOUS>true</IS-SYNCHRONOUS>
              <CALL-TYPE>INTERRUPT</CALL-TYPE>
              [!IF "as:modconf('Can')[1]/CanGeneral/CanTypeofInterruptFunction = 'CAN_ISR_CAT2'"!][!//
              <EXECUTION-CONTEXT>INTERRUPT-CAT-2</EXECUTION-CONTEXT>
              [!ELSE!][!//
              <EXECUTION-CONTEXT>INTERRUPT-CAT-1</EXECUTION-CONTEXT>
              [!ENDIF!][!//
              <SW-SERVICE-IMPL-POLICY>STANDARD</SW-SERVICE-IMPL-POLICY>
              <BSW-ENTRY-KIND>CONCRETE</BSW-ENTRY-KIND>
            </BSW-MODULE-ENTRY>
            <BSW-MODULE-ENTRY UUID="7f808ba2-63db-46f4-8000-d8d86708c8b8">
              <SHORT-NAME>Can_CheckWakeup</SHORT-NAME>
              <SERVICE-ID>11</SERVICE-ID>
              <IS-REENTRANT>false</IS-REENTRANT>
              <IS-SYNCHRONOUS>true</IS-SYNCHRONOUS>
              <CALL-TYPE>REGULAR</CALL-TYPE>
              <EXECUTION-CONTEXT>UNSPECIFIED</EXECUTION-CONTEXT>
              <SW-SERVICE-IMPL-POLICY>STANDARD</SW-SERVICE-IMPL-POLICY>
              <BSW-ENTRY-KIND>CONCRETE</BSW-ENTRY-KIND>
            </BSW-MODULE-ENTRY>
            <BSW-MODULE-ENTRY UUID="ad2befa7-4cd5-4c70-966c-2dfa1ae6bbda">
              <SHORT-NAME>Can_DeInit</SHORT-NAME>
              <SERVICE-ID>16</SERVICE-ID>
              <IS-REENTRANT>false</IS-REENTRANT>
              <IS-SYNCHRONOUS>true</IS-SYNCHRONOUS>
              <CALL-TYPE>REGULAR</CALL-TYPE>
              <EXECUTION-CONTEXT>UNSPECIFIED</EXECUTION-CONTEXT>
              <SW-SERVICE-IMPL-POLICY>STANDARD</SW-SERVICE-IMPL-POLICY>
              <BSW-ENTRY-KIND>CONCRETE</BSW-ENTRY-KIND>
            </BSW-MODULE-ENTRY>
            <BSW-MODULE-ENTRY UUID="dcd07f7b-51d5-42b6-9dca-909c2aff0bb9">
              <SHORT-NAME>Can_DisableControllerInterrupts</SHORT-NAME>
              <SERVICE-ID>4</SERVICE-ID>
              <IS-REENTRANT>true</IS-REENTRANT>
              <IS-SYNCHRONOUS>true</IS-SYNCHRONOUS>
              <CALL-TYPE>REGULAR</CALL-TYPE>
              <EXECUTION-CONTEXT>UNSPECIFIED</EXECUTION-CONTEXT>
              <SW-SERVICE-IMPL-POLICY>STANDARD</SW-SERVICE-IMPL-POLICY>
              <BSW-ENTRY-KIND>CONCRETE</BSW-ENTRY-KIND>
            </BSW-MODULE-ENTRY>
            <BSW-MODULE-ENTRY UUID="e5aa82bb-2440-41bb-b8a8-79333947d692">
              <SHORT-NAME>Can_EnableControllerInterrupts</SHORT-NAME>
              <SERVICE-ID>5</SERVICE-ID>
              <IS-REENTRANT>true</IS-REENTRANT>
              <IS-SYNCHRONOUS>true</IS-SYNCHRONOUS>
              <CALL-TYPE>REGULAR</CALL-TYPE>
              <EXECUTION-CONTEXT>UNSPECIFIED</EXECUTION-CONTEXT>
              <SW-SERVICE-IMPL-POLICY>STANDARD</SW-SERVICE-IMPL-POLICY>
              <BSW-ENTRY-KIND>CONCRETE</BSW-ENTRY-KIND>
            </BSW-MODULE-ENTRY>
            <BSW-MODULE-ENTRY UUID="345d7384-bb06-4329-b7bd-0317e342d81f">
              <SHORT-NAME>Can_GetControllerErrorState</SHORT-NAME>
              <SERVICE-ID>17</SERVICE-ID>
              <IS-REENTRANT>false</IS-REENTRANT>
              <IS-SYNCHRONOUS>true</IS-SYNCHRONOUS>
              <CALL-TYPE>REGULAR</CALL-TYPE>
              <EXECUTION-CONTEXT>UNSPECIFIED</EXECUTION-CONTEXT>
              <SW-SERVICE-IMPL-POLICY>STANDARD</SW-SERVICE-IMPL-POLICY>
              <BSW-ENTRY-KIND>CONCRETE</BSW-ENTRY-KIND>
            </BSW-MODULE-ENTRY>
            <BSW-MODULE-ENTRY UUID="08839271-b4b5-4df5-9258-1c17684c055f">
              <SHORT-NAME>Can_GetControllerMode</SHORT-NAME>
              <SERVICE-ID>18</SERVICE-ID>
              <IS-REENTRANT>false</IS-REENTRANT>
              <IS-SYNCHRONOUS>true</IS-SYNCHRONOUS>
              <CALL-TYPE>REGULAR</CALL-TYPE>
              <EXECUTION-CONTEXT>UNSPECIFIED</EXECUTION-CONTEXT>
              <SW-SERVICE-IMPL-POLICY>STANDARD</SW-SERVICE-IMPL-POLICY>
              <BSW-ENTRY-KIND>CONCRETE</BSW-ENTRY-KIND>
            </BSW-MODULE-ENTRY>
            <BSW-MODULE-ENTRY UUID="ced45391-39d8-4fcc-bd87-f4b48777093d">
              <SHORT-NAME>Can_GetVersionInfo</SHORT-NAME>
              <SERVICE-ID>7</SERVICE-ID>
              <IS-REENTRANT>true</IS-REENTRANT>
              <IS-SYNCHRONOUS>true</IS-SYNCHRONOUS>
              <CALL-TYPE>REGULAR</CALL-TYPE>
              <EXECUTION-CONTEXT>UNSPECIFIED</EXECUTION-CONTEXT>
              <SW-SERVICE-IMPL-POLICY>STANDARD</SW-SERVICE-IMPL-POLICY>
              <BSW-ENTRY-KIND>CONCRETE</BSW-ENTRY-KIND>
            </BSW-MODULE-ENTRY>
            <BSW-MODULE-ENTRY UUID="74e9925f-06c4-4a36-a512-6ce2f23bbc28">
              <SHORT-NAME>Can_Init</SHORT-NAME>
              <SERVICE-ID>0</SERVICE-ID>
              <IS-REENTRANT>false</IS-REENTRANT>
              <IS-SYNCHRONOUS>true</IS-SYNCHRONOUS>
              <CALL-TYPE>REGULAR</CALL-TYPE>
              <EXECUTION-CONTEXT>UNSPECIFIED</EXECUTION-CONTEXT>
              <SW-SERVICE-IMPL-POLICY>STANDARD</SW-SERVICE-IMPL-POLICY>
              <BSW-ENTRY-KIND>CONCRETE</BSW-ENTRY-KIND>
            </BSW-MODULE-ENTRY>
            <BSW-MODULE-ENTRY UUID="ca89f437-c077-4a7e-bad5-d93046f6ff2c">
              <SHORT-NAME>Can_MainFunction_BusOff</SHORT-NAME>
              <SERVICE-ID>9</SERVICE-ID>
              <IS-REENTRANT>true</IS-REENTRANT>
              <IS-SYNCHRONOUS>true</IS-SYNCHRONOUS>
              <CALL-TYPE>SCHEDULED</CALL-TYPE>
              <EXECUTION-CONTEXT>TASK</EXECUTION-CONTEXT>
              <SW-SERVICE-IMPL-POLICY>STANDARD</SW-SERVICE-IMPL-POLICY>
              <BSW-ENTRY-KIND>CONCRETE</BSW-ENTRY-KIND>
            </BSW-MODULE-ENTRY>
            <BSW-MODULE-ENTRY UUID="a25a642c-438b-4256-9dbd-2662d2175044">
              <SHORT-NAME>Can_MainFunction_Mode</SHORT-NAME>
              <SERVICE-ID>12</SERVICE-ID>
              <IS-REENTRANT>true</IS-REENTRANT>
              <IS-SYNCHRONOUS>true</IS-SYNCHRONOUS>
              <CALL-TYPE>SCHEDULED</CALL-TYPE>
              <EXECUTION-CONTEXT>TASK</EXECUTION-CONTEXT>
              <SW-SERVICE-IMPL-POLICY>STANDARD</SW-SERVICE-IMPL-POLICY>
              <BSW-ENTRY-KIND>CONCRETE</BSW-ENTRY-KIND>
            </BSW-MODULE-ENTRY>
            <BSW-MODULE-ENTRY UUID="d62326a2-76d7-4b5f-a48a-868d01e75cd8">
              <SHORT-NAME>Can_MainFunction_Read</SHORT-NAME>
              <SERVICE-ID>8</SERVICE-ID>
              <IS-REENTRANT>true</IS-REENTRANT>
              <IS-SYNCHRONOUS>true</IS-SYNCHRONOUS>
              <CALL-TYPE>SCHEDULED</CALL-TYPE>
              <EXECUTION-CONTEXT>TASK</EXECUTION-CONTEXT>
              <SW-SERVICE-IMPL-POLICY>STANDARD</SW-SERVICE-IMPL-POLICY>
              <BSW-ENTRY-KIND>CONCRETE</BSW-ENTRY-KIND>
            </BSW-MODULE-ENTRY>
            <BSW-MODULE-ENTRY UUID="e4f090d2-5452-4579-815a-91814ae787b1">
              <SHORT-NAME>Can_MainFunction_Wakeup</SHORT-NAME>
              <SERVICE-ID>10</SERVICE-ID>
              <IS-REENTRANT>true</IS-REENTRANT>
              <IS-SYNCHRONOUS>true</IS-SYNCHRONOUS>
              <CALL-TYPE>SCHEDULED</CALL-TYPE>
              <EXECUTION-CONTEXT>TASK</EXECUTION-CONTEXT>
              <SW-SERVICE-IMPL-POLICY>STANDARD</SW-SERVICE-IMPL-POLICY>
              <BSW-ENTRY-KIND>CONCRETE</BSW-ENTRY-KIND>
            </BSW-MODULE-ENTRY>
            <BSW-MODULE-ENTRY UUID="4e4e4b1e-5669-44c3-8985-65cde984c255">
              <SHORT-NAME>Can_MainFunction_Write</SHORT-NAME>
              <SERVICE-ID>1</SERVICE-ID>
              <IS-REENTRANT>true</IS-REENTRANT>
              <IS-SYNCHRONOUS>true</IS-SYNCHRONOUS>
              <CALL-TYPE>SCHEDULED</CALL-TYPE>
              <EXECUTION-CONTEXT>TASK</EXECUTION-CONTEXT>
              <SW-SERVICE-IMPL-POLICY>STANDARD</SW-SERVICE-IMPL-POLICY>
              <BSW-ENTRY-KIND>CONCRETE</BSW-ENTRY-KIND>
            </BSW-MODULE-ENTRY>
            <BSW-MODULE-ENTRY UUID="88c4b6d9-89ae-47d1-89e2-7b65de198119">
              <SHORT-NAME>Can_RegisterReadback</SHORT-NAME>
              <IS-REENTRANT>false</IS-REENTRANT>
              <IS-SYNCHRONOUS>true</IS-SYNCHRONOUS>
              <CALL-TYPE>REGULAR</CALL-TYPE>
              <EXECUTION-CONTEXT>UNSPECIFIED</EXECUTION-CONTEXT>
              <SW-SERVICE-IMPL-POLICY>STANDARD</SW-SERVICE-IMPL-POLICY>
              <BSW-ENTRY-KIND>CONCRETE</BSW-ENTRY-KIND>
            </BSW-MODULE-ENTRY>
            <BSW-MODULE-ENTRY UUID="0ca9282e-79e2-4d3a-a158-8e6bd8f1f407">
              <SHORT-NAME>Can_SetBaudrate</SHORT-NAME>
              <SERVICE-ID>15</SERVICE-ID>
              <IS-REENTRANT>false</IS-REENTRANT>
              <IS-SYNCHRONOUS>true</IS-SYNCHRONOUS>
              <CALL-TYPE>REGULAR</CALL-TYPE>
              <EXECUTION-CONTEXT>UNSPECIFIED</EXECUTION-CONTEXT>
              <SW-SERVICE-IMPL-POLICY>STANDARD</SW-SERVICE-IMPL-POLICY>
              <BSW-ENTRY-KIND>CONCRETE</BSW-ENTRY-KIND>
            </BSW-MODULE-ENTRY>
            <BSW-MODULE-ENTRY UUID="ce068c6d-0c7f-4ac5-aab5-10bd63b136c3">
              <SHORT-NAME>Can_SetControllerMode</SHORT-NAME>
              <SERVICE-ID>3</SERVICE-ID>
              <IS-REENTRANT>false</IS-REENTRANT>
              <IS-SYNCHRONOUS>false</IS-SYNCHRONOUS>
              <CALL-TYPE>REGULAR</CALL-TYPE>
              <EXECUTION-CONTEXT>UNSPECIFIED</EXECUTION-CONTEXT>
              <SW-SERVICE-IMPL-POLICY>STANDARD</SW-SERVICE-IMPL-POLICY>
              <BSW-ENTRY-KIND>CONCRETE</BSW-ENTRY-KIND>
            </BSW-MODULE-ENTRY>
            <BSW-MODULE-ENTRY UUID="0e013ca2-a25a-4aef-8c31-dc60c733d41c">
              <SHORT-NAME>Can_TestLoopBackModeDisable</SHORT-NAME>
              <IS-REENTRANT>false</IS-REENTRANT>
              <IS-SYNCHRONOUS>true</IS-SYNCHRONOUS>
              <CALL-TYPE>REGULAR</CALL-TYPE>
              <EXECUTION-CONTEXT>UNSPECIFIED</EXECUTION-CONTEXT>
              <SW-SERVICE-IMPL-POLICY>STANDARD</SW-SERVICE-IMPL-POLICY>
              <BSW-ENTRY-KIND>CONCRETE</BSW-ENTRY-KIND>
            </BSW-MODULE-ENTRY>
            <BSW-MODULE-ENTRY UUID="8f3bebf4-5ffa-4366-a635-6b9b4bf51f11">
              <SHORT-NAME>Can_TestLoopBackModeEnable</SHORT-NAME>
              <IS-REENTRANT>false</IS-REENTRANT>
              <IS-SYNCHRONOUS>true</IS-SYNCHRONOUS>
              <CALL-TYPE>REGULAR</CALL-TYPE>
              <EXECUTION-CONTEXT>UNSPECIFIED</EXECUTION-CONTEXT>
              <SW-SERVICE-IMPL-POLICY>STANDARD</SW-SERVICE-IMPL-POLICY>
              <BSW-ENTRY-KIND>CONCRETE</BSW-ENTRY-KIND>
            </BSW-MODULE-ENTRY>
            <BSW-MODULE-ENTRY UUID="410173d9-6d41-4c6d-8fe7-ea29f9732b9a">
              <SHORT-NAME>Can_Write</SHORT-NAME>
              <SERVICE-ID>6</SERVICE-ID>
              <IS-REENTRANT>true</IS-REENTRANT>
              <IS-SYNCHRONOUS>true</IS-SYNCHRONOUS>
              <CALL-TYPE>REGULAR</CALL-TYPE>
              <EXECUTION-CONTEXT>UNSPECIFIED</EXECUTION-CONTEXT>
              <SW-SERVICE-IMPL-POLICY>STANDARD</SW-SERVICE-IMPL-POLICY>
              <BSW-ENTRY-KIND>CONCRETE</BSW-ENTRY-KIND>
            </BSW-MODULE-ENTRY>
          </ELEMENTS>
        </AR-PACKAGE>
      </AR-PACKAGES>
    </AR-PACKAGE>
  </AR-PACKAGES>
</AUTOSAR>
