AUTOSAR XML (schema 00044)
package /TI_AM263Px
  module definition Spi [0..1]: post-build-variant-support=true, refined-module-def=Spi, variants link-time/post-build/pre-compile  # Configuration of the Spi (Serial Peripheral Interface) module.
    container SpiDemEventParameterRefs [0..1]  # Container for the references to DemEventParameter elements which shall be invoked using the API Dem_SetEventStatus in case the corresponding error occurs. The EventId is taken from the referenced DemEventParameter's DemEventId symbolic value. The standardized errors are provided in this container and can be extended by vendor-specific error references.
      symbolic name reference SPI_E_HARDWARE_ERROR [0..1]: multiplicity set at pre-compile, set at pre-compile, destination=DemEventParameter  # Reference to configured DEM event to report "Hardware failure". If the reference is not configured the error shall not be reported.
    container SpiDriver  # This container contains the configuration parameters and sub containers of the AUTOSAR Spi module.
      integer SpiMaxChannel [0..1]: 0..255, multiplicity set at link in variant link-time / post-build in variant post-build / pre-compile in variant pre-compile, post-build-variant-multiplicity=true, post-build-variant-value=true, set at link in variant link-time / post-build in variant post-build / pre-compile in variant pre-compile, default-value=1  # This parameter contains the number of Channels configured. It will be gathered by tools during the configuration stage.Max range is derived from SpiMaxChannels.Please refer SpiGeneral/SpiMaxChannels.
      integer SpiMaxJob [0..1]: 0..65535, multiplicity set at link in variant link-time / post-build in variant post-build / pre-compile in variant pre-compile, post-build-variant-multiplicity=true, post-build-variant-value=true, set at link in variant link-time / post-build in variant post-build / pre-compile in variant pre-compile, default-value=1  # Total number of Jobs configured.Max range is derived from SpiMaxJobs.Please refer SpiGeneral/SpiMaxJobs.
      integer SpiMaxSequence [0..1]: 0..255, multiplicity set at link in variant link-time / post-build in variant post-build / pre-compile in variant pre-compile, post-build-variant-multiplicity=true, post-build-variant-value=true, set at link in variant link-time / post-build in variant post-build / pre-compile in variant pre-compile, default-value=1  # Total number of Sequences configured.Max range is derived from SpiMaxSequences.Please refer SpiGeneral/SpiMaxSequences.
      integer SpiMaxHwUnit: 0..8, origin=Texas Instruments, set at link in variant link-time / post-build in variant post-build / pre-compile in variant pre-compile, default-value=8  # Maximum number of HW unit.Max range is derived from SpiMaxHwUnit.Please refer SpiPublishedInformation/SpiMaxHwUnit.
      integer SpiMaxExternalDeviceConfig: 0..8, origin=Texas Instruments, set at link in variant link-time / post-build in variant post-build / pre-compile in variant pre-compile, default-value=1  # Maximum Number of different SPI hardware microcontroller peripherals available and handled by this SPI Handler/Driver module.Max range is derived from SpiMaxExternalDevices.Please refer SpiGeneral/SpiMaxExternalDevices.
      container SpiChannel [1..255]  # All data needed to configure one SPI-channel
        integer SpiChannelId: 0..255, set at pre-compile, symbolic-name-value=true, default-value=0  # SPI Channel ID, used as parameter in SPI API functions.
        enumeration SpiChannelType: {EB, IB}, post-build-variant-value=true, set at link in variant link-time / post-build in variant post-build / pre-compile in variant pre-compile, default-value=EB  # Buffer usage with EB/IB channel.
        integer SpiDataWidth: 1..32, post-build-variant-value=true, set at link in variant link-time / post-build in variant post-build / pre-compile in variant pre-compile, default-value=8  # This parameter is the width of a transmitted data unit.
        integer SpiDefaultData [0..1]: 0..4294967295, multiplicity set at link in variant link-time / post-build in variant post-build / pre-compile in variant pre-compile, post-build-variant-multiplicity=true, post-build-variant-value=true, set at link in variant link-time / post-build in variant post-build / pre-compile in variant pre-compile, default-value=0  # The default data to be transmitted when (for internal buffer or external buffer) the pointer passed to Spi_WriteIB (for internal buffer) or to Spi_SetupEB (for external buffer) is NULL.
        integer SpiEbMaxLength: 0..65535, post-build-variant-value=true, set at link in variant link-time / post-build in variant post-build / pre-compile in variant pre-compile, default-value=255  # This parameter contains the maximum size (number of data elements) of data buffers in case of EB Channels and only.
        integer SpiIbNBuffers: 0..65535, post-build-variant-value=true, set at link in variant link-time / post-build in variant post-build / pre-compile in variant pre-compile, default-value=10  # This parameter contains the maximum number of data buffers in case of IB Channels and only.
        enumeration SpiTransferStart: {LSB, MSB}, post-build-variant-value=true, set at link in variant link-time / post-build in variant post-build / pre-compile in variant pre-compile, default-value=MSB  # This parameter defines the first starting bit for transmission.
      container SpiExternalDevice [1..*]  # The communication settings of an external device. Closely linked to SpiJob.
        integer SpiExternalDeviceId: 0..65535, origin=Texas Instruments, set at pre-compile, default-value=0  # The index of the corresponding external device config associated with job.
        float SpiBaudrate: 0.0..INF, post-build-variant-value=true, set at link in variant link-time / post-build in variant post-build / pre-compile in variant pre-compile, default-value=500.0  # This parameter is the communication baudrate - This parameter allows using a range of values, from the point of view of configuration tools, from Hz up to MHz. SPI Baudrate is not used.Instead SpiExtDeviceClockDivider is used to derive required baudrate.Refer to Baudrate Calculation session in SPI_Userguide.
        string SpiCsIdentifier: set at pre-compile, symbolic-name-value=true, default-value=SCS0  # This parameter is the symbolic name to identify the Chip Select (CS) allocated to this Job.
        enumeration SpiCsPolarity: {HIGH, LOW}, post-build-variant-value=true, set at link in variant link-time / post-build in variant post-build / pre-compile in variant pre-compile, default-value=HIGH  # This parameter defines the active polarity of Chip Select.
        enumeration SpiCsSelection [0..0]: {SPI_CS_VIA_GPIO, SPI_CS_VIA_PERIPHERAL_ENGINE}, post-build-variant-value=true, set at link in variant link-time / post-build in variant post-build / pre-compile in variant pre-compile, default-value=SPI_CS_VIA_PERIPHERAL_ENGINE  # When the Chip select handling is enabled (see SpiEnableCs), then this parameter specifies if the chip select is handled automatically by Peripheral HW engine or via general purpose IO by Spi driver.
        enumeration SpiDataShiftEdge: {LEADING, TRAILING}, post-build-variant-value=true, set at link in variant link-time / post-build in variant post-build / pre-compile in variant pre-compile, default-value=LEADING  # This parameter defines the SPI data shift edge.
        boolean SpiEnableCs: post-build-variant-value=true, set at link in variant link-time / post-build in variant post-build / pre-compile in variant pre-compile, default-value=true  # This parameter enables or not the Chip Select handling functions. If this parameter is enabled then parameter SpiCsSelection further details the type of chip selection.
        enumeration SpiHwUnit: {CSIB0, CSIB1, CSIB2, CSIB3, CSIB4}, set at link in variant link-time / post-build in variant post-build / pre-compile in variant pre-compile, default-value=CSIB0  # This parameter is the symbolic name to identify the HW SPI Hardware microcontroller peripheral allocated to this Job.
        enumeration SpiShiftClockIdleLevel: {HIGH, LOW}, post-build-variant-value=true, set at link in variant link-time / post-build in variant post-build / pre-compile in variant pre-compile, default-value=LOW  # This parameter defines the SPI shift clock idle level.
        float SpiTimeClk2Cs [0..0]: 0.0..1.0E-4, post-build-variant-value=true, set at link in variant link-time / post-build in variant post-build / pre-compile in variant pre-compile, default-value=1.0E-4  # Timing between clock and chip select (in seconds) - This parameter allows to use a range of values from 0 up to 0.0001 seconds.
        enumeration SpiCsMode: {SPI_SINGLE, SPI_CONTINUOUS}, origin=Texas Instruments, set at link in variant link-time / post-build in variant post-build / pre-compile in variant pre-compile, default-value=SPI_CONTINUOUS  # This selcts which CS mode the device should enter. SPI_SINGLE: the CS will return to default level after one transmission unit has been sent. SPI_CONTINUOUS: the CS will remain active during the whole transmission.
        enumeration SpiCsIdleTime: {SPI_DATADELAY_0, SPI_DATADELAY_1, SPI_DATADELAY_2, SPI_DATADELAY_3}, origin=Texas Instruments, set at link in variant link-time / post-build in variant post-build / pre-compile in variant pre-compile, default-value=SPI_DATADELAY_0  # CS idle time (Timing between clock and chip select) if single mode is chosen.
        integer SpiExtDeviceClockDivider: 0..65535, origin=Texas Instruments, set at link in variant link-time / post-build in variant post-build / pre-compile in variant pre-compile, default-value=0  # Clock divider. This is used to derive the required baudrate from the functional clock. This value should be 1 less than the actual divider value. So a value of 0 means the divider is 1
        container SpiExternalDeviceConfigMCSPI  # MCSPI HW specific external device config. Should be populated only if hwUnitId is of type MCSPI
          enumeration SpiExtDeviceMCSPITxRxMode: {SPI_TX_RX_MODE_BOTH, SPI_TX_RX_MODE_TX_ONLY}, origin=Texas Instruments, set at link in variant link-time / post-build in variant post-build / pre-compile in variant pre-compile, default-value=SPI_TX_RX_MODE_BOTH  # TX and RX mode. Data is transmitted (shifted out serially on SPIDAT[0]) and received (shifted in serially on SPIDAT[1]) simultaneously on separate data lines. Tx only mode - Data is only transmiited (shifted out serially on SPIDAT). Minimizies data movement when only transmission is meaningful. RX only mode doesn't make sense in master mode because to receive data the master has to generate clock, which means it should transmit first. Hence this mode is not supported. The user can alternatively set the TX buffer pointer to NULL and set the default TX value (defaultTxData) to make TX data line at the desired level. in case of Both EB/IB Buffer Mode.
          boolean SpiExtDeviceMCSPIStartBitEnable: origin=Texas Instruments, set at link in variant link-time / post-build in variant post-build / pre-compile in variant pre-compile, default-value=true  # Start bit D/CX added before SPI transfer. Polarity is defined by StartBitLevel
          enumeration SpiExtDeviceMCSPIStartBitLevel: {SPI_LOW, SPI_HIGH}, origin=Texas Instruments, set at link in variant link-time / post-build in variant post-build / pre-compile in variant pre-compile, default-value=SPI_LOW  # Start-bit polarity used when startBitEnable is TRUE.
          enumeration SpiExtDeviceMCSPIDataLineSelectReception: {DATA_LINE_0_RECEPTION, DATA_LINE_1_RECEPTION}, origin=Texas Instruments, set at link in variant link-time / post-build in variant post-build / pre-compile in variant pre-compile, default-value=DATA_LINE_0_RECEPTION  # Data Line 0 or 1 selected for reception.
          enumeration SpiExtDeviceMCSPIDataLineSelectTransmission: {DATA_LINE_NO_TRANSMISSION, DATA_LINE_0_TRANSMISSION, DATA_LINE_1_TRANSMISSION, DATA_LINE_BOTH_TRANSMISSION}, origin=Texas Instruments, set at link in variant link-time / post-build in variant post-build / pre-compile in variant pre-compile, default-value=DATA_LINE_1_TRANSMISSION  # Data Line 0 or 1 or both selected for transmission.No transmission on data lines if DATA_LINE_NO_TRANSMISSION is selected
      container SpiJob [1..*]  # All data needed to configure one SPI-Job, amongst others the connection between the internal SPI unit and the special settings for an external device is done.
        enumeration SpiHwUnitSynchronous [0..1]: {ASYNCHRONOUS, SYNCHRONOUS}, multiplicity set at link in variant link-time / post-build in variant post-build / pre-compile in variant pre-compile, post-build-variant-multiplicity=true, post-build-variant-value=true, set at link in variant link-time / post-build in variant post-build / pre-compile in variant pre-compile, default-value=ASYNCHRONOUS  # If SpiHwUnitSynchronous is set to "SYNCHRONOUS", the SpiJob uses its containing SpiDriver in a synchronous manner. If it is set to "ASYNCHRONOUS", it uses the driver in an asynchronous way. If the parameter is not set, the SpiChannel uses the driver also in an asynchronous way. Tags: atp.Status=obsolete
        function name SpiJobEndNotification [0..1]: multiplicity set at link in variant link-time / post-build in variant post-build / pre-compile in variant pre-compile, post-build-variant-multiplicity=true, post-build-variant-value=true, set at link in variant link-time / post-build in variant post-build / pre-compile in variant pre-compile, default-value=NULL_PTR  # This parameter is a reference to a notification function.
        integer SpiJobId: 0..65535, set at pre-compile, symbolic-name-value=true, default-value=0  # SPI Job ID, used as parameter in SPI API functions.
        integer SpiJobPriority: 0..3, post-build-variant-value=true, set at link in variant link-time / post-build in variant post-build / pre-compile in variant pre-compile, default-value=3  # Priority set accordingly to SPI093: 0, lowest, 3, highest priority
        reference SpiDeviceAssignment: set at pre-compile, destination=SpiExternalDevice  # Reference to the external device used by this job
        reference SpiHwUnitAssignment: origin=Texas Instruments, set at pre-compile, destination=SpiHwUnitConfig  # Reference to the HW unit used by this job
        container SpiChannelList [1..32]  # References to SPI channels and their order within the Job.
          integer SpiChannelIndex: 0..255, post-build-variant-value=true, set at link in variant link-time / post-build in variant post-build / pre-compile in variant pre-compile, default-value=0  # This parameter specifies the order of Channels within the Job.
          reference SpiChannelAssignment: post-build-variant-value=true, set at link in variant link-time / post-build in variant post-build / pre-compile in variant pre-compile, destination=SpiChannel  # A job reference to a SPI channel.
      container SpiSequence [1..*]  # All data needed to configure one SPI-sequence
        boolean SpiInterruptibleSequence: post-build-variant-value=true, set at link in variant link-time / post-build in variant post-build / pre-compile in variant pre-compile, default-value=true  # This parameter allows or not this Sequence to be suspended by another one.
        function name SpiSeqEndNotification [0..1]: multiplicity set at link in variant link-time / post-build in variant post-build / pre-compile in variant pre-compile, post-build-variant-multiplicity=true, post-build-variant-value=true, set at link in variant link-time / post-build in variant post-build / pre-compile in variant pre-compile, default-value=NULL_PTR  # This parameter is a reference to a notification function.
        integer SpiSequenceId: 0..255, scope=ECU, set at pre-compile, symbolic-name-value=true, default-value=0  # SPI Sequence ID, used as parameter in SPI API functions.
        reference SpiJobAssignment [1..255]: multiplicity set at link in variant link-time / post-build in variant post-build / pre-compile in variant pre-compile, post-build-variant-multiplicity=true, post-build-variant-value=true, set at link in variant link-time / post-build in variant post-build / pre-compile in variant pre-compile, destination=SpiJob  # A sequence references several jobs, which are executed during a communication sequence
      container SpiHwUnitConfig [1..8]  # HW Unit configurations
        enumeration SpiHwUnitType: {SPI_UNIT_MCSPI0, SPI_UNIT_MCSPI1, SPI_UNIT_MCSPI2, SPI_UNIT_MCSPI3, SPI_UNIT_MCSPI4, SPI_UNIT_MCSPI5, SPI_UNIT_MCSPI6, SPI_UNIT_MCSPI7}, origin=Texas Instruments, set at link in variant link-time / post-build in variant post-build / pre-compile in variant pre-compile, default-value=SPI_UNIT_MCSPI0  # SPI HW unit to use.
        boolean SpiHwUnitDmaEnable: origin=Texas Instruments, set at pre-compile in variant pre-compile / link in variant link-time / post-build in variant post-build, default-value=false  # Enables DMA support for MCSPI instance
        reference SpiHwUnitCddDmaTxHandler [0..1]: origin=Texas Instruments, set at link in variant link-time / post-build in variant post-build / pre-compile in variant pre-compile, destination=CddDmaDriverHandler  # References the CDD DMA handler used for MCSPI transmission
        reference SpiHwUnitCddDmaRxHandler [0..1]: origin=Texas Instruments, set at link in variant link-time / post-build in variant post-build / pre-compile in variant pre-compile, destination=CddDmaDriverHandler  # References the CDD DMA handler used for MCSPI reception
    container SpiGeneral  # General configuration settings for SPI-Handler
      boolean SpiCancelApi: set at pre-compile, default-value=true  # Switches the Spi_Cancel function ON or OFF.
      boolean SpiEnableJobLog: origin=Texas Instruments, set at pre-compile, default-value=false  # Enable/disable SPI job log
      integer SpiMaxExternalDevices: 1..8, origin=Texas Instruments, set at pre-compile, default-value=8  # Number of different SPI hardware microcontroller peripherals (units/busses) available and handled by this SPI Handler/Driver module.
      integer SpiMaxJobLogLength: 1..65535, origin=Texas Instruments, set at pre-compile, default-value=100  # Maximum job log entries when logging is ON
      integer SpiMaxTimeoutDuration: 1..4294967295, origin=Texas Instruments, set at pre-compile, default-value=10000  # Maximum time duration for SPI transmission. Unit is in clock ticks. Configure the timeout according to r5f clock frequency(400MHz/200MHz)
      integer SpiMaxChannelsPerJob: 1..255, origin=Texas Instruments, set at pre-compile, default-value=4  # Maximum channels allowed per job Max range is derived from realtime usecases.
      integer SpiMaxJobsPerSequence: 1..255, origin=Texas Instruments, set at pre-compile, default-value=4  # Maximum jobs allowed per sequence Max range is derived from realtime usecases.
      integer SpiMaxChannels: 1..255, origin=Texas Instruments, set at pre-compile, default-value=24  # Maximum channels across all jobs/sequence/hwunit
      integer SpiMaxJobs: 1..65535, origin=Texas Instruments, set at pre-compile, default-value=10  # Maximum jobs across all sequence/hwunit
      integer SpiMaxSequences: 1..255, origin=Texas Instruments, set at pre-compile, default-value=10  # Maximum sequences across all hwunit
      integer SpiChannelBuffersAllowed: 0..2, set at pre-compile, default-value=2  # Selects the SPI Handler/Driver Channel Buffers usage allowed and delivered. IB = 0; EB = 1; IB/EB = 2;
      boolean SpiDevErrorDetect: set at pre-compile, default-value=true  # Switches the development error detection and notification on or off.
      boolean SpiHwStatusApi: set at pre-compile, default-value=true  # Switches the Spi_GetHWUnitStatus function ON or OFF.
      boolean SpiInterruptibleSeqAllowed: set at pre-compile, default-value=true  # Switches the Interruptible Sequences handling functionality ON or OFF.
      integer SpiLevelDelivered: 0..2, set at pre-compile, default-value=2  # Selects the SPI Handler/Driver level of scalable functionality: SYNC ONLY(0), ASYNC ONLY (1), SYNC/ASYNC(2)
      float SpiMainFunctionPeriod: 0.0..INF, set at pre-compile, default-value=0.01  # This parameter defines the cycle time of the function Spi_MainFunction_Handling in seconds. The parameter is not used by the driver it self, but it is used by upper layer.
      boolean SpiSupportConcurrentSyncTransmit: set at pre-compile, default-value=false  # Specifies whether concurrent Spi_SyncTransmit() calls for different sequences shall be configurable.
      string SpiUserCallbackHeaderFile [0..*]: multiplicity set at pre-compile, set at pre-compile  # Header file name which will be included by the Spi. The value of this parameter shall be used as h-char-sequence or q-char-sequence according to ISO C90 section 6.10.2 "source file inclusion". The parameter value MUST NOT represent a path, since ISO C90 does not specify how such a path is treated (i.e., this is implementation defined (and additionally depends on the operating system and the underlying file system)).
      boolean SpiVersionInfoApi: set at pre-compile, default-value=true  # Switches the Spi_GetVersionInfo function ON or OFF.
      enumeration SpiIrqType: {SPI_ISR_VOID, SPI_ISR_CAT1, SPI_ISR_CAT2}, origin=Texas Instruments, set at pre-compile, default-value=SPI_ISR_CAT2  # Type of Isr function: void functionname(void) CAT1 : interrupt void func(void) CAT2 : ISR(func)
      integer SpiDefaultOSCounterId [0..1]: 0..16, origin=Texas Instruments, set at pre-compile, default-value=0  # Default Os Counter Id if node reference to OsCounter ref SpiOsCounterRef is not set
      integer SpiTimeoutDuration: 1..4294967295, origin=Texas Instruments, set at pre-compile, default-value=32000  # SPI timeout - used in SPI busy wait. Unit is in clock ticks. Configure the timeout according to r5f clock frequency(400MHz/200MHz)
      boolean SpiRegisterReadbackApi: origin=Texas Instruments, set at pre-compile, default-value=true  # Enable API to readback SPI critical registers
      boolean SpiSafetyApi: origin=Texas Instruments, set at pre-compile, default-value=true  # Enable API to do safety diagnostic
      integer SpiChannelInternalBufferMaxLength: 1..4294967295, origin=Texas Instruments, set at pre-compile, default-value=64  # Internal Buffer length in bytes - applicable for SpiChannelBuffer type - SPI_IB. This is the maximum length that can be allocated by each channel and it is fixed.Can vary buffer length per channel by configuring SpiIbNBuffers and SpiDataWidth. Refer MCAL-1255 and MCAL-1203
      enumeration SpiDeviceVariant: {AM263Px}, origin=Texas Instruments, set at pre-compile, default-value=AM263Px  # Select SOC variant
      reference SpiOsCounterRef [0..1]: origin=Texas Instruments, set at pre-compile, destination=OsCounter  # This parameter contains a reference to the OsCounter, which is used by the SPI driver.
      container SpiHwUnitEnabled [1..8]  # Structure for storing enabled SPI HW units
        enumeration SpiHwUnitEnabledFlag: {SPI_HWUNIT_MCSPI0, SPI_HWUNIT_MCSPI1, SPI_HWUNIT_MCSPI2, SPI_HWUNIT_MCSPI3, SPI_HWUNIT_MCSPI4, SPI_HWUNIT_MCSPI5, SPI_HWUNIT_MCSPI6, SPI_HWUNIT_MCSPI7}, origin=Texas Instruments, set at pre-compile, default-value=SPI_HWUNIT_MCSPI0  # Group configurations
    container SpiPublishedInformation  # Container holding all SPI specific published information parameters
      integer SpiMaxHwUnit: 8..8, set at published-information, default-value=8  # Number of different SPI hardware microcontroller peripherals (units/busses) available and handled by this SPI Handler/Driver module.
