AUTOSAR XML (schema 00044)
package /TI_AM263Px
  module definition Cdd_Pwm [0..*]: refined-module-def=Cdd, variants post-build/pre-compile  # Configuration of Cdd Pwm (Complex Device driver Pulse Width Modulation) module.
    container CddPwmConfigurationOfOptionalApis [0..1]: multiplicity set at pre-compile  # Configuration of optional APIs.
      boolean CddPwmDeInitApi: origin=Texas Instruments, set at pre-compile, default-value=true  # Adds / removes the service CddPwmDeInit() from the code.
      boolean CddPwmGetCounterApi: origin=Texas Instruments, set at pre-compile, default-value=true  # Adds / removes the service CddPwmGetCounter() from the code.
      boolean CddPwmVersionInfoApi: origin=Texas Instruments, set at pre-compile, default-value=true  # Switch to indicate that the CddPwmGetVersionInfo() is supported.
      boolean CddPwmEnableRegisterReadbackApi: origin=Texas Instruments, set at pre-compile, default-value=true  # Switch to indicate that the CddPwmRegisterReadBack is supported.
      boolean CddPwmSetRelativeThreshold: origin=Texas Instruments, set at pre-compile, default-value=true  # Switches the API Cdd_Pwm_SetRelativeThreshold.
      boolean CddPwmSetAbsoluteThreshold: origin=Texas Instruments, set at pre-compile, default-value=true  # Switches the API Cdd_Pwm_SetAbsoluteThreshold.
      boolean CddPwmSetPinAction: origin=Texas Instruments, set at pre-compile, default-value=true  # Switches the API Cdd_Pwm_SetPinAction.
      boolean CddPwmSetPeriodDutyPhase: origin=Texas Instruments, set at pre-compile, default-value=true  # Switches the API Cdd_Pwm_SetPeriodDutyPhase.
      boolean CddPwmSetOutputToIdle: origin=Texas Instruments, set at pre-compile, default-value=true  # Switches the API Cdd_Pwm_SetOutputToIdle.
      boolean CddPwmGetCounterStatus: origin=Texas Instruments, set at pre-compile, default-value=true  # Switches the API Cdd_Pwm_GetCounterStatus.
      boolean CddPwmCounterComparatorCfg: origin=Texas Instruments, set at pre-compile, default-value=true  # Switches the API Cdd_Pwm_CounterComparatorCfg.
      boolean CddPwmSetAdcTriggerApi: origin=Texas Instruments, set at pre-compile, default-value=true  # Switch to indicate that the ADC enable API is supported.
      boolean CddPwmNotificationSupported: origin=Texas Instruments, set at pre-compile, default-value=true  # Adds / removes the services CddPwmEnableNotification() and CddPwmDisableNotification() from the code.
    container CddPwmGeneral  # This container contains the module-wide configuration parameters of the CDD PWM Driver
      boolean CddPwmDevErrorDetect: origin=Texas Instruments, set at pre-compile, default-value=true  # Switches the Development Error Detection ON or OFF.
      boolean CddPwmEventTriggerEnable: origin=Texas Instruments, set at pre-compile, default-value=true  # Switches the Pwm event trigger functionality ON or OFF.
      boolean CddPwmTripZoneEnable: origin=Texas Instruments, set at pre-compile, default-value=true  # Switches the Pwm Trip zone functionality ON or OFF.
      boolean CddPwmDigitalCompareEnable: origin=Texas Instruments, set at pre-compile, default-value=false  # Switches the Pwm Digital Compare functionality ON or OFF.
      boolean CddPwmDeadBandEnable: origin=Texas Instruments, set at pre-compile, default-value=true  # Switches the PWM dead band functionality ON or OFF.
      boolean CddPwmChopperEnable: origin=Texas Instruments, set at pre-compile, default-value=true  # Switches the PWM chopper functionality ON or OFF.
      boolean CddPwmActionQualifierEnable: origin=Texas Instruments, set at pre-compile, default-value=true  # Switches the Pwm Action Qualifier functionality ON or OFF.
      boolean CddPwmChannelTimerBaseSyncEnable: origin=Texas Instruments, set at pre-compile, default-value=true  # Switches the PWM timer base sync functionality ON or OFF.
      boolean CddPwmChannelHighResPwmEnable: origin=Texas Instruments, set at pre-compile, default-value=true  # Switches the High Resolution PWM functionality ON or OFF.
      boolean CddPwmHrSetPeriodDutyEnable: origin=Texas Instruments, set at pre-compile, default-value=true  # Enable/Disable switch the API Cdd_Pwm_HrSetPeriodDutyPhase.
      boolean CddPwmHrSfoCalibrationEnable: origin=Texas Instruments, set at pre-compile, default-value=true  # Enable/disable switch to the API Cdd_Pwm_HrSfoCalibration.
      boolean CddPwmHrSfoStatusEnable: origin=Texas Instruments, set at pre-compile, default-value=true  # Enable/disable switch to the API Cdd_Pwm_HrSfoStatus.
      enumeration CddPwmTypeofInterruptFunction: {CDD_PWM_ISR_VOID, CDD_PWM_ISR_CAT1, CDD_PWM_ISR_CAT2}, origin=Texas Instruments, set at pre-compile, default-value=CDD_PWM_ISR_VOID  # Type of ISR function
      integer CddPwmSystemClock: 0..200000000, origin=Texas Instruments, set at pre-compile, default-value=200000000  # This parameter specifies the starting parameter of the EDMA channel for use as own resource.
      integer CddPwmMaxDutyCycle: 0..65536, origin=Texas Instruments, set at pre-compile, default-value=65536  # The physical hardware channel that is assigned to this logical channel.
    container CddPwmPublishedInformation  # Container holding all Pwm module published information parameters
      enumeration CddPwmDeviceVariant: {AM263PX}, origin=Texas Instruments, set at pre-compile, default-value=AM263PX  # Device variant MCAL
      integer CddPwmNumberofChannel: origin=Texas Instruments, set at pre-compile, default-value=32  # Number of actual HW channels. This is of type published information and not editable
    container CddPwmConfigSet  # This container is the base of a Configuration Set, which contains the configured Cdd Pwm channels. This way, different configuration sets can be defined for post-build process.
      container CddPwmChannel [1..128]  # Configuration of an individual CDD PWM channel.
        integer CddPwmChannelId: 0..127, origin=Texas Instruments, set at pre-compile  # The physical hardware channel that is assigned to this logical channel.
        enumeration CddPwmHwChannel: {CDD_PWM_CHANNEL_0, CDD_PWM_CHANNEL_1, CDD_PWM_CHANNEL_2, CDD_PWM_CHANNEL_3, CDD_PWM_CHANNEL_4, CDD_PWM_CHANNEL_5, CDD_PWM_CHANNEL_6, CDD_PWM_CHANNEL_7, CDD_PWM_CHANNEL_8, CDD_PWM_CHANNEL_9, CDD_PWM_CHANNEL_10, CDD_PWM_CHANNEL_11, CDD_PWM_CHANNEL_12, CDD_PWM_CHANNEL_13, CDD_PWM_CHANNEL_14, CDD_PWM_CHANNEL_15, CDD_PWM_CHANNEL_16, CDD_PWM_CHANNEL_17, CDD_PWM_CHANNEL_18, CDD_PWM_CHANNEL_19, CDD_PWM_CHANNEL_20, CDD_PWM_CHANNEL_21, CDD_PWM_CHANNEL_22, CDD_PWM_CHANNEL_23, CDD_PWM_CHANNEL_24, CDD_PWM_CHANNEL_25, CDD_PWM_CHANNEL_26, CDD_PWM_CHANNEL_27, CDD_PWM_CHANNEL_28, CDD_PWM_CHANNEL_29, CDD_PWM_CHANNEL_30, CDD_PWM_CHANNEL_31}, origin=Texas Instruments, set at pre-compile, default-value=CDD_PWM_CHANNEL_0  # The physical hardware channel that is assigned to this logical channel.
        enumeration CddPwmGroupUnit: {CDD_PWM_CONTROLSS_G0, CDD_PWM_CONTROLSS_G1, CDD_PWM_CONTROLSS_G2, CDD_PWM_CONTROLSS_G3}, origin=Texas Instruments, post-build-variant-value=true, set at pre-compile, default-value=CDD_PWM_CONTROLSS_G0  # The parameter is used to select the EPWM Group unit: G0, G1, G2 and G3.
        enumeration CddPwmOutPutChannelSelection: {CDD_PWM_OUTPUT_CH_BOTH_A_AND_B, CDD_PWM_OUTPUT_CH_A, CDD_PWM_OUTPUT_CH_B}, origin=Texas Instruments, post-build-variant-value=true, set at pre-compile, default-value=CDD_PWM_OUTPUT_CH_BOTH_A_AND_B  # The parameter is used to select the EPWM Channel EPWMA or EPWMB or Both.
        enumeration CddPwmPolarity: {CDD_PWM_HIGH, CDD_PWM_LOW}, origin=Texas Instruments, post-build-variant-value=true, set at pre-compile in variant pre-compile / post-build in variant post-build, default-value=CDD_PWM_HIGH  # The parameter is used to select the EPWM Channel Polarity HIGH or LOW.
        function name CddPwmNotification [0..1]: origin=Texas Instruments, post-build-variant-multiplicity=true, post-build-variant-value=true, set at pre-compile in variant pre-compile / post-build in variant post-build, default-value=NULL_PTR  # Callback function for each Channel
        function name CddPwmTzNotification [0..1]: origin=Texas Instruments, post-build-variant-multiplicity=true, post-build-variant-value=true, set at pre-compile in variant pre-compile / post-build in variant post-build, default-value=NULL_PTR  # Trip Zone Event Callback function for each Channel
        reference CddPwmChannelTimerBaseRef [0..1]: origin=Texas Instruments, set at pre-compile in variant pre-compile / post-build in variant post-build, destination=CddPwmTimerBase  # This parameter contains a reference to the Timer Base parameters, which is used by the CDD PWM Driver.
        reference CddPwmChannelTimerBaseSyncRef [0..1]: origin=Texas Instruments, set at pre-compile in variant pre-compile / post-build in variant post-build, destination=CddPwmTimerBaseSync  # This parameter contains a reference to the Timer Base Sync parameters, which is used by the CDD PWM Driver.
        reference CddPwmCounterCompareRef [0..1]: origin=Texas Instruments, set at pre-compile in variant pre-compile / post-build in variant post-build, destination=CddPwmCounterCompare  # This parameter contains a reference to the Counter Compare parameters, which is used by the CDD PWM Driver.
        reference CddPwmActionQualifierRef [0..1]: origin=Texas Instruments, set at pre-compile in variant pre-compile / post-build in variant post-build, destination=CddPwmActionQualifier  # This parameter contains a reference to the Action Qualifier parameters, which is used by the CDD PWM Driver.
        reference CddPwmEventTriggerRef [0..1]: origin=Texas Instruments, set at pre-compile in variant pre-compile / post-build in variant post-build, destination=CddPwmEventTrigger  # This parameter contains a reference to the event trigger parameters, which is used by the CDD PWM Driver.
        reference CddPwmAdcEventTriggerRef [0..1]: origin=Texas Instruments, set at pre-compile in variant pre-compile / post-build in variant post-build, destination=CddPwmAdcEventTrigger  # This parameter contains a reference to the event trigger parameters, which is used by the CDD PWM Driver.
        reference CddPwmTripZoneRef [0..1]: origin=Texas Instruments, set at pre-compile in variant pre-compile / post-build in variant post-build, destination=CddPwmTripZone  # This parameter contains a reference to the Trip Zone parameters, which is used by the CDD PWM Driver.
        reference CddPwmDigitalCompareRef [0..1]: origin=Texas Instruments, set at pre-compile in variant pre-compile / post-build in variant post-build, destination=CddPwmDigitalCompare  # This parameter contains a reference to the Digital Compare parameters, which is used by the CDD PWM Driver.
        reference CddPwmDeadBandRef [0..1]: origin=Texas Instruments, set at pre-compile in variant pre-compile / post-build in variant post-build, destination=CddPwmDeadBand  # This parameter contains a reference to the dead band parameters, which is used by the CDD PWM Driver.
        reference CddPwmChopperRef [0..1]: origin=Texas Instruments, set at pre-compile in variant pre-compile / post-build in variant post-build, destination=CddPwmChopper  # This parameter contains a reference to the chopper parameters, which is used by the CDD PWM Driver.
        reference CddPwmHighResolutionPwmRef [0..1]: origin=Texas Instruments, set at pre-compile in variant pre-compile / post-build in variant post-build, destination=CddPwmHighResolutionPwm  # This parameter contains a reference to the HRPWM parameters, which is used by the CDD PWM Driver.
      container CddPwmTimerBase [1..32]  # Configuration of an individual CDD PWM channel.
        integer CddPwmTimerBaseId: 0..255, origin=Texas Instruments, set at pre-compile in variant pre-compile / post-build in variant post-build  # The Timer Base unit ID.
        boolean CddPwmTimerBaseGlobalLoad: origin=Texas Instruments, set at pre-compile in variant pre-compile / post-build in variant post-build, default-value=false  # Use global load configuration for PRD.
        boolean CddPwmTimerBaseShadowMode: origin=Texas Instruments, set at pre-compile in variant pre-compile / post-build in variant post-build, default-value=false  # The physical hardware channel that is assigned to this logical channel.
        enumeration CddPwmEmulationMode: {CDD_PWM_EMULATION_STOP_AFTER_NEXT_TB, CDD_PWM_EMULATION_STOP_AFTER_FULL_CYCLE, CDD_PWM_EMULATION_FREE_RUN}, origin=Texas Instruments, post-build-variant-value=true, set at pre-compile in variant pre-compile / post-build in variant post-build, default-value=CDD_PWM_EMULATION_FREE_RUN  # Behavior of the ePWM time-base counter during emulation events: Stop after next Time Base counter increment or decrement, Stop when counter completes whole cycle, Free run counter.
        enumeration CddPwmClockDivider: {CDD_PWM_CLOCK_DIVIDER_1, CDD_PWM_CLOCK_DIVIDER_2, CDD_PWM_CLOCK_DIVIDER_4, CDD_PWM_CLOCK_DIVIDER_8, CDD_PWM_CLOCK_DIVIDER_16, CDD_PWM_CLOCK_DIVIDER_32, CDD_PWM_CLOCK_DIVIDER_64, CDD_PWM_CLOCK_DIVIDER_128}, origin=Texas Instruments, post-build-variant-value=true, set at pre-compile in variant pre-compile / post-build in variant post-build, default-value=CDD_PWM_CLOCK_DIVIDER_1  # Time Base Clock Divider:CLKDIV CLKDIV: These bits select the time base clock pre-scale value, TBCLK = EPWMCLK/(HSPCLKDIV*CLKDIV).
        enumeration CddPwmHSClockDivider: {CDD_PWM_HSCLOCK_DIVIDER_1, CDD_PWM_HSCLOCK_DIVIDER_2, CDD_PWM_HSCLOCK_DIVIDER_4, CDD_PWM_HSCLOCK_DIVIDER_6, CDD_PWM_HSCLOCK_DIVIDER_8, CDD_PWM_HSCLOCK_DIVIDER_10, CDD_PWM_HSCLOCK_DIVIDER_12, CDD_PWM_HSCLOCK_DIVIDER_14}, origin=Texas Instruments, post-build-variant-value=true, set at pre-compile in variant pre-compile / post-build in variant post-build, default-value=CDD_PWM_HSCLOCK_DIVIDER_1  # High Speed Clock Divider:CLKDIV HSPCLKDIV: These bits determine part of the time-base clock pre-scale value, TBCLK = EPWMCLK/(HSPCLKDIV*CLKDIV).
        float CddPwmTbPeriod: 0.0..INF, post-build-variant-value=true, set at post-build in variant post-build / pre-compile in variant pre-compile, default-value=1.0  # Value of period used for Initialization.(in seconds).
        float CddPwmTbPeriodInitValue: 0.0..INF, post-build-variant-value=true, set at post-build in variant post-build / pre-compile in variant pre-compile, default-value=1.0  # Value of period used for Initialization.(in seconds). Initial Counter value for the Time Base Counter Submodule
        enumeration CddPwmCounterMode: {CDD_PWM_COUNTER_MODE_UP, CDD_PWM_COUNTER_MODE_DOWN, CDD_PWM_COUNTER_MODE_UP_DOWN, CDD_PWM_COUNTER_MODE_STOP_FREEZE}, origin=Texas Instruments, post-build-variant-value=true, set at pre-compile in variant pre-compile / post-build in variant post-build, default-value=CDD_PWM_COUNTER_MODE_STOP_FREEZE  # Counter Mode:Mode of the Counter value for the Time Base Counter Submodule.
        boolean CddPwmEnablePhaseShift: origin=Texas Instruments, set at pre-compile in variant pre-compile / post-build in variant post-build, default-value=false  # Enable Phase Shift Load:Enable phase shift load for the Time Base Counter Submodule
        integer CddPwmEnablePhaseShiftValue: 0..65535, origin=Texas Instruments, set at pre-compile in variant pre-compile / post-build in variant post-build, default-value=1  # Phase Shift Value:Phase Shift Value for the Time Base Counter Submodule.
        enumeration CddPwmPeriodLoadMode: {CDD_PWM_PERIOD_SHADOW_LOAD, CDD_PWM_PERIOD_DIRECT_LOAD}, origin=Texas Instruments, post-build-variant-value=true, set at pre-compile in variant pre-compile / post-build in variant post-build, default-value=CDD_PWM_PERIOD_DIRECT_LOAD  # Time Base Period Load Mode:Period load mode for the Time Base Counter Submodule.
        enumeration CddPwmTbprdlink: {CDD_PWM_LINK_DISABLE, CDD_PWM_LINK_WITH_PWM_0, CDD_PWM_LINK_WITH_PWM_1, CDD_PWM_LINK_WITH_PWM_2, CDD_PWM_LINK_WITH_PWM_3, CDD_PWM_LINK_WITH_PWM_4, CDD_PWM_LINK_WITH_PWM_5, CDD_PWM_LINK_WITH_PWM_6, CDD_PWM_LINK_WITH_PWM_7, CDD_PWM_LINK_WITH_PWM_8, CDD_PWM_LINK_WITH_PWM_9, CDD_PWM_LINK_WITH_PWM_10, CDD_PWM_LINK_WITH_PWM_11, CDD_PWM_LINK_WITH_PWM_12, CDD_PWM_LINK_WITH_PWM_13, CDD_PWM_LINK_WITH_PWM_14, CDD_PWM_LINK_WITH_PWM_15, CDD_PWM_LINK_WITH_PWM_16, CDD_PWM_LINK_WITH_PWM_17, CDD_PWM_LINK_WITH_PWM_18, CDD_PWM_LINK_WITH_PWM_19, CDD_PWM_LINK_WITH_PWM_20, CDD_PWM_LINK_WITH_PWM_21, CDD_PWM_LINK_WITH_PWM_22, CDD_PWM_LINK_WITH_PWM_23, CDD_PWM_LINK_WITH_PWM_24, CDD_PWM_LINK_WITH_PWM_25, CDD_PWM_LINK_WITH_PWM_26, CDD_PWM_LINK_WITH_PWM_27, CDD_PWM_LINK_WITH_PWM_28, CDD_PWM_LINK_WITH_PWM_29, CDD_PWM_LINK_WITH_PWM_30, CDD_PWM_LINK_WITH_PWM_31}, origin=Texas Instruments, post-build-variant-value=true, set at pre-compile in variant pre-compile / post-build in variant post-build, default-value=CDD_PWM_LINK_DISABLE  # Time Base Period Link:Simultaneous write to the current ePWM module PRD register.
        enumeration CddPwmPeriodShadowLoadMode: {CDD_PWM_SHADOW_LOAD_MODE_COUNTER_ZERO, CDD_PWM_SHADOW_LOAD_MODE_COUNTER_SYNC, CDD_PWM_SHADOW_LOAD_MODE_SYNC}, origin=Texas Instruments, post-build-variant-value=true, set at pre-compile in variant pre-compile / post-build in variant post-build, default-value=CDD_PWM_SHADOW_LOAD_MODE_COUNTER_ZERO  # .
      container CddPwmTimerBaseSync [1..32]  # Configuration of an individual CDD PWM channel.
        integer CddPwmTimerBaseSyncId: 0..255, origin=Texas Instruments, set at pre-compile in variant pre-compile / post-build in variant post-build  # The Timer Base Sync unit ID.
        enumeration CddPwmOneShotSyncOutTrigger: {CDD_PWM_OSHT_SYNC_OUT_TRIG_SYNC, CDD_PWM_OSHT_SYNC_OUT_TRIG_RELOAD}, origin=Texas Instruments, post-build-variant-value=true, set at pre-compile in variant pre-compile / post-build in variant post-build, default-value=CDD_PWM_OSHT_SYNC_OUT_TRIG_SYNC  # One-Shot Sync Out Trigger:One-Shot Sync Out Trigger for the Time Base Counter Submodule.
        boolean CddPwmForceSync: origin=Texas Instruments, set at pre-compile in variant pre-compile / post-build in variant post-build, default-value=false  # Force A Sync Pulse:Force a sync pulse for the Time Base Counter Submodule.
        enumeration CddPwmTbprdlink: {CDD_PWM_LINK_DISABLE, CDD_PWM_LINK_WITH_PWM_0, CDD_PWM_LINK_WITH_PWM_1, CDD_PWM_LINK_WITH_PWM_2, CDD_PWM_LINK_WITH_PWM_3, CDD_PWM_LINK_WITH_PWM_4, CDD_PWM_LINK_WITH_PWM_5, CDD_PWM_LINK_WITH_PWM_6, CDD_PWM_LINK_WITH_PWM_7, CDD_PWM_LINK_WITH_PWM_8, CDD_PWM_LINK_WITH_PWM_9, CDD_PWM_LINK_WITH_PWM_10, CDD_PWM_LINK_WITH_PWM_11, CDD_PWM_LINK_WITH_PWM_12, CDD_PWM_LINK_WITH_PWM_13, CDD_PWM_LINK_WITH_PWM_14, CDD_PWM_LINK_WITH_PWM_15, CDD_PWM_LINK_WITH_PWM_16, CDD_PWM_LINK_WITH_PWM_17, CDD_PWM_LINK_WITH_PWM_18, CDD_PWM_LINK_WITH_PWM_19, CDD_PWM_LINK_WITH_PWM_20, CDD_PWM_LINK_WITH_PWM_21, CDD_PWM_LINK_WITH_PWM_22, CDD_PWM_LINK_WITH_PWM_23, CDD_PWM_LINK_WITH_PWM_24, CDD_PWM_LINK_WITH_PWM_25, CDD_PWM_LINK_WITH_PWM_26, CDD_PWM_LINK_WITH_PWM_27, CDD_PWM_LINK_WITH_PWM_28, CDD_PWM_LINK_WITH_PWM_29, CDD_PWM_LINK_WITH_PWM_30, CDD_PWM_LINK_WITH_PWM_31}, origin=Texas Instruments, post-build-variant-value=true, set at pre-compile in variant pre-compile / post-build in variant post-build, default-value=CDD_PWM_LINK_DISABLE  # .
        enumeration CddPwmSyncOutPulseSource: {CDD_PWM_SYNC_IN_PULSE_SRC_DISABLE, CDD_PWM_SYNC_IN_PULSE_SRC_SYNCOUT_EPWM0, CDD_PWM_SYNC_IN_PULSE_SRC_SYNCOUT_EPWM1, CDD_PWM_SYNC_IN_PULSE_SRC_SYNCOUT_EPWM2, CDD_PWM_SYNC_IN_PULSE_SRC_SYNCOUT_EPWM3, CDD_PWM_SYNC_IN_PULSE_SRC_SYNCOUT_EPWM4, CDD_PWM_SYNC_IN_PULSE_SRC_SYNCOUT_EPWM5, CDD_PWM_SYNC_IN_PULSE_SRC_SYNCOUT_EPWM6, CDD_PWM_SYNC_IN_PULSE_SRC_SYNCOUT_EPWM7, CDD_PWM_SYNC_IN_PULSE_SRC_SYNCOUT_EPWM8, CDD_PWM_SYNC_IN_PULSE_SRC_SYNCOUT_EPWM9, CDD_PWM_SYNC_IN_PULSE_SRC_SYNCOUT_EPWM10, CDD_PWM_SYNC_IN_PULSE_SRC_SYNCOUT_EPWM11, CDD_PWM_SYNC_IN_PULSE_SRC_SYNCOUT_EPWM12, CDD_PWM_SYNC_IN_PULSE_SRC_SYNCOUT_EPWM13, CDD_PWM_SYNC_IN_PULSE_SRC_SYNCOUT_EPWM14, CDD_PWM_SYNC_IN_PULSE_SRC_SYNCOUT_EPWM15, CDD_PWM_SYNC_IN_PULSE_SRC_SYNCOUT_EPWM16, CDD_PWM_SYNC_IN_PULSE_SRC_SYNCOUT_EPWM17, CDD_PWM_SYNC_IN_PULSE_SRC_SYNCOUT_EPWM18, CDD_PWM_SYNC_IN_PULSE_SRC_SYNCOUT_EPWM19, CDD_PWM_SYNC_IN_PULSE_SRC_SYNCOUT_EPWM20, CDD_PWM_SYNC_IN_PULSE_SRC_SYNCOUT_EPWM21, CDD_PWM_SYNC_IN_PULSE_SRC_SYNCOUT_EPWM22, CDD_PWM_SYNC_IN_PULSE_SRC_SYNCOUT_EPWM23, CDD_PWM_SYNC_IN_PULSE_SRC_SYNCOUT_ECAP0, CDD_PWM_SYNC_IN_PULSE_SRC_SYNCOUT_ECAP1, CDD_PWM_SYNC_IN_PULSE_SRC_SYNCOUT_ECAP2, CDD_PWM_SYNC_IN_PULSE_SRC_SYNCOUT_ECAP3, CDD_PWM_SYNC_IN_PULSE_SRC_SYNCOUT_ECAP4, CDD_PWM_SYNC_IN_PULSE_SRC_SYNCOUT_ECAP5, CDD_PWM_SYNC_IN_PULSE_SRC_SYNCOUT_ECAP6, CDD_PWM_SYNC_IN_PULSE_SRC_SYNCOUT_ECAP7, CDD_PWM_SYNC_IN_PULSE_SRC_SYNCOUT_ECAP8, CDD_PWM_SYNC_IN_PULSE_SRC_SYNCOUT_ECAP9, CDD_PWM_SYNC_IN_PULSE_SRC_INPUTXBAR_OUT4, CDD_PWM_SYNC_IN_PULSE_SRC_INPUTXBAR_OUT20, CDD_PWM_SYNC_IN_PULSE_SRC_C2K_TIMESYNC_XBAR_PWM_OUT0, CDD_PWM_SYNC_IN_PULSE_SRC_C2K_TIMESYNC_XBAR_PWM_OUT1, CDD_PWM_SYNC_IN_PULSE_SRC_FSIRX0_RX_TRIG0, CDD_PWM_SYNC_IN_PULSE_SRC_FSIRX0_RX_TRIG1, CDD_PWM_SYNC_IN_PULSE_SRC_FSIRX0_RX_TRIG2, CDD_PWM_SYNC_IN_PULSE_SRC_FSIRX0_RX_TRIG3, CDD_PWM_SYNC_IN_PULSE_SRC_FSIRX1_RX_TRIG0, CDD_PWM_SYNC_IN_PULSE_SRC_FSIRX1_RX_TRIG1, CDD_PWM_SYNC_IN_PULSE_SRC_FSIRX1_RX_TRIG2, CDD_PWM_SYNC_IN_PULSE_SRC_FSIRX1_RX_TRIG3, CDD_PWM_SYNC_IN_PULSE_SRC_FSIRX2_RX_TRIG0, CDD_PWM_SYNC_IN_PULSE_SRC_FSIRX2_RX_TRIG1, CDD_PWM_SYNC_IN_PULSE_SRC_FSIRX2_RX_TRIG2, CDD_PWM_SYNC_IN_PULSE_SRC_FSIRX2_RX_TRIG3, CDD_PWM_SYNC_IN_PULSE_SRC_FSIRX3_RX_TRIG0, CDD_PWM_SYNC_IN_PULSE_SRC_FSIRX3_RX_TRIG1, CDD_PWM_SYNC_IN_PULSE_SRC_FSIRX3_RX_TRIG2, CDD_PWM_SYNC_IN_PULSE_SRC_FSIRX3_RX_TRIG3}, origin=Texas Instruments, post-build-variant-value=true, set at pre-compile in variant pre-compile / post-build in variant post-build, default-value=CDD_PWM_SYNC_IN_PULSE_SRC_DISABLE  # Sync In Pulse Source:Sync in Pulse for the Time Base Counter Submodule.
        container CddPwmSyncOutPulseOn  # Configuration of an individual Sync Out Pulse On.
          boolean CddPwmSyncOutPulseOnSoftware: origin=Texas Instruments, set at pre-compile in variant pre-compile / post-build in variant post-build, default-value=false  # Software force generated EPWM sync-out pulse.
          boolean CddPwmSyncOutPulseOnCntrZero: origin=Texas Instruments, set at pre-compile in variant pre-compile / post-build in variant post-build, default-value=false  # Counter zero event generates EPWM sync-out pulse.
          boolean CddPwmSyncOutPulseOnCntCmpB: origin=Texas Instruments, set at pre-compile in variant pre-compile / post-build in variant post-build, default-value=false  # Counter equal to CMPB event generates EPWM sync-out pulse.
          boolean CddPwmSyncOutPulseOnCntCmpC: origin=Texas Instruments, set at pre-compile in variant pre-compile / post-build in variant post-build, default-value=false  # Counter equal to CMPC event generates EPWM sync-out pulse.
          boolean CddPwmSyncOutPulseOnCntCmpD: origin=Texas Instruments, set at pre-compile in variant pre-compile / post-build in variant post-build, default-value=false  # Counter equal to CMPD event generates EPWM sync-out pulse.
          boolean CddPwmSyncOutPulseOnDCAEVT1SYNC: origin=Texas Instruments, set at pre-compile in variant pre-compile / post-build in variant post-build, default-value=false  # DCA Event 1 Sync signal generates EPWM sync-out pulse.
          boolean CddPwmSyncOutPulseOnDCBEVT1SYNC: origin=Texas Instruments, set at pre-compile in variant pre-compile / post-build in variant post-build, default-value=false  # DCB Event 1 Sync signal generates EPWM sync-out pulse.
          boolean CddPwmSyncOutPulseOnALL: origin=Texas Instruments, set at pre-compile in variant pre-compile / post-build in variant post-build, default-value=false  # The physical hardware channel that is assigned to this logical channel.
      container CddPwmCounterCompare [1..32]  # Configuration of an individual CDD PWM channel.
        integer CddPwmCounterCompareId: 0..255, origin=Texas Instruments, set at pre-compile in variant pre-compile / post-build in variant post-build  # The Counter Compare unit ID.
        container CddPwmCounterCompareA  # Configuration of an individual CDD PWM channel.
          enumeration CddPwmCounterBlockCmpA: {CDD_PWM_CMP_A}, origin=Texas Instruments, post-build-variant-value=true, set at pre-compile in variant pre-compile / post-build in variant post-build, default-value=CDD_PWM_CMP_A  # Compare A (CMPA) Block.
          integer CddPwmCompareValueCmpA: 0..65536, origin=Texas Instruments, set at pre-compile in variant pre-compile / post-build in variant post-build, default-value=1  # Counter Compare A (CMPA) value.
          boolean CddPwmCounterCompareGlobalLoadCmpA: origin=Texas Instruments, set at pre-compile in variant pre-compile / post-build in variant post-build, default-value=false  # Enable Counter Compare A Global Load Use global load configuration for CMPA.
          boolean CddPwmCounterCompareShadowModeCmpA: origin=Texas Instruments, set at pre-compile in variant pre-compile / post-build in variant post-build, default-value=false  # Enable Shadow Counter Compare A Enable Shadow Counter Compare A (CMPA) value.
          enumeration CddPwmCounterCompareShadowEventCmpA: {CDD_PWM_COMP_LOAD_ON_CNTR_ZERO, CDD_PWM_COMP_LOAD_ON_CNTR_PERIOD, CDD_PWM_COMP_LOAD_ON_CNTR_ZERO_PERIOD, CDD_PWM_COMP_LOAD_FREEZE, CDD_PWM_COMP_LOAD_ON_SYNC_CNTR_ZERO, CDD_PWM_COMP_LOAD_ON_SYNC_CNTR_PERIOD, CDD_PWM_COMP_LOAD_ON_SYNC_CNTR_ZERO_PERIOD, CDD_PWM_COMP_LOAD_ON_SYNC_ONLY}, origin=Texas Instruments, post-build-variant-value=true, set at pre-compile in variant pre-compile / post-build in variant post-build, default-value=CDD_PWM_COMP_LOAD_ON_CNTR_ZERO  # Counter Compare A Shadow Load Event.
          enumeration CddPwmTbprdlinkCmpA: {CDD_PWM_LINK_DISABLE, CDD_PWM_LINK_WITH_PWM_0, CDD_PWM_LINK_WITH_PWM_1, CDD_PWM_LINK_WITH_PWM_2, CDD_PWM_LINK_WITH_PWM_3, CDD_PWM_LINK_WITH_PWM_4, CDD_PWM_LINK_WITH_PWM_5, CDD_PWM_LINK_WITH_PWM_6, CDD_PWM_LINK_WITH_PWM_7, CDD_PWM_LINK_WITH_PWM_8, CDD_PWM_LINK_WITH_PWM_9, CDD_PWM_LINK_WITH_PWM_10, CDD_PWM_LINK_WITH_PWM_11, CDD_PWM_LINK_WITH_PWM_12, CDD_PWM_LINK_WITH_PWM_13, CDD_PWM_LINK_WITH_PWM_14, CDD_PWM_LINK_WITH_PWM_15, CDD_PWM_LINK_WITH_PWM_16, CDD_PWM_LINK_WITH_PWM_17, CDD_PWM_LINK_WITH_PWM_18, CDD_PWM_LINK_WITH_PWM_19, CDD_PWM_LINK_WITH_PWM_20, CDD_PWM_LINK_WITH_PWM_21, CDD_PWM_LINK_WITH_PWM_22, CDD_PWM_LINK_WITH_PWM_23, CDD_PWM_LINK_WITH_PWM_24, CDD_PWM_LINK_WITH_PWM_25, CDD_PWM_LINK_WITH_PWM_26, CDD_PWM_LINK_WITH_PWM_27, CDD_PWM_LINK_WITH_PWM_28, CDD_PWM_LINK_WITH_PWM_29, CDD_PWM_LINK_WITH_PWM_30, CDD_PWM_LINK_WITH_PWM_31}, origin=Texas Instruments, post-build-variant-value=true, set at pre-compile in variant pre-compile / post-build in variant post-build, default-value=CDD_PWM_LINK_DISABLE  # Time Base Period Link:Simultaneous write to the current ePWM module CMP A register.
        container CddPwmCounterCompareB  # Configuration of an individual CDD PWM channel.
          enumeration CddPwmCounterBlockCmpB: {CDD_PWM_CMP_B}, origin=Texas Instruments, post-build-variant-value=true, set at pre-compile in variant pre-compile / post-build in variant post-build, default-value=CDD_PWM_CMP_B  # Compare B (CMPB) Block.
          integer CddPwmCompareValueCmpB: 0..65536, origin=Texas Instruments, set at pre-compile in variant pre-compile / post-build in variant post-build, default-value=1  # Counter Compare B (CMPB) value.
          boolean CddPwmCounterCompareGlobalLoadCmpB: origin=Texas Instruments, set at pre-compile in variant pre-compile / post-build in variant post-build, default-value=false  # Enable Counter Compare B Global Load Use global load configuration for CMPB.
          boolean CddPwmCounterCompareShadowModeCmpB: origin=Texas Instruments, set at pre-compile in variant pre-compile / post-build in variant post-build, default-value=false  # Enable Shadow Counter Compare B Enable Shadow Counter Compare B (CMPB) value.
          enumeration CddPwmCounterCompareShadowEventCmpB: {CDD_PWM_COMP_LOAD_ON_CNTR_ZERO, CDD_PWM_COMP_LOAD_ON_CNTR_PERIOD, CDD_PWM_COMP_LOAD_ON_CNTR_ZERO_PERIOD, CDD_PWM_COMP_LOAD_FREEZE, CDD_PWM_COMP_LOAD_ON_SYNC_CNTR_ZERO, CDD_PWM_COMP_LOAD_ON_SYNC_CNTR_PERIOD, CDD_PWM_COMP_LOAD_ON_SYNC_CNTR_ZERO_PERIOD, CDD_PWM_COMP_LOAD_ON_SYNC_ONLY}, origin=Texas Instruments, post-build-variant-value=true, set at pre-compile in variant pre-compile / post-build in variant post-build, default-value=CDD_PWM_COMP_LOAD_ON_CNTR_ZERO  # Counter Compare B Shadow Load Event.
          enumeration CddPwmTbprdlinkCmpB: {CDD_PWM_LINK_DISABLE, CDD_PWM_LINK_WITH_PWM_0, CDD_PWM_LINK_WITH_PWM_1, CDD_PWM_LINK_WITH_PWM_2, CDD_PWM_LINK_WITH_PWM_3, CDD_PWM_LINK_WITH_PWM_4, CDD_PWM_LINK_WITH_PWM_5, CDD_PWM_LINK_WITH_PWM_6, CDD_PWM_LINK_WITH_PWM_7, CDD_PWM_LINK_WITH_PWM_8, CDD_PWM_LINK_WITH_PWM_9, CDD_PWM_LINK_WITH_PWM_10, CDD_PWM_LINK_WITH_PWM_11, CDD_PWM_LINK_WITH_PWM_12, CDD_PWM_LINK_WITH_PWM_13, CDD_PWM_LINK_WITH_PWM_14, CDD_PWM_LINK_WITH_PWM_15, CDD_PWM_LINK_WITH_PWM_16, CDD_PWM_LINK_WITH_PWM_17, CDD_PWM_LINK_WITH_PWM_18, CDD_PWM_LINK_WITH_PWM_19, CDD_PWM_LINK_WITH_PWM_20, CDD_PWM_LINK_WITH_PWM_21, CDD_PWM_LINK_WITH_PWM_22, CDD_PWM_LINK_WITH_PWM_23, CDD_PWM_LINK_WITH_PWM_24, CDD_PWM_LINK_WITH_PWM_25, CDD_PWM_LINK_WITH_PWM_26, CDD_PWM_LINK_WITH_PWM_27, CDD_PWM_LINK_WITH_PWM_28, CDD_PWM_LINK_WITH_PWM_29, CDD_PWM_LINK_WITH_PWM_30, CDD_PWM_LINK_WITH_PWM_31}, origin=Texas Instruments, post-build-variant-value=true, set at pre-compile in variant pre-compile / post-build in variant post-build, default-value=CDD_PWM_LINK_DISABLE  # Time Base Period Link:Simultaneous write to the current ePWM module CMP B register.
        container CddPwmCounterCompareC  # Configuration of an individual CDD PWM channel.
          enumeration CddPwmCounterBlockCmpC: {CDD_PWM_CMP_C}, origin=Texas Instruments, post-build-variant-value=true, set at pre-compile in variant pre-compile / post-build in variant post-build, default-value=CDD_PWM_CMP_C  # Compare C (CMPC) Block.
          integer CddPwmCompareValueCmpC: 0..65536, origin=Texas Instruments, set at pre-compile in variant pre-compile / post-build in variant post-build, default-value=1  # Counter Compare C (CMPC) value.
          boolean CddPwmCounterCompareGlobalLoadCmpC: origin=Texas Instruments, set at pre-compile in variant pre-compile / post-build in variant post-build, default-value=false  # Enable Counter Compare C Global Load Use global load configuration for CMPC.
          boolean CddPwmCounterCompareShadowModeCmpC: origin=Texas Instruments, set at pre-compile in variant pre-compile / post-build in variant post-build, default-value=false  # Enable Shadow Counter Compare C Enable Shadow Counter Compare C (CMPC) value.
          enumeration CddPwmCounterCompareShadowEventCmpC: {CDD_PWM_COMP_LOAD_ON_CNTR_ZERO, CDD_PWM_COMP_LOAD_ON_CNTR_PERIOD, CDD_PWM_COMP_LOAD_ON_CNTR_ZERO_PERIOD, CDD_PWM_COMP_LOAD_FREEZE, CDD_PWM_COMP_LOAD_ON_SYNC_CNTR_ZERO, CDD_PWM_COMP_LOAD_ON_SYNC_CNTR_PERIOD, CDD_PWM_COMP_LOAD_ON_SYNC_CNTR_ZERO_PERIOD, CDD_PWM_COMP_LOAD_ON_SYNC_ONLY}, origin=Texas Instruments, post-build-variant-value=true, set at pre-compile in variant pre-compile / post-build in variant post-build, default-value=CDD_PWM_COMP_LOAD_ON_CNTR_ZERO  # Counter Compare C Shadow Load Event.
          enumeration CddPwmTbprdlinkCmpC: {CDD_PWM_LINK_DISABLE, CDD_PWM_LINK_WITH_PWM_0, CDD_PWM_LINK_WITH_PWM_1, CDD_PWM_LINK_WITH_PWM_2, CDD_PWM_LINK_WITH_PWM_3, CDD_PWM_LINK_WITH_PWM_4, CDD_PWM_LINK_WITH_PWM_5, CDD_PWM_LINK_WITH_PWM_6, CDD_PWM_LINK_WITH_PWM_7, CDD_PWM_LINK_WITH_PWM_8, CDD_PWM_LINK_WITH_PWM_9, CDD_PWM_LINK_WITH_PWM_10, CDD_PWM_LINK_WITH_PWM_11, CDD_PWM_LINK_WITH_PWM_12, CDD_PWM_LINK_WITH_PWM_13, CDD_PWM_LINK_WITH_PWM_14, CDD_PWM_LINK_WITH_PWM_15, CDD_PWM_LINK_WITH_PWM_16, CDD_PWM_LINK_WITH_PWM_17, CDD_PWM_LINK_WITH_PWM_18, CDD_PWM_LINK_WITH_PWM_19, CDD_PWM_LINK_WITH_PWM_20, CDD_PWM_LINK_WITH_PWM_21, CDD_PWM_LINK_WITH_PWM_22, CDD_PWM_LINK_WITH_PWM_23, CDD_PWM_LINK_WITH_PWM_24, CDD_PWM_LINK_WITH_PWM_25, CDD_PWM_LINK_WITH_PWM_26, CDD_PWM_LINK_WITH_PWM_27, CDD_PWM_LINK_WITH_PWM_28, CDD_PWM_LINK_WITH_PWM_29, CDD_PWM_LINK_WITH_PWM_30, CDD_PWM_LINK_WITH_PWM_31}, origin=Texas Instruments, post-build-variant-value=true, set at pre-compile in variant pre-compile / post-build in variant post-build, default-value=CDD_PWM_LINK_DISABLE  # Time Base Period Link:Simultaneous write to the current ePWM module CMP C register.
        container CddPwmCounterCompareD  # Configuration of an individual CDD PWM channel.
          enumeration CddPwmCounterBlockCmpD: {CDD_PWM_CMP_D}, origin=Texas Instruments, post-build-variant-value=true, set at pre-compile in variant pre-compile / post-build in variant post-build, default-value=CDD_PWM_CMP_D  # Compare D (CMPD) Block.
          integer CddPwmCompareValueCmpD: 0..65536, origin=Texas Instruments, set at pre-compile in variant pre-compile / post-build in variant post-build, default-value=1  # Counter Compare D (CMPD) value.
          boolean CddPwmCounterCompareGlobalLoadCmpD: origin=Texas Instruments, set at pre-compile in variant pre-compile / post-build in variant post-build, default-value=false  # Enable Counter Compare D Global Load Use global load configuration for CMPD.
          boolean CddPwmCounterCompareShadowModeCmpD: origin=Texas Instruments, set at pre-compile in variant pre-compile / post-build in variant post-build, default-value=false  # Enable Shadow Counter Compare D Enable Shadow Counter Compare D (CMPD) value.
          enumeration CddPwmCounterCompareShadowEventCmpD: {CDD_PWM_COMP_LOAD_ON_CNTR_ZERO, CDD_PWM_COMP_LOAD_ON_CNTR_PERIOD, CDD_PWM_COMP_LOAD_ON_CNTR_ZERO_PERIOD, CDD_PWM_COMP_LOAD_FREEZE, CDD_PWM_COMP_LOAD_ON_SYNC_CNTR_ZERO, CDD_PWM_COMP_LOAD_ON_SYNC_CNTR_PERIOD, CDD_PWM_COMP_LOAD_ON_SYNC_CNTR_ZERO_PERIOD, CDD_PWM_COMP_LOAD_ON_SYNC_ONLY}, origin=Texas Instruments, post-build-variant-value=true, set at pre-compile in variant pre-compile / post-build in variant post-build, default-value=CDD_PWM_COMP_LOAD_ON_CNTR_ZERO  # Counter Compare D Shadow Load Event.
          enumeration CddPwmTbprdlinkCmpD: {CDD_PWM_LINK_DISABLE, CDD_PWM_LINK_WITH_PWM_0, CDD_PWM_LINK_WITH_PWM_1, CDD_PWM_LINK_WITH_PWM_2, CDD_PWM_LINK_WITH_PWM_3, CDD_PWM_LINK_WITH_PWM_4, CDD_PWM_LINK_WITH_PWM_5, CDD_PWM_LINK_WITH_PWM_6, CDD_PWM_LINK_WITH_PWM_7, CDD_PWM_LINK_WITH_PWM_8, CDD_PWM_LINK_WITH_PWM_9, CDD_PWM_LINK_WITH_PWM_10, CDD_PWM_LINK_WITH_PWM_11, CDD_PWM_LINK_WITH_PWM_12, CDD_PWM_LINK_WITH_PWM_13, CDD_PWM_LINK_WITH_PWM_14, CDD_PWM_LINK_WITH_PWM_15, CDD_PWM_LINK_WITH_PWM_16, CDD_PWM_LINK_WITH_PWM_17, CDD_PWM_LINK_WITH_PWM_18, CDD_PWM_LINK_WITH_PWM_19, CDD_PWM_LINK_WITH_PWM_20, CDD_PWM_LINK_WITH_PWM_21, CDD_PWM_LINK_WITH_PWM_22, CDD_PWM_LINK_WITH_PWM_23, CDD_PWM_LINK_WITH_PWM_24, CDD_PWM_LINK_WITH_PWM_25, CDD_PWM_LINK_WITH_PWM_26, CDD_PWM_LINK_WITH_PWM_27, CDD_PWM_LINK_WITH_PWM_28, CDD_PWM_LINK_WITH_PWM_29, CDD_PWM_LINK_WITH_PWM_30, CDD_PWM_LINK_WITH_PWM_31}, origin=Texas Instruments, post-build-variant-value=true, set at pre-compile in variant pre-compile / post-build in variant post-build, default-value=CDD_PWM_LINK_DISABLE  # Time Base Period Link:Simultaneous write to the current ePWM module CMP D register.
      container CddPwmActionQualifier [1..32]  # Configuration of an individual CDD PWM channel.
        integer CddPwmActionQualifierId: 0..255, origin=Texas Instruments, set at pre-compile in variant pre-compile / post-build in variant post-build  # The Action Qualifier unit ID.
        container CddPwmActionQualifierA  # Configuration of an individual CDD PWM channel.
          enumeration CddPwmOutptEPWMA: {CDD_PWM_E_A}, origin=Texas Instruments, post-build-variant-value=true, set at pre-compile in variant pre-compile / post-build in variant post-build, default-value=CDD_PWM_E_A  # .
          boolean CddPwmActionGlobalLoadEPWMA: origin=Texas Instruments, set at pre-compile in variant pre-compile / post-build in variant post-build, default-value=false  # Enable Action qualifier Global Load A Use global load configuration.
          boolean CddPwmActionShadowModeEPWMA: origin=Texas Instruments, set at pre-compile in variant pre-compile / post-build in variant post-build, default-value=false  # Enable Shadow Action Qualifier A Enable Shadow for action qualifier
          enumeration CddPwmActionShadowEventEPWMA: {CDD_PWM_AQ_LOAD_ON_CNTR_ZERO, CDD_PWM_AQ_LOAD_ON_CNTR_PERIOD, CDD_PWM_AQ_LOAD_ON_CNTR_ZERO_PERIOD, CDD_PWM_AQ_LOAD_FREEZE, CDD_PWM_AQ_LOAD_ON_SYNC_CNTR_ZERO, CDD_PWM_AQ_LOAD_ON_SYNC_CNTR_PERIOD, CDD_PWM_AQ_LOAD_ON_SYNC_CNTR_ZERO_PERIOD, CDD_PWM_AQ_LOAD_ON_SYNC_ONLY}, origin=Texas Instruments, post-build-variant-value=true, set at pre-compile in variant pre-compile / post-build in variant post-build, default-value=CDD_PWM_AQ_LOAD_ON_CNTR_ZERO  # Action Qualifer EPWM A Shadow Load Event.
          enumeration CddPwmT1TriggerSourceEPWMA: {CDD_PWM_AQ_TRIGGER_EVENT_TRIG_DCA_1, CDD_PWM_AQ_TRIGGER_EVENT_TRIG_DCA_2, CDD_PWM_AQ_TRIGGER_EVENT_TRIG_DCB_1, CDD_PWM_AQ_TRIGGER_EVENT_TRIG_DCB_2, CDD_PWM_AQ_TRIGGER_EVENT_TRIG_TZ_1, CDD_PWM_AQ_TRIGGER_EVENT_TRIG_TZ_2, CDD_PWM_AQ_TRIGGER_EVENT_TRIG_TZ_3, CDD_PWM_AQ_TRIGGER_EVENT_TRIG_EPWM_SYNCIN, CDD_PWM_AQ_TRIGGER_EVENT_TRIG_DC_EVTFILT}, origin=Texas Instruments, post-build-variant-value=true, set at pre-compile in variant pre-compile / post-build in variant post-build, default-value=CDD_PWM_AQ_TRIGGER_EVENT_TRIG_DCA_1  # Trigger 1 event sources.
          enumeration CddPwmT2TriggerSourceEPWMA: {CDD_PWM_AQ_TRIGGER_EVENT_TRIG_DCA_1, CDD_PWM_AQ_TRIGGER_EVENT_TRIG_DCA_2, CDD_PWM_AQ_TRIGGER_EVENT_TRIG_DCB_1, CDD_PWM_AQ_TRIGGER_EVENT_TRIG_DCB_2, CDD_PWM_AQ_TRIGGER_EVENT_TRIG_TZ_1, CDD_PWM_AQ_TRIGGER_EVENT_TRIG_TZ_2, CDD_PWM_AQ_TRIGGER_EVENT_TRIG_TZ_3, CDD_PWM_AQ_TRIGGER_EVENT_TRIG_EPWM_SYNCIN, CDD_PWM_AQ_TRIGGER_EVENT_TRIG_DC_EVTFILT}, origin=Texas Instruments, post-build-variant-value=true, set at pre-compile in variant pre-compile / post-build in variant post-build, default-value=CDD_PWM_AQ_TRIGGER_EVENT_TRIG_DCA_1  # Trigger 2 event sources.
          enumeration CddPwmActionQualifierOneTimeSwOutputEPWMA: {CDD_PWM_AQ_OUTPUT_NO_CHANGE, CDD_PWM_AQ_OUTPUT_LOW, CDD_PWM_AQ_OUTPUT_HIGH, CDD_PWM_AQ_OUTPUT_TOGGLE}, origin=Texas Instruments, post-build-variant-value=true, set at pre-compile in variant pre-compile / post-build in variant post-build, default-value=CDD_PWM_AQ_OUTPUT_NO_CHANGE  # One time software forced event, output state based.
          enumeration CddPwmActionQualifierContinuousSwOutputEPWMA: {CDD_PWM_AQ_SW_DISABLED, CDD_PWM_AQ_SW_OUTPUT_LOW, CDD_PWM_AQ_SW_OUTPUT_HIGH}, origin=Texas Instruments, post-build-variant-value=true, set at pre-compile in variant pre-compile / post-build in variant post-build, default-value=CDD_PWM_AQ_SW_DISABLED  # Continuous software forced event, output state based.
          enumeration CddPwmAqOutputOnTimebaseZEROEPWMA: {CDD_PWM_AQ_OUTPUT_NO_CHANGE, CDD_PWM_AQ_OUTPUT_LOW, CDD_PWM_AQ_OUTPUT_HIGH, CDD_PWM_AQ_OUTPUT_TOGGLE}, origin=Texas Instruments, post-build-variant-value=true, set at pre-compile in variant pre-compile / post-build in variant post-build, default-value=CDD_PWM_AQ_OUTPUT_NO_CHANGE  # Action when event generate, when TBCTR Equals Zero.
          enumeration CddPwmAqOutputOnTimebasePERIODEPWMA: {CDD_PWM_AQ_OUTPUT_NO_CHANGE, CDD_PWM_AQ_OUTPUT_LOW, CDD_PWM_AQ_OUTPUT_HIGH, CDD_PWM_AQ_OUTPUT_TOGGLE}, origin=Texas Instruments, post-build-variant-value=true, set at pre-compile in variant pre-compile / post-build in variant post-build, default-value=CDD_PWM_AQ_OUTPUT_NO_CHANGE  # Action when event generate, when TBCTR Equals period.
          enumeration CddPwmAqOutputOnTimebaseUPCMPAEPWMA: {CDD_PWM_AQ_OUTPUT_NO_CHANGE, CDD_PWM_AQ_OUTPUT_LOW, CDD_PWM_AQ_OUTPUT_HIGH, CDD_PWM_AQ_OUTPUT_TOGGLE}, origin=Texas Instruments, post-build-variant-value=true, set at pre-compile in variant pre-compile / post-build in variant post-build, default-value=CDD_PWM_AQ_OUTPUT_NO_CHANGE  # Action when event generate, when TBCTR Equals CMPA in Up counter mode.
          enumeration CddPwmAqOutputOnTimebaseDOWNCMPAEPWMA: {CDD_PWM_AQ_OUTPUT_NO_CHANGE, CDD_PWM_AQ_OUTPUT_LOW, CDD_PWM_AQ_OUTPUT_HIGH, CDD_PWM_AQ_OUTPUT_TOGGLE}, origin=Texas Instruments, post-build-variant-value=true, set at pre-compile in variant pre-compile / post-build in variant post-build, default-value=CDD_PWM_AQ_OUTPUT_NO_CHANGE  # Action when event generate, when TBCTR Equals CMPA in Down counter mode.
          enumeration CddPwmAqOutputOnTimebaseUPCMPBEPWMA: {CDD_PWM_AQ_OUTPUT_NO_CHANGE, CDD_PWM_AQ_OUTPUT_LOW, CDD_PWM_AQ_OUTPUT_HIGH, CDD_PWM_AQ_OUTPUT_TOGGLE}, origin=Texas Instruments, post-build-variant-value=true, set at pre-compile in variant pre-compile / post-build in variant post-build, default-value=CDD_PWM_AQ_OUTPUT_NO_CHANGE  # Action when event generate, when TBCTR Equals CMPB in Up counter mode.
          enumeration CddPwmAqOutputOnTimebaseDOWNCMPBEPWMA: {CDD_PWM_AQ_OUTPUT_NO_CHANGE, CDD_PWM_AQ_OUTPUT_LOW, CDD_PWM_AQ_OUTPUT_HIGH, CDD_PWM_AQ_OUTPUT_TOGGLE}, origin=Texas Instruments, post-build-variant-value=true, set at pre-compile in variant pre-compile / post-build in variant post-build, default-value=CDD_PWM_AQ_OUTPUT_NO_CHANGE  # Action when event generate, when TBCTR Equals CMPB in Down counter mode.
          enumeration CddPwmAqOutputOnT1COUNTUPEPWMA: {CDD_PWM_AQ_OUTPUT_NO_CHANGE, CDD_PWM_AQ_OUTPUT_LOW, CDD_PWM_AQ_OUTPUT_HIGH, CDD_PWM_AQ_OUTPUT_TOGGLE}, origin=Texas Instruments, post-build-variant-value=true, set at pre-compile in variant pre-compile / post-build in variant post-build, default-value=CDD_PWM_AQ_OUTPUT_NO_CHANGE  # Action when event generate, when T1 event occures in Up counter mode.
          enumeration CddPwmAqOutputOnT1COUNTDOWNEPWMA: {CDD_PWM_AQ_OUTPUT_NO_CHANGE, CDD_PWM_AQ_OUTPUT_LOW, CDD_PWM_AQ_OUTPUT_HIGH, CDD_PWM_AQ_OUTPUT_TOGGLE}, origin=Texas Instruments, post-build-variant-value=true, set at pre-compile in variant pre-compile / post-build in variant post-build, default-value=CDD_PWM_AQ_OUTPUT_NO_CHANGE  # Action when event generate, when T1 event occures in Down counter mode.
          enumeration CddPwmAqOutputOnT2COUNTUPEPWMA: {CDD_PWM_AQ_OUTPUT_NO_CHANGE, CDD_PWM_AQ_OUTPUT_LOW, CDD_PWM_AQ_OUTPUT_HIGH, CDD_PWM_AQ_OUTPUT_TOGGLE}, origin=Texas Instruments, post-build-variant-value=true, set at pre-compile in variant pre-compile / post-build in variant post-build, default-value=CDD_PWM_AQ_OUTPUT_NO_CHANGE  # Action when event generate, when T2 event occures in Up counter mode.
          enumeration CddPwmAqOutputOnT2COUNTDOWNEPWMA: {CDD_PWM_AQ_OUTPUT_NO_CHANGE, CDD_PWM_AQ_OUTPUT_LOW, CDD_PWM_AQ_OUTPUT_HIGH, CDD_PWM_AQ_OUTPUT_TOGGLE}, origin=Texas Instruments, post-build-variant-value=true, set at pre-compile in variant pre-compile / post-build in variant post-build, default-value=CDD_PWM_AQ_OUTPUT_NO_CHANGE  # Action when event generate, when T2 event occures in Down counter mode.
        container CddPwmActionQualifierB  # Configuration of an individual CDD PWM channel.
          enumeration CddPwmOutptEPWMB: {CDD_PWM_E_B}, origin=Texas Instruments, post-build-variant-value=true, set at pre-compile in variant pre-compile / post-build in variant post-build, default-value=CDD_PWM_E_B  # .
          boolean CddPwmActionGlobalLoadEPWMB: origin=Texas Instruments, set at pre-compile in variant pre-compile / post-build in variant post-build, default-value=false  # Enable Action qualifier Global Load B Use global load configuration.
          boolean CddPwmActionShadowModeEPWMB: origin=Texas Instruments, set at pre-compile in variant pre-compile / post-build in variant post-build, default-value=false  # Enable Shadow Action Qualifier B Enable Shadow for action qualifier
          enumeration CddPwmActionShadowEventEPWMB: {CDD_PWM_AQ_LOAD_ON_CNTR_ZERO, CDD_PWM_AQ_LOAD_ON_CNTR_PERIOD, CDD_PWM_AQ_LOAD_ON_CNTR_ZERO_PERIOD, CDD_PWM_AQ_LOAD_FREEZE, CDD_PWM_AQ_LOAD_ON_SYNC_CNTR_ZERO, CDD_PWM_AQ_LOAD_ON_SYNC_CNTR_PERIOD, CDD_PWM_AQ_LOAD_ON_SYNC_CNTR_ZERO_PERIOD, CDD_PWM_AQ_LOAD_ON_SYNC_ONLY}, origin=Texas Instruments, post-build-variant-value=true, set at pre-compile in variant pre-compile / post-build in variant post-build, default-value=CDD_PWM_AQ_LOAD_ON_CNTR_ZERO  # Action Qualifer EPWM B Shadow Load Event.
          enumeration CddPwmT1TriggerSourceEPWMB: {CDD_PWM_AQ_TRIGGER_EVENT_TRIG_DCA_1, CDD_PWM_AQ_TRIGGER_EVENT_TRIG_DCA_2, CDD_PWM_AQ_TRIGGER_EVENT_TRIG_DCB_1, CDD_PWM_AQ_TRIGGER_EVENT_TRIG_DCB_2, CDD_PWM_AQ_TRIGGER_EVENT_TRIG_TZ_1, CDD_PWM_AQ_TRIGGER_EVENT_TRIG_TZ_2, CDD_PWM_AQ_TRIGGER_EVENT_TRIG_TZ_3, CDD_PWM_AQ_TRIGGER_EVENT_TRIG_EPWM_SYNCIN, CDD_PWM_AQ_TRIGGER_EVENT_TRIG_DC_EVTFILT}, origin=Texas Instruments, post-build-variant-value=true, set at pre-compile in variant pre-compile / post-build in variant post-build, default-value=CDD_PWM_AQ_TRIGGER_EVENT_TRIG_DCA_1  # Trigger 1 event sources.
          enumeration CddPwmT2TriggerSourceEPWMB: {CDD_PWM_AQ_TRIGGER_EVENT_TRIG_DCA_1, CDD_PWM_AQ_TRIGGER_EVENT_TRIG_DCA_2, CDD_PWM_AQ_TRIGGER_EVENT_TRIG_DCB_1, CDD_PWM_AQ_TRIGGER_EVENT_TRIG_DCB_2, CDD_PWM_AQ_TRIGGER_EVENT_TRIG_TZ_1, CDD_PWM_AQ_TRIGGER_EVENT_TRIG_TZ_2, CDD_PWM_AQ_TRIGGER_EVENT_TRIG_TZ_3, CDD_PWM_AQ_TRIGGER_EVENT_TRIG_EPWM_SYNCIN, CDD_PWM_AQ_TRIGGER_EVENT_TRIG_DC_EVTFILT}, origin=Texas Instruments, post-build-variant-value=true, set at pre-compile in variant pre-compile / post-build in variant post-build, default-value=CDD_PWM_AQ_TRIGGER_EVENT_TRIG_DCA_1  # Trigger 2 event sources.
          enumeration CddPwmActionQualifierOneTimeSwOutputEPWMB: {CDD_PWM_AQ_OUTPUT_NO_CHANGE, CDD_PWM_AQ_OUTPUT_LOW, CDD_PWM_AQ_OUTPUT_HIGH, CDD_PWM_AQ_OUTPUT_TOGGLE}, origin=Texas Instruments, post-build-variant-value=true, set at pre-compile in variant pre-compile / post-build in variant post-build, default-value=CDD_PWM_AQ_OUTPUT_NO_CHANGE  # One time software forced event, output state based.
          enumeration CddPwmActionQualifierContinuousSwOutputEPWMB: {CDD_PWM_AQ_SW_DISABLED, CDD_PWM_AQ_SW_OUTPUT_LOW, CDD_PWM_AQ_SW_OUTPUT_HIGH}, origin=Texas Instruments, post-build-variant-value=true, set at pre-compile in variant pre-compile / post-build in variant post-build, default-value=CDD_PWM_AQ_SW_DISABLED  # Continuous software forced event, output state based.
          enumeration CddPwmAqOutputOnTimebaseZEROEPWMB: {CDD_PWM_AQ_OUTPUT_NO_CHANGE, CDD_PWM_AQ_OUTPUT_LOW, CDD_PWM_AQ_OUTPUT_HIGH, CDD_PWM_AQ_OUTPUT_TOGGLE}, origin=Texas Instruments, post-build-variant-value=true, set at pre-compile in variant pre-compile / post-build in variant post-build, default-value=CDD_PWM_AQ_OUTPUT_NO_CHANGE  # Action when event generate, when TBCTR Equals Zero.
          enumeration CddPwmAqOutputOnTimebasePERIODEPWMB: {CDD_PWM_AQ_OUTPUT_NO_CHANGE, CDD_PWM_AQ_OUTPUT_LOW, CDD_PWM_AQ_OUTPUT_HIGH, CDD_PWM_AQ_OUTPUT_TOGGLE}, origin=Texas Instruments, post-build-variant-value=true, set at pre-compile in variant pre-compile / post-build in variant post-build, default-value=CDD_PWM_AQ_OUTPUT_NO_CHANGE  # Action when event generate, when TBCTR Equals period.
          enumeration CddPwmAqOutputOnTimebaseUPCMPAEPWMB: {CDD_PWM_AQ_OUTPUT_NO_CHANGE, CDD_PWM_AQ_OUTPUT_LOW, CDD_PWM_AQ_OUTPUT_HIGH, CDD_PWM_AQ_OUTPUT_TOGGLE}, origin=Texas Instruments, post-build-variant-value=true, set at pre-compile in variant pre-compile / post-build in variant post-build, default-value=CDD_PWM_AQ_OUTPUT_NO_CHANGE  # Action when event generate, when TBCTR Equals CMPA in Up counter mode.
          enumeration CddPwmAqOutputOnTimebaseDOWNCMPAEPWMB: {CDD_PWM_AQ_OUTPUT_NO_CHANGE, CDD_PWM_AQ_OUTPUT_LOW, CDD_PWM_AQ_OUTPUT_HIGH, CDD_PWM_AQ_OUTPUT_TOGGLE}, origin=Texas Instruments, post-build-variant-value=true, set at pre-compile in variant pre-compile / post-build in variant post-build, default-value=CDD_PWM_AQ_OUTPUT_NO_CHANGE  # Action when event generate, when TBCTR Equals CMPA in Down counter mode.
          enumeration CddPwmAqOutputOnTimebaseUPCMPBEPWMB: {CDD_PWM_AQ_OUTPUT_NO_CHANGE, CDD_PWM_AQ_OUTPUT_LOW, CDD_PWM_AQ_OUTPUT_HIGH, CDD_PWM_AQ_OUTPUT_TOGGLE}, origin=Texas Instruments, post-build-variant-value=true, set at pre-compile in variant pre-compile / post-build in variant post-build, default-value=CDD_PWM_AQ_OUTPUT_NO_CHANGE  # Action when event generate, when TBCTR Equals CMPB in Up counter mode.
          enumeration CddPwmAqOutputOnTimebaseDOWNCMPBEPWMB: {CDD_PWM_AQ_OUTPUT_NO_CHANGE, CDD_PWM_AQ_OUTPUT_LOW, CDD_PWM_AQ_OUTPUT_HIGH, CDD_PWM_AQ_OUTPUT_TOGGLE}, origin=Texas Instruments, post-build-variant-value=true, set at pre-compile in variant pre-compile / post-build in variant post-build, default-value=CDD_PWM_AQ_OUTPUT_NO_CHANGE  # Action when event generate, when TBCTR Equals CMPB in Down counter mode.
          enumeration CddPwmAqOutputOnT1COUNTUPEPWMB: {CDD_PWM_AQ_OUTPUT_NO_CHANGE, CDD_PWM_AQ_OUTPUT_LOW, CDD_PWM_AQ_OUTPUT_HIGH, CDD_PWM_AQ_OUTPUT_TOGGLE}, origin=Texas Instruments, post-build-variant-value=true, set at pre-compile in variant pre-compile / post-build in variant post-build, default-value=CDD_PWM_AQ_OUTPUT_NO_CHANGE  # Action when event generate, when T1 event occures in Up counter mode.
          enumeration CddPwmAqOutputOnT1COUNTDOWNEPWMB: {CDD_PWM_AQ_OUTPUT_NO_CHANGE, CDD_PWM_AQ_OUTPUT_LOW, CDD_PWM_AQ_OUTPUT_HIGH, CDD_PWM_AQ_OUTPUT_TOGGLE}, origin=Texas Instruments, post-build-variant-value=true, set at pre-compile in variant pre-compile / post-build in variant post-build, default-value=CDD_PWM_AQ_OUTPUT_NO_CHANGE  # Action when event generate, when T1 event occures in Down counter mode.
          enumeration CddPwmAqOutputOnT2COUNTUPEPWMB: {CDD_PWM_AQ_OUTPUT_NO_CHANGE, CDD_PWM_AQ_OUTPUT_LOW, CDD_PWM_AQ_OUTPUT_HIGH, CDD_PWM_AQ_OUTPUT_TOGGLE}, origin=Texas Instruments, post-build-variant-value=true, set at pre-compile in variant pre-compile / post-build in variant post-build, default-value=CDD_PWM_AQ_OUTPUT_NO_CHANGE  # Action when event generate, when T2 event occures in Up counter mode.
          enumeration CddPwmAqOutputOnT2COUNTDOWNEPWMB: {CDD_PWM_AQ_OUTPUT_NO_CHANGE, CDD_PWM_AQ_OUTPUT_LOW, CDD_PWM_AQ_OUTPUT_HIGH, CDD_PWM_AQ_OUTPUT_TOGGLE}, origin=Texas Instruments, post-build-variant-value=true, set at pre-compile in variant pre-compile / post-build in variant post-build, default-value=CDD_PWM_AQ_OUTPUT_NO_CHANGE  # Action when event generate, when T2 event occures in Down counter mode.
      container CddPwmEventTrigger [1..32]  # Configuration of an individual CDD PWM channel.
        integer CddPwmEventTriggerId: 0..255, origin=Texas Instruments, set at pre-compile in variant pre-compile / post-build in variant post-build  # The Action Qualifier unit ID.
        boolean CddPwmForceEventValue: origin=Texas Instruments, set at pre-compile in variant pre-compile / post-build in variant post-build, default-value=false  # Forces the ePWM interrupt counter to be pre-interrupt loaded with the init count value.
        boolean CddPwmEnableEventCountInitialValue: origin=Texas Instruments, set at pre-compile in variant pre-compile / post-build in variant post-build, default-value=false  # Enables the ePWM SOC trigger counter to be pre-event loaded with a count value after a software force
        integer CddPwmEventCountInitialValue: 0..15, origin=Texas Instruments, set at pre-compile in variant pre-compile / post-build in variant post-build, default-value=1  # Value of the pre-event value that is to be loaded into the SOC trigger event counter.
        integer CddPwmInterruptCount: 1..15, origin=Texas Instruments, set at pre-compile in variant pre-compile / post-build in variant post-build, default-value=1  # The number of events that have to occur before an interrupt is issued.
        enumeration CddPwmInterruptEventSources: {CDD_PWM_INT_TBCTR_ZERO, CDD_PWM_INT_TBCTR_PERIOD, CDD_PWM_INT_TBCTR_ETINTMIX, CDD_PWM_INT_TBCTR_U_CMPA, CDD_PWM_INT_TBCTR_U_CMPC, CDD_PWM_INT_TBCTR_D_CMPA, CDD_PWM_INT_TBCTR_D_CMPC, CDD_PWM_INT_TBCTR_U_CMPB, CDD_PWM_INT_TBCTR_U_CMPD, CDD_PWM_INT_TBCTR_D_CMPB, CDD_PWM_INT_TBCTR_D_CMPD}, origin=Texas Instruments, post-build-variant-value=true, set at pre-compile in variant pre-compile / post-build in variant post-build, default-value=CDD_PWM_INT_TBCTR_ZERO  # Events that must be enabled to generate an EPWM interrupt.
        container CddPwmInterruptMixedSources  # Configuration of an Interrupt Mixed Sources.
          boolean CddPwmIntMixTbctrZero: origin=Texas Instruments, set at pre-compile in variant pre-compile / post-build in variant post-build, default-value=false  # Switches the PWM dead band functionality ON or OFF.
          boolean CddPwmIntMixTbctrPeriod: origin=Texas Instruments, set at pre-compile in variant pre-compile / post-build in variant post-build, default-value=false  # Switches the PWM dead band functionality ON or OFF.
          boolean CddPwmIntMixTbctrUCmpA: origin=Texas Instruments, set at pre-compile in variant pre-compile / post-build in variant post-build, default-value=false  # Switches the PWM dead band functionality ON or OFF.
          boolean CddPwmIntMixTbctrDCmpA: origin=Texas Instruments, set at pre-compile in variant pre-compile / post-build in variant post-build, default-value=false  # Switches the PWM dead band functionality ON or OFF.
          boolean CddPwmIntMixTbctrUCmpB: origin=Texas Instruments, set at pre-compile in variant pre-compile / post-build in variant post-build, default-value=false  # Switches the PWM dead band functionality ON or OFF.
          boolean CddPwmIntMixTbctrDCmpB: origin=Texas Instruments, set at pre-compile in variant pre-compile / post-build in variant post-build, default-value=false  # Switches the PWM dead band functionality ON or OFF.
          boolean CddPwmIntMixTbctrUCmpC: origin=Texas Instruments, set at pre-compile in variant pre-compile / post-build in variant post-build, default-value=false  # Switches the PWM dead band functionality ON or OFF.
          boolean CddPwmIntMixTbctrDCmpC: origin=Texas Instruments, set at pre-compile in variant pre-compile / post-build in variant post-build, default-value=false  # Switches the PWM dead band functionality ON or OFF.
          boolean CddPwmIntMixTbctrUCmpD: origin=Texas Instruments, set at pre-compile in variant pre-compile / post-build in variant post-build, default-value=false  # Switches the PWM dead band functionality ON or OFF.
          boolean CddPwmIntMixTbctrDCmpD: origin=Texas Instruments, set at pre-compile in variant pre-compile / post-build in variant post-build, default-value=false  # Switches the PWM dead band functionality ON or OFF.
          boolean CddPwmIntMixDCAEvt1: origin=Texas Instruments, set at pre-compile in variant pre-compile / post-build in variant post-build, default-value=false  # Switches the PWM dead band functionality ON or OFF.
      container CddPwmAdcEventTrigger [1..32]  # Configuration of an individual CDD PWM channel.
        integer CddPwmAdcEventTriggerId: 0..255, origin=Texas Instruments, set at pre-compile in variant pre-compile / post-build in variant post-build  # The ADC event triggered ID.
        container CddPwmAdcEventTriggerSocA  # Configuration of an individual CDD PWM channel.
          boolean CddPwmSocAEpwmEvent: origin=Texas Instruments, set at pre-compile in variant pre-compile / post-build in variant post-build, default-value=false  # Enable the SOC trigger generated by the ET submodule.
          boolean CddPwmSocAForceEventValue: origin=Texas Instruments, set at pre-compile in variant pre-compile / post-build in variant post-build, default-value=false  # Forces the ePWM SOC trigger counter to be pre-event loaded with the init count value.
          boolean CddPwmSocAEventCountInitialValueEnable: origin=Texas Instruments, set at pre-compile in variant pre-compile / post-build in variant post-build, default-value=false  # Enables the ePWM SOC trigger counter to be pre-event loaded with a count value after a software force.
          integer CddPwmSocAEventCountInitialValue: 0..15, origin=Texas Instruments, set at pre-compile in variant pre-compile / post-build in variant post-build, default-value=1  # Value of the pre-event value that is to be loaded into the SOC trigger event counter.
          integer CddPwmSocAInterruptCount: 1..15, origin=Texas Instruments, set at pre-compile in variant pre-compile / post-build in variant post-build, default-value=1  # The number of events that have to occur before an SOC is issued.
          enumeration CddPwmSocAInterruptEventSources: {CDD_PWM_SOC_DCxEVT1, CDD_PWM_SOC_TBCTR_ZERO, CDD_PWM_SOC_TBCTR_PERIOD, CDD_PWM_SOC_TBCTR_MIXED_EVENT, CDD_PWM_SOC_TBCTR_U_CMPA, CDD_PWM_SOC_TBCTR_U_CMPC, CDD_PWM_SOC_TBCTR_D_CMPA, CDD_PWM_SOC_TBCTR_D_CMPC, CDD_PWM_SOC_TBCTR_U_CMPB, CDD_PWM_SOC_TBCTR_U_CMPD, CDD_PWM_SOC_TBCTR_D_CMPB, CDD_PWM_SOC_TBCTR_D_CMPD}, origin=Texas Instruments, post-build-variant-value=true, set at pre-compile in variant pre-compile / post-build in variant post-build, default-value=CDD_PWM_SOC_TBCTR_ZERO  # Select the SOC trigger source for SOCA.
          container CddPwmSocAMixedSources  # Configuration of an ADC SOC-A Mixed Sources.
            boolean CddPwmIntSocAMixTbctrZero: origin=Texas Instruments, set at pre-compile in variant pre-compile / post-build in variant post-build, default-value=false  # Switches the PWM dead band functionality ON or OFF.
            boolean CddPwmIntSocAMixTbctrPeriod: origin=Texas Instruments, set at pre-compile in variant pre-compile / post-build in variant post-build, default-value=false  # Switches the PWM dead band functionality ON or OFF.
            boolean CddPwmIntSocAMixTbctrUCmpA: origin=Texas Instruments, set at pre-compile in variant pre-compile / post-build in variant post-build, default-value=false  # Switches the PWM dead band functionality ON or OFF.
            boolean CddPwmIntSocAMixTbctrDCmpA: origin=Texas Instruments, set at pre-compile in variant pre-compile / post-build in variant post-build, default-value=false  # Switches the PWM dead band functionality ON or OFF.
            boolean CddPwmIntSocAMixTbctrUCmpB: origin=Texas Instruments, set at pre-compile in variant pre-compile / post-build in variant post-build, default-value=false  # Switches the PWM dead band functionality ON or OFF.
            boolean CddPwmIntSocAMixTbctrDCmpB: origin=Texas Instruments, set at pre-compile in variant pre-compile / post-build in variant post-build, default-value=false  # Switches the PWM dead band functionality ON or OFF.
            boolean CddPwmIntSocAMixTbctrUCmpC: origin=Texas Instruments, set at pre-compile in variant pre-compile / post-build in variant post-build, default-value=false  # Switches the PWM dead band functionality ON or OFF.
            boolean CddPwmIntSocAMixTbctrDCmpC: origin=Texas Instruments, set at pre-compile in variant pre-compile / post-build in variant post-build, default-value=false  # Switches the PWM dead band functionality ON or OFF.
            boolean CddPwmIntSocAMixTbctrUCmpD: origin=Texas Instruments, set at pre-compile in variant pre-compile / post-build in variant post-build, default-value=false  # Switches the PWM dead band functionality ON or OFF.
            boolean CddPwmIntSocAMixTbctrDCmpD: origin=Texas Instruments, set at pre-compile in variant pre-compile / post-build in variant post-build, default-value=false  # Switches the PWM dead band functionality ON or OFF.
            boolean CddPwmSocAIntMixDCAEvt1: origin=Texas Instruments, set at pre-compile in variant pre-compile / post-build in variant post-build, default-value=false  # Switches the PWM dead band functionality ON or OFF.
        container CddPwmAdcEventTriggerSocB  # Configuration of an individual CDD PWM channel.
          boolean CddPwmSocBEpwmEvent: origin=Texas Instruments, set at pre-compile in variant pre-compile / post-build in variant post-build, default-value=false  # Enable the SOC B trigger generated by the ET submodule.
          boolean CddPwmSocBForceEventValue: origin=Texas Instruments, set at pre-compile in variant pre-compile / post-build in variant post-build, default-value=false  # Forces the ePWM SOC B trigger counter to be pre-event loaded with the init count value.
          boolean CddPwmSocBEventCountInitialValueEnable: origin=Texas Instruments, set at pre-compile in variant pre-compile / post-build in variant post-build, default-value=false  # Enables the ePWM SOC B trigger counter to be pre-event loaded with a count value after a software force.
          integer CddPwmSocBEventCountInitialValue: 0..15, origin=Texas Instruments, set at pre-compile in variant pre-compile / post-build in variant post-build, default-value=1  # Value of the pre-event value that is to be loaded into the SOC B trigger event counter.
          integer CddPwmSocBInterruptCount: 1..15, origin=Texas Instruments, set at pre-compile in variant pre-compile / post-build in variant post-build, default-value=1  # The number of events that have to occur before an SOC B is issued.
          enumeration CddPwmSocBInterruptEventSources: {CDD_PWM_SOC_DCxEVT1, CDD_PWM_SOC_TBCTR_ZERO, CDD_PWM_SOC_TBCTR_PERIOD, CDD_PWM_SOC_TBCTR_MIXED_EVENT, CDD_PWM_SOC_TBCTR_U_CMPA, CDD_PWM_SOC_TBCTR_U_CMPC, CDD_PWM_SOC_TBCTR_D_CMPA, CDD_PWM_SOC_TBCTR_D_CMPC, CDD_PWM_SOC_TBCTR_U_CMPB, CDD_PWM_SOC_TBCTR_U_CMPD, CDD_PWM_SOC_TBCTR_D_CMPB, CDD_PWM_SOC_TBCTR_D_CMPD}, origin=Texas Instruments, post-build-variant-value=true, set at pre-compile in variant pre-compile / post-build in variant post-build, default-value=CDD_PWM_SOC_DCxEVT1  # Select the SOC trigger source for SOCB.
          container CddPwmSocBMixedSources  # Configuration of an ADC SOC-B Mixed Sources.
            boolean CddPwmIntSocBMixTbctrZero: origin=Texas Instruments, set at pre-compile in variant pre-compile / post-build in variant post-build, default-value=false  # Switches the PWM dead band functionality ON or OFF.
            boolean CddPwmIntSocBMixTbctrPeriod: origin=Texas Instruments, set at pre-compile in variant pre-compile / post-build in variant post-build, default-value=false  # Switches the PWM dead band functionality ON or OFF.
            boolean CddPwmIntSocBMixTbctrUCmpA: origin=Texas Instruments, set at pre-compile in variant pre-compile / post-build in variant post-build, default-value=false  # Switches the PWM dead band functionality ON or OFF.
            boolean CddPwmIntSocBMixTbctrDCmpA: origin=Texas Instruments, set at pre-compile in variant pre-compile / post-build in variant post-build, default-value=false  # Switches the PWM dead band functionality ON or OFF.
            boolean CddPwmIntSocBMixTbctrUCmpB: origin=Texas Instruments, set at pre-compile in variant pre-compile / post-build in variant post-build, default-value=false  # Switches the PWM dead band functionality ON or OFF.
            boolean CddPwmIntSocBMixTbctrDCmpB: origin=Texas Instruments, set at pre-compile in variant pre-compile / post-build in variant post-build, default-value=false  # Switches the PWM dead band functionality ON or OFF.
            boolean CddPwmIntSocBMixTbctrUCmpC: origin=Texas Instruments, set at pre-compile in variant pre-compile / post-build in variant post-build, default-value=false  # Switches the PWM dead band functionality ON or OFF.
            boolean CddPwmIntSocBMixTbctrDCmpC: origin=Texas Instruments, set at pre-compile in variant pre-compile / post-build in variant post-build, default-value=false  # Switches the PWM dead band functionality ON or OFF.
            boolean CddPwmIntSocBMixTbctrUCmpD: origin=Texas Instruments, set at pre-compile in variant pre-compile / post-build in variant post-build, default-value=false  # Switches the PWM dead band functionality ON or OFF.
            boolean CddPwmIntSocBMixTbctrDCmpD: origin=Texas Instruments, set at pre-compile in variant pre-compile / post-build in variant post-build, default-value=false  # Switches the PWM dead band functionality ON or OFF.
            boolean CddPwmSocBIntMixDCAEvt1: origin=Texas Instruments, set at pre-compile in variant pre-compile / post-build in variant post-build, default-value=false  # Switches the PWM dead band functionality ON or OFF.
      container CddPwmTripZone [1..32]  # Configuration of an individual CDD PWM channel.
        integer CddPwmTripZoneId: 0..255, origin=Texas Instruments, set at pre-compile in variant pre-compile / post-build in variant post-build  # Pwm Trip Zone unit ID.
        boolean CddPwmAdvancedTripZoneAction: origin=Texas Instruments, set at pre-compile in variant pre-compile / post-build in variant post-build, default-value=false  # Enable / disable the trip zone.
        enumeration CddPwmCycleByCycleTripZoneClearMode: {CDD_PWM_TZ_CBC_PULSE_CLR_CNTR_ZERO, CDD_PWM_TZ_CBC_PULSE_CLR_CNTR_PERIOD, CDD_PWM_TZ_CBC_PULSE_CLR_CNTR_ZERO_PERIOD}, origin=Texas Instruments, post-build-variant-value=true, set at pre-compile in variant pre-compile / post-build in variant post-build, default-value=CDD_PWM_TZ_CBC_PULSE_CLR_CNTR_ZERO  # CBC trip zone latch clear signal.
        container CddPwmTZA  # Configuration of an individual Trip Zone A.
          enumeration CddPwmTZAEvent: {CDD_PWM_HZ_STATE, CDD_PWM_HIGH_STATE, CDD_PWM_LOW_STATE, CDD_PWM_DISABLE_STATE}, origin=Texas Instruments, post-build-variant-value=true, set at pre-compile in variant pre-compile / post-build in variant post-build, default-value=CDD_PWM_HZ_STATE  # Trip Zone Actions: CDD_PWM_HZ_STATE ==>> High impedance output CDD_PWM_HIGH_STATE ==>> High voltage state CDD_PWM_LOW_STATE ==>> Low voltage state CDD_PWM_DISABLE_STATE ==>> Disable action.
          enumeration CddPwmTZAAdvUEvent: {CDD_PWM_TZ_ADV_ACTION_HIGH_Z, CDD_PWM_TZ_ADV_ACTION_HIGH, CDD_PWM_TZ_ADV_ACTION_LOW, CDD_PWM_TZ_ADV_ACTION_TOGGLE, CDD_PWM_TZ_ADV_ACTION_DISABLE}, origin=Texas Instruments, post-build-variant-value=true, set at pre-compile in variant pre-compile / post-build in variant post-build, default-value=CDD_PWM_TZ_ADV_ACTION_HIGH_Z  # Trip Zone Advanced Actions: CDD_PWM_TZ_ADV_ACTION_HIGH_Z ==>> High impedance output CDD_PWM_TZ_ADV_ACTION_HIGH ==>> High voltage state CDD_PWM_TZ_ADV_ACTION_LOW ==>> Low voltage state CDD_PWM_TZ_ADV_ACTION_TOGGLE ==>> Toggle the output CDD_PWM_TZ_ADV_ACTION_DISABLE ==>> Disable action .
          enumeration CddPwmTZAAdvDEvent: {CDD_PWM_TZ_ADV_ACTION_HIGH_Z, CDD_PWM_TZ_ADV_ACTION_HIGH, CDD_PWM_TZ_ADV_ACTION_LOW, CDD_PWM_TZ_ADV_ACTION_TOGGLE, CDD_PWM_TZ_ADV_ACTION_DISABLE}, origin=Texas Instruments, post-build-variant-value=true, set at pre-compile in variant pre-compile / post-build in variant post-build, default-value=CDD_PWM_TZ_ADV_ACTION_HIGH_Z  # Trip Zone Advanced Actions: CDD_PWM_TZ_ADV_ACTION_HIGH_Z ==>> High impedance output CDD_PWM_TZ_ADV_ACTION_HIGH ==>> High voltage state CDD_PWM_TZ_ADV_ACTION_LOW ==>> Low voltage state CDD_PWM_TOGGLE_STATE ==>> Toggle the output CDD_PWM_TZ_ADV_ACTION_TOGGLE ==>> Disable action .
        container CddPwmTZB  # Configuration of an individual Trip Zone B.
          enumeration CddPwmTZBEvent: {CDD_PWM_HZ_STATE, CDD_PWM_HIGH_STATE, CDD_PWM_LOW_STATE, CDD_PWM_DISABLE_STATE}, origin=Texas Instruments, post-build-variant-value=true, set at pre-compile in variant pre-compile / post-build in variant post-build, default-value=CDD_PWM_HZ_STATE  # Trip Zone Actions: CDD_PWM_HZ_STATE ==>> High impedance output CDD_PWM_HIGH_STATE ==>> High voltage state CDD_PWM_LOW_STATE ==>> Low voltage state CDD_PWM_DISABLE_STATE ==>> Disable action .
          enumeration CddPwmTZBAdvUEvent: {CDD_PWM_TZ_ADV_ACTION_HIGH_Z, CDD_PWM_TZ_ADV_ACTION_HIGH, CDD_PWM_TZ_ADV_ACTION_LOW, CDD_PWM_TZ_ADV_ACTION_TOGGLE, CDD_PWM_TZ_ADV_ACTION_DISABLE}, origin=Texas Instruments, post-build-variant-value=true, set at pre-compile in variant pre-compile / post-build in variant post-build, default-value=CDD_PWM_TZ_ADV_ACTION_HIGH_Z  # Trip Zone Advanced Actions: CDD_PWM_TZ_ADV_ACTION_HIGH_Z ==>> High impedance output CDD_PWM_TZ_ADV_ACTION_HIGH ==>> High voltage state CDD_PWM_TZ_ADV_ACTION_LOW ==>> Low voltage state CDD_PWM_TOGGLE_STATE ==>> Toggle the output CDD_PWM_TZ_ADV_ACTION_TOGGLE ==>> Disable action .
          enumeration CddPwmTZBAdvDEvent: {CDD_PWM_TZ_ADV_ACTION_HIGH_Z, CDD_PWM_TZ_ADV_ACTION_HIGH, CDD_PWM_TZ_ADV_ACTION_LOW, CDD_PWM_TZ_ADV_ACTION_TOGGLE, CDD_PWM_TZ_ADV_ACTION_DISABLE}, origin=Texas Instruments, post-build-variant-value=true, set at pre-compile in variant pre-compile / post-build in variant post-build, default-value=CDD_PWM_TZ_ADV_ACTION_HIGH_Z  # Trip Zone Advanced Actions: CDD_PWM_TZ_ADV_ACTION_HIGH_Z ==>> High impedance output CDD_PWM_TZ_ADV_ACTION_HIGH ==>> High voltage state CDD_PWM_TZ_ADV_ACTION_LOW ==>> Low voltage state CDD_PWM_TOGGLE_STATE ==>> Toggle the output CDD_PWM_TZ_ADV_ACTION_TOGGLE ==>> Disable action .
        container CddPwmDCA  # Configuration of an individual Trip Zone DCA.
          enumeration CddPwmDCAEVT1Event: {CDD_PWM_HZ_STATE, CDD_PWM_HIGH_STATE, CDD_PWM_LOW_STATE, CDD_PWM_DISABLE_STATE}, origin=Texas Instruments, post-build-variant-value=true, set at pre-compile in variant pre-compile / post-build in variant post-build, default-value=CDD_PWM_HZ_STATE  # Trip Zone Actions: CDD_PWM_HZ_STATE ==>> High impedance output CDD_PWM_HIGH_STATE ==>> High voltage state CDD_PWM_LOW_STATE ==>> Low voltage state CDD_PWM_DISABLE_STATE ==>> Disable action .
          enumeration CddPwmDCAEVT1AdvUEvent: {CDD_PWM_TZ_ADV_ACTION_HIGH_Z, CDD_PWM_TZ_ADV_ACTION_HIGH, CDD_PWM_TZ_ADV_ACTION_LOW, CDD_PWM_TZ_ADV_ACTION_TOGGLE, CDD_PWM_TZ_ADV_ACTION_DISABLE}, origin=Texas Instruments, post-build-variant-value=true, set at pre-compile in variant pre-compile / post-build in variant post-build, default-value=CDD_PWM_TZ_ADV_ACTION_HIGH_Z  # Trip Zone Advanced Actions: CDD_PWM_TZ_ADV_ACTION_HIGH_Z ==>> High impedance output CDD_PWM_TZ_ADV_ACTION_HIGH ==>> High voltage state CDD_PWM_TZ_ADV_ACTION_LOW ==>> Low voltage state CDD_PWM_TOGGLE_STATE ==>> Toggle the output CDD_PWM_TZ_ADV_ACTION_TOGGLE ==>> Disable action .
          enumeration CddPwmDCAEVT1AdvDEvent: {CDD_PWM_TZ_ADV_ACTION_HIGH_Z, CDD_PWM_TZ_ADV_ACTION_HIGH, CDD_PWM_TZ_ADV_ACTION_LOW, CDD_PWM_TZ_ADV_ACTION_TOGGLE, CDD_PWM_TZ_ADV_ACTION_DISABLE}, origin=Texas Instruments, post-build-variant-value=true, set at pre-compile in variant pre-compile / post-build in variant post-build, default-value=CDD_PWM_TZ_ADV_ACTION_HIGH_Z  # Trip Zone Advanced Actions: CDD_PWM_TZ_ADV_ACTION_HIGH_Z ==>> High impedance output CDD_PWM_TZ_ADV_ACTION_HIGH ==>> High voltage state CDD_PWM_TZ_ADV_ACTION_LOW ==>> Low voltage state CDD_PWM_TOGGLE_STATE ==>> Toggle the output CDD_PWM_TZ_ADV_ACTION_TOGGLE ==>> Disable action .
          enumeration CddPwmDCAEVT2Event: {CDD_PWM_HZ_STATE, CDD_PWM_HIGH_STATE, CDD_PWM_LOW_STATE, CDD_PWM_DISABLE_STATE}, origin=Texas Instruments, post-build-variant-value=true, set at pre-compile in variant pre-compile / post-build in variant post-build, default-value=CDD_PWM_HZ_STATE  # Trip Zone Actions: CDD_PWM_HZ_STATE ==>> High impedance output CDD_PWM_HIGH_STATE ==>> High voltage state CDD_PWM_LOW_STATE ==>> Low voltage state CDD_PWM_DISABLE_STATE ==>> Disable action .
          enumeration CddPwmDCAEVT2AdvUEvent: {CDD_PWM_TZ_ADV_ACTION_HIGH_Z, CDD_PWM_TZ_ADV_ACTION_HIGH, CDD_PWM_TZ_ADV_ACTION_LOW, CDD_PWM_TZ_ADV_ACTION_TOGGLE, CDD_PWM_TZ_ADV_ACTION_DISABLE}, origin=Texas Instruments, post-build-variant-value=true, set at pre-compile in variant pre-compile / post-build in variant post-build, default-value=CDD_PWM_TZ_ADV_ACTION_HIGH_Z  # Trip Zone Advanced Actions: CDD_PWM_TZ_ADV_ACTION_HIGH_Z ==>> High impedance output CDD_PWM_TZ_ADV_ACTION_HIGH ==>> High voltage state CDD_PWM_TZ_ADV_ACTION_LOW ==>> Low voltage state CDD_PWM_TOGGLE_STATE ==>> Toggle the output CDD_PWM_TZ_ADV_ACTION_TOGGLE ==>> Disable action .
          enumeration CddPwmDCAEVT2AdvDEvent: {CDD_PWM_TZ_ADV_ACTION_HIGH_Z, CDD_PWM_TZ_ADV_ACTION_HIGH, CDD_PWM_TZ_ADV_ACTION_LOW, CDD_PWM_TZ_ADV_ACTION_TOGGLE, CDD_PWM_TZ_ADV_ACTION_DISABLE}, origin=Texas Instruments, post-build-variant-value=true, set at pre-compile in variant pre-compile / post-build in variant post-build, default-value=CDD_PWM_TZ_ADV_ACTION_HIGH_Z  # Trip Zone Advanced Actions: CDD_PWM_TZ_ADV_ACTION_HIGH_Z ==>> High impedance output CDD_PWM_TZ_ADV_ACTION_HIGH ==>> High voltage state CDD_PWM_TZ_ADV_ACTION_LOW ==>> Low voltage state CDD_PWM_TOGGLE_STATE ==>> Toggle the output CDD_PWM_TZ_ADV_ACTION_TOGGLE ==>> Disable action .
        container CddPwmDCB  # Configuration of an individual Trip Zone DCB.
          enumeration CddPwmDCBEVT1Event: {CDD_PWM_HZ_STATE, CDD_PWM_HIGH_STATE, CDD_PWM_LOW_STATE, CDD_PWM_DISABLE_STATE}, origin=Texas Instruments, post-build-variant-value=true, set at pre-compile in variant pre-compile / post-build in variant post-build, default-value=CDD_PWM_HZ_STATE  # Trip Zone Actions: CDD_PWM_HZ_STATE ==>> High impedance output CDD_PWM_HIGH_STATE ==>> High voltage state CDD_PWM_LOW_STATE ==>> Low voltage state CDD_PWM_DISABLE_STATE ==>> Disable action .
          enumeration CddPwmDCBEVT1AdvUEvent: {CDD_PWM_TZ_ADV_ACTION_HIGH_Z, CDD_PWM_TZ_ADV_ACTION_HIGH, CDD_PWM_TZ_ADV_ACTION_LOW, CDD_PWM_TZ_ADV_ACTION_TOGGLE, CDD_PWM_TZ_ADV_ACTION_DISABLE}, origin=Texas Instruments, post-build-variant-value=true, set at pre-compile in variant pre-compile / post-build in variant post-build, default-value=CDD_PWM_TZ_ADV_ACTION_HIGH_Z  # Trip Zone Advanced Actions: CDD_PWM_TZ_ADV_ACTION_HIGH_Z ==>> High impedance output CDD_PWM_TZ_ADV_ACTION_HIGH ==>> High voltage state CDD_PWM_TZ_ADV_ACTION_LOW ==>> Low voltage state CDD_PWM_TOGGLE_STATE ==>> Toggle the output CDD_PWM_TZ_ADV_ACTION_TOGGLE ==>> Disable action .
          enumeration CddPwmDCBEVT1AdvDEvent: {CDD_PWM_TZ_ADV_ACTION_HIGH_Z, CDD_PWM_TZ_ADV_ACTION_HIGH, CDD_PWM_TZ_ADV_ACTION_LOW, CDD_PWM_TZ_ADV_ACTION_TOGGLE, CDD_PWM_TZ_ADV_ACTION_DISABLE}, origin=Texas Instruments, post-build-variant-value=true, set at pre-compile in variant pre-compile / post-build in variant post-build, default-value=CDD_PWM_TZ_ADV_ACTION_HIGH_Z  # Trip Zone Advanced Actions: CDD_PWM_TZ_ADV_ACTION_HIGH_Z ==>> High impedance output CDD_PWM_TZ_ADV_ACTION_HIGH ==>> High voltage state CDD_PWM_TZ_ADV_ACTION_LOW ==>> Low voltage state CDD_PWM_TOGGLE_STATE ==>> Toggle the output CDD_PWM_TZ_ADV_ACTION_TOGGLE ==>> Disable action .
          enumeration CddPwmDCBEVT2Event: {CDD_PWM_HZ_STATE, CDD_PWM_HIGH_STATE, CDD_PWM_LOW_STATE, CDD_PWM_DISABLE_STATE}, origin=Texas Instruments, post-build-variant-value=true, set at pre-compile in variant pre-compile / post-build in variant post-build, default-value=CDD_PWM_HZ_STATE  # Trip Zone Actions: CDD_PWM_HZ_STATE ==>> High impedance output CDD_PWM_HIGH_STATE ==>> High voltage state CDD_PWM_LOW_STATE ==>> Low voltage state CDD_PWM_DISABLE_STATE ==>> Disable action .
          enumeration CddPwmDCBEVT2AdvUEvent: {CDD_PWM_TZ_ADV_ACTION_HIGH_Z, CDD_PWM_TZ_ADV_ACTION_HIGH, CDD_PWM_TZ_ADV_ACTION_LOW, CDD_PWM_TZ_ADV_ACTION_TOGGLE, CDD_PWM_TZ_ADV_ACTION_DISABLE}, origin=Texas Instruments, post-build-variant-value=true, set at pre-compile in variant pre-compile / post-build in variant post-build, default-value=CDD_PWM_TZ_ADV_ACTION_HIGH_Z  # Trip Zone Advanced Actions: CDD_PWM_TZ_ADV_ACTION_HIGH_Z ==>> High impedance output CDD_PWM_TZ_ADV_ACTION_HIGH ==>> High voltage state CDD_PWM_TZ_ADV_ACTION_LOW ==>> Low voltage state CDD_PWM_TZ_ADV_ACTION_TOGGLE ==>> Toggle the output CDD_PWM_TZ_ADV_ACTION_TOGGLE ==>> Disable action .
          enumeration CddPwmDCBEVT2AdvDEvent: {CDD_PWM_TZ_ADV_ACTION_HIGH_Z, CDD_PWM_TZ_ADV_ACTION_HIGH, CDD_PWM_TZ_ADV_ACTION_LOW, CDD_PWM_TZ_ADV_ACTION_TOGGLE, CDD_PWM_TZ_ADV_ACTION_DISABLE}, origin=Texas Instruments, post-build-variant-value=true, set at pre-compile in variant pre-compile / post-build in variant post-build, default-value=CDD_PWM_TZ_ADV_ACTION_HIGH_Z  # Trip Zone Advanced Actions: CDD_PWM_TZ_ADV_ACTION_HIGH_Z ==>> High impedance output CDD_PWM_TZ_ADV_ACTION_HIGH ==>> High voltage state CDD_PWM_TZ_ADV_ACTION_LOW ==>> Low voltage state CDD_PWM_TZ_ADV_ACTION_TOGGLE ==>> Toggle the output CDD_PWM_TZ_ADV_ACTION_TOGGLE ==>> Disable action .
        container CddPwmOneShotTZ  # Configuration of an individual One Shot Trip Zone.
          boolean CddPwmOneShotTZ{1..6}: origin=Texas Instruments, set at pre-compile in variant pre-compile / post-build in variant post-build, default-value=false  # Enable / disable one shot trip zone.
          boolean CddPwmOneShotDCAEVT1: origin=Texas Instruments, set at pre-compile in variant pre-compile / post-build in variant post-build, default-value=false  # Enable / disable one shot Digital comapre A event.
          boolean CddPwmOneShotDCBEVT1: origin=Texas Instruments, set at pre-compile in variant pre-compile / post-build in variant post-build, default-value=false  # Enable / disable one shot Digital comapre B event.
        container CddPwmCBCTZ  # Configuration of an individual CBC Trip Zone.
          boolean CddPwmCBCTZ{1..6}: origin=Texas Instruments, set at pre-compile in variant pre-compile / post-build in variant post-build, default-value=false  # Enable / disable cycle by cycle trip zone.
          boolean CddPwmCBCDCAEVT2: origin=Texas Instruments, set at pre-compile in variant pre-compile / post-build in variant post-build, default-value=false  # Enable / disable cycle by cycle Digital comapre A event.
          boolean CddPwmCBCDCBEVT2: origin=Texas Instruments, set at pre-compile in variant pre-compile / post-build in variant post-build, default-value=false  # Enable / disable cycle by cycle Digital comapre B event.
        container CddPwmInterrupt  # Configuration of an individual Trip Zone Interrupt.
          boolean CddPwmTZCBCInterrupt: origin=Texas Instruments, set at pre-compile in variant pre-compile / post-build in variant post-build, default-value=false  # Enable / disable cycle by cycle trip zone interupt.
          boolean CddPwmTZOneShotInterrupt: origin=Texas Instruments, set at pre-compile in variant pre-compile / post-build in variant post-build, default-value=false  # Enable / disable one shot trip zone interupt.
          boolean CddPwmDCAEVT1Interrupt: origin=Texas Instruments, set at pre-compile in variant pre-compile / post-build in variant post-build, default-value=false  # Enable / disable digital compare A event 1 interupt.
          boolean CddPwmDCAEVT2Interrupt: origin=Texas Instruments, set at pre-compile in variant pre-compile / post-build in variant post-build, default-value=false  # Enable / disable digital compare A event 2 interupt.
          boolean CddPwmDCBEVT1Interrupt: origin=Texas Instruments, set at pre-compile in variant pre-compile / post-build in variant post-build, default-value=false  # Enable / disable digital compare B event 1 interupt.
          boolean CddPwmDCBEVT2Interrupt: origin=Texas Instruments, set at pre-compile in variant pre-compile / post-build in variant post-build, default-value=false  # Enable / disable digital compare B event 2 interupt.
      container CddPwmDeadBand [1..32]  # Configuration of an individual CDD PWM channel.
        integer CddPwmDeadBandId: 0..255, origin=Texas Instruments, set at pre-compile in variant pre-compile / post-build in variant post-build  # Dead band unit ID.
        enumeration CddPwmDeadBandClockMode: {CDD_PWM_DB_COUNTER_CLOCK_FULL_CYCLE, CDD_PWM_DB_COUNTER_CLOCK_HALF_CYCLE}, origin=Texas Instruments, post-build-variant-value=true, set at pre-compile in variant pre-compile / post-build in variant post-build, default-value=CDD_PWM_DB_COUNTER_CLOCK_FULL_CYCLE  # Dead band clock rate.
        boolean CddPwmDeadBandGlobalLoad: origin=Texas Instruments, set at pre-compile in variant pre-compile / post-build in variant post-build, default-value=false  # Enable Deadband global load configuration.
        boolean CddPwmDeadBandShadowMode: origin=Texas Instruments, set at pre-compile in variant pre-compile / post-build in variant post-build, default-value=false  # Enable Deadband shandowing.
        boolean CddPwmDeadBandSwapOutputA: origin=Texas Instruments, set at pre-compile in variant pre-compile / post-build in variant post-build, default-value=false  # Enable swap the output, Channel A path to Out B.
        boolean CddPwmDeadBandSwapOutputB: origin=Texas Instruments, set at pre-compile in variant pre-compile / post-build in variant post-build, default-value=false  # Enable swap the output, Channel B path to Out A.
        enumeration CddPwmDeadBandDelayLoadMode: {CDD_PWM_RED_LOAD_ON_CNTR_ZERO, CDD_PWM_RED_LOAD_ON_CNTR_PERIOD, CDD_PWM_RED_LOAD_ON_CNTR_ZERO_PERIOD, CDD_PWM_RED_LOAD_FREEZE}, origin=Texas Instruments, post-build-variant-value=true, set at pre-compile in variant pre-compile / post-build in variant post-build, default-value=CDD_PWM_RED_LOAD_ON_CNTR_ZERO  # Shadow to active load event.
        container CddPwmRedSetting  # Configuration of an individual CDD PWM channel.
          boolean CddPwmRedGlobalLoad: origin=Texas Instruments, set at pre-compile in variant pre-compile / post-build in variant post-build, default-value=false  # Enable global load for RED.
          boolean CddPwmRedShadowMode: origin=Texas Instruments, set at pre-compile in variant pre-compile / post-build in variant post-build, default-value=false  # Enable RED shandowing.
          boolean CddPwmREDEnable: origin=Texas Instruments, set at pre-compile in variant pre-compile / post-build in variant post-build, default-value=false  # Enable the Raising edge delay(RED).
          integer CddPwmREDDelayValue: 0..65536, origin=Texas Instruments, set at pre-compile in variant pre-compile / post-build in variant post-build, default-value=1  # Raising edge delay value.
          enumeration CddPwmRedDelayLoadMode: {CDD_PWM_RED_LOAD_ON_CNTR_ZERO, CDD_PWM_RED_LOAD_ON_CNTR_PERIOD, CDD_PWM_RED_LOAD_ON_CNTR_ZERO_PERIOD, CDD_PWM_RED_LOAD_FREEZE}, origin=Texas Instruments, post-build-variant-value=true, set at pre-compile in variant pre-compile / post-build in variant post-build, default-value=CDD_PWM_RED_LOAD_ON_CNTR_ZERO  # Shadow to active load RED event.
          enumeration CddPwmRedBandPolarity: {CDD_PWM_DB_POLARITY_ACTIVE_HIGH, CDD_PWM_DB_POLARITY_ACTIVE_LOW}, origin=Texas Instruments, post-build-variant-value=true, set at pre-compile in variant pre-compile / post-build in variant post-build, default-value=CDD_PWM_DB_POLARITY_ACTIVE_HIGH  # RED polarity: To invert the signal.
          enumeration CddPwmREDDelayInput: {CDD_PWM_DB_INPUT_EPWMA, CDD_PWM_DB_INPUT_EPWMB}, origin=Texas Instruments, post-build-variant-value=true, set at pre-compile in variant pre-compile / post-build in variant post-build, default-value=CDD_PWM_DB_INPUT_EPWMA  # Source for RED.
        container CddPwmFedSetting  # Configuration of an individual CDD PWM FED Setting.
          boolean CddPwmFedGlobalLoad: origin=Texas Instruments, set at pre-compile in variant pre-compile / post-build in variant post-build, default-value=false  # Enable global load for FED.
          boolean CddPwmFedShadowMode: origin=Texas Instruments, set at pre-compile in variant pre-compile / post-build in variant post-build, default-value=false  # Enable FED shandowing.
          boolean CddPwmFEDEnable: origin=Texas Instruments, set at pre-compile in variant pre-compile / post-build in variant post-build, default-value=false  # Enable the falling edge delay(FED).
          integer CddPwmFEDDelayValue: 0..65536, origin=Texas Instruments, set at pre-compile in variant pre-compile / post-build in variant post-build, default-value=1  # Falling edge delay value.
          enumeration CddPwmFedDelayLoadMode: {CDD_PWM_RED_LOAD_ON_CNTR_ZERO, CDD_PWM_RED_LOAD_ON_CNTR_PERIOD, CDD_PWM_RED_LOAD_ON_CNTR_ZERO_PERIOD, CDD_PWM_RED_LOAD_FREEZE}, origin=Texas Instruments, post-build-variant-value=true, set at pre-compile in variant pre-compile / post-build in variant post-build, default-value=CDD_PWM_RED_LOAD_ON_CNTR_ZERO  # Shadow to active load FED event.
          enumeration CddPwmFedBandPolarity: {CDD_PWM_DB_POLARITY_ACTIVE_HIGH, CDD_PWM_DB_POLARITY_ACTIVE_LOW}, origin=Texas Instruments, post-build-variant-value=true, set at pre-compile in variant pre-compile / post-build in variant post-build, default-value=CDD_PWM_DB_POLARITY_ACTIVE_HIGH  # FED polarity: To invert the signal.
          enumeration CddPwmFEDDelayInput: {CDD_PWM_DB_INPUT_EPWMA, CDD_PWM_DB_INPUT_EPWMB, CDD_PWM_DB_INPUT_DB_RED}, origin=Texas Instruments, post-build-variant-value=true, set at pre-compile in variant pre-compile / post-build in variant post-build, default-value=CDD_PWM_DB_INPUT_EPWMA  # Source for FED.
      container CddPwmDigitalCompare [1..32]  # Configuration of an individual CDD PWM Digital Compare.
        integer CddPwmDigitalCompareId: 0..255, origin=Texas Instruments, set at pre-compile in variant pre-compile / post-build in variant post-build  # Specifies the Unit ID of Digital Compare.This value will be assigned to the Digital compare reference Channel.
        enumeration CddPwmDcFilterInputEventSource: {EPWM_DC_WINDOW_SOURCE_DCAEVT1, EPWM_DC_WINDOW_SOURCE_DCAEVT2, EPWM_DC_WINDOW_SOURCE_DCBEVT1, EPWM_DC_WINDOW_SOURCE_DCBEVT2}, origin=Texas Instruments, set at pre-compile, default-value=EPWM_DC_WINDOW_SOURCE_DCAEVT1  # Select the event source for the DCEVTFILT signal.
        container CddPwmDigitalCompareAEVT  # CDD PWM Digital Compare Event for channel A.
          enumeration DCAHigh [0..1]: {EPWM_DC_COMBINATIONAL_TRIPIN1, EPWM_DC_COMBINATIONAL_TRIPIN2, EPWM_DC_COMBINATIONAL_TRIPIN3, EPWM_DC_COMBINATIONAL_TRIPIN4, EPWM_DC_COMBINATIONAL_TRIPIN5, EPWM_DC_COMBINATIONAL_TRIPIN6, EPWM_DC_COMBINATIONAL_TRIPIN7, EPWM_DC_COMBINATIONAL_TRIPIN8, EPWM_DC_COMBINATIONAL_TRIPIN9, EPWM_DC_COMBINATIONAL_TRIPIN10, EPWM_DC_COMBINATIONAL_TRIPIN11, EPWM_DC_COMBINATIONAL_TRIPIN12, EPWM_DC_COMBINATIONAL_TRIPIN13, EPWM_DC_COMBINATIONAL_TRIPIN14, EPWM_DC_COMBINATIONAL_TRIPIN15, EPWM_DC_COMBINATIONAL_ALLTRIPS}, origin=Texas Instruments, post-build-variant-value=true, set at pre-compile in variant pre-compile / post-build in variant post-build, default-value=EPWM_DC_COMBINATIONAL_TRIPIN1  # .
          enumeration CddPwmDCAHigh: {EPWM_DC_TRIP_TRIPIN1, EPWM_DC_TRIP_TRIPIN2, EPWM_DC_TRIP_TRIPIN3, EPWM_DC_TRIP_TRIPIN4, EPWM_DC_TRIP_TRIPIN5, EPWM_DC_TRIP_TRIPIN6, EPWM_DC_TRIP_TRIPIN7, EPWM_DC_TRIP_TRIPIN8, EPWM_DC_TRIP_TRIPIN9, EPWM_DC_TRIP_TRIPIN10, EPWM_DC_TRIP_TRIPIN11, EPWM_DC_TRIP_TRIPIN12, EPWM_DC_TRIP_TRIPIN13, EPWM_DC_TRIP_TRIPIN14, EPWM_DC_TRIP_TRIPIN15, EPWM_DC_TRIP_COMBINATION}, origin=Texas Instruments, set at pre-compile in variant pre-compile / post-build in variant post-build, default-value=EPWM_DC_TRIP_TRIPIN1  # Trip Input to the DCA High.
          enumeration DCALow [0..1]: {EPWM_DC_COMBINATIONAL_TRIPIN1, EPWM_DC_COMBINATIONAL_TRIPIN2, EPWM_DC_COMBINATIONAL_TRIPIN3, EPWM_DC_COMBINATIONAL_TRIPIN4, EPWM_DC_COMBINATIONAL_TRIPIN5, EPWM_DC_COMBINATIONAL_TRIPIN6, EPWM_DC_COMBINATIONAL_TRIPIN7, EPWM_DC_COMBINATIONAL_TRIPIN8, EPWM_DC_COMBINATIONAL_TRIPIN9, EPWM_DC_COMBINATIONAL_TRIPIN10, EPWM_DC_COMBINATIONAL_TRIPIN11, EPWM_DC_COMBINATIONAL_TRIPIN12, EPWM_DC_COMBINATIONAL_TRIPIN13, EPWM_DC_COMBINATIONAL_TRIPIN14, EPWM_DC_COMBINATIONAL_TRIPIN15, EPWM_DC_COMBINATIONAL_ALLTRIPS}, origin=Texas Instrument, set at pre-compile in variant pre-compile / post-build in variant post-build  # Select the sources to include in the combination input sources
          enumeration CddPwmDCALow: {EPWM_DC_TRIP_TRIPIN1, EPWM_DC_TRIP_TRIPIN2, EPWM_DC_TRIP_TRIPIN3, EPWM_DC_TRIP_TRIPIN4, EPWM_DC_TRIP_TRIPIN5, EPWM_DC_TRIP_TRIPIN6, EPWM_DC_TRIP_TRIPIN7, EPWM_DC_TRIP_TRIPIN8, EPWM_DC_TRIP_TRIPIN9, EPWM_DC_TRIP_TRIPIN10, EPWM_DC_TRIP_TRIPIN11, EPWM_DC_TRIP_TRIPIN12, EPWM_DC_TRIP_TRIPIN13, EPWM_DC_TRIP_TRIPIN14, EPWM_DC_TRIP_TRIPIN15, EPWM_DC_TRIP_COMBINATION}, origin=Texas Instruments, set at pre-compile, default-value=EPWM_DC_TRIP_TRIPIN1  # Trip Input to the DCA Low.
          enumeration CddPwmDCAOutputHigh1A: {EPWM_TZ_EVENT_DC_DISABLED, EPWM_TZ_EVENT_DCXH_LOW, EPWM_TZ_EVENT_DCXH_HIGH, EPWM_TZ_EVENT_DCXL_LOW, EPWM_TZ_EVENT_DCXL_HIGH, EPWM_TZ_EVENT_DCXL_HIGH_DCXH_LOW}, origin=Texas Instruments, set at pre-compile, default-value=EPWM_TZ_EVENT_DC_DISABLED  # Condition for DCA output high1 for channel A.
          enumeration CddPwmDCAOutputHigh2A: {EPWM_TZ_EVENT_DC_DISABLED, EPWM_TZ_EVENT_DCXH_LOW, EPWM_TZ_EVENT_DCXH_HIGH, EPWM_TZ_EVENT_DCXL_LOW, EPWM_TZ_EVENT_DCXL_HIGH, EPWM_TZ_EVENT_DCXL_HIGH_DCXH_LOW}, origin=Texas Instruments, set at pre-compile, default-value=EPWM_TZ_EVENT_DC_DISABLED  # Condition for DCA output high2 for channel A.
          boolean CddPwmAdcSocEventA: origin=Texas Instruments, set at pre-compile, default-value=false  # Enables/Disables the ADC SOC Event for Digital compare module A digital compare number 1.
          boolean CddPwmSyncOutEventA: origin=Texas Instruments, set at pre-compile, default-value=false  # Enables/Disables the ADC Syncout Event for Digital compare module A digital compare number 1.
          enumeration CddPwmSyncModeAEVT1: {EPWM_DC_EVENT_INPUT_SYNCED, EPWM_DC_EVENT_INPUT_NOT_SYNCED}, origin=Texas Instruments, set at pre-compile, default-value=EPWM_DC_EVENT_INPUT_SYNCED  # Select the Sync mode for digital compare module A Event Number 1.
          enumeration CddPwmSignalSoureAEVT1: {EPWM_DC_EVENT_SOURCE_ORIG_SIGNAL, EPWM_DC_EVENT_SOURCE_FILT_SIGNAL}, origin=Texas Instruments, set at pre-compile, default-value=EPWM_DC_EVENT_SOURCE_ORIG_SIGNAL  # Select the Sync mode for digital compare module A Event Number 1.
          enumeration CddPwmCBCLatchModeDCAEVT1: {EPWM_DC_CBC_LATCH_DISABLED, EPWM_DC_CBC_LATCH_ENABLED}, origin=Texas Instruments, set at pre-compile, default-value=EPWM_DC_CBC_LATCH_DISABLED  # Select the CBC LAtch mode for digital compare module A Event Number 1.
          enumeration CddPwmCBCLatchClearModeDCAEVT1: {EPWM_DC_CBC_LATCH_CLR_CNTR_ZERO, EPWM_DC_CBC_LATCH_CLR_ON_CNTR_PERIOD, EPWM_DC_CBC_LATCH_CLR_ON_CNTR_ZERO_PERIOD}, origin=Texas Instruments, set at pre-compile, default-value=EPWM_DC_CBC_LATCH_CLR_CNTR_ZERO  # Select the CBC Latch clear mode for digital compare module A Event Number 1.
          enumeration CddPwmSyncModeAEVT2: {EPWM_DC_EVENT_INPUT_SYNCED, EPWM_DC_EVENT_INPUT_NOT_SYNCED}, origin=Texas Instruments, set at pre-compile, default-value=EPWM_DC_EVENT_INPUT_SYNCED  # Select the Sync mode for digital compare module A Event Number 2.
          enumeration CddPwmSignalSoureAEVT2: {EPWM_DC_EVENT_SOURCE_ORIG_SIGNAL, EPWM_DC_EVENT_SOURCE_FILT_SIGNAL}, origin=Texas Instruments, set at pre-compile, default-value=EPWM_DC_EVENT_SOURCE_ORIG_SIGNAL  # Select the Sync mode for digital compare module A Event Number 2.
          enumeration CddPwmCBCLatchModeDCAEVT2: {EPWM_DC_CBC_LATCH_DISABLED, EPWM_DC_CBC_LATCH_ENABLED}, origin=Texas Instruments, set at pre-compile, default-value=EPWM_DC_CBC_LATCH_DISABLED  # Select the CBC LAtch mode for digital compare module A Event Number 2.
          enumeration CddPwmCBCLatchClearModeDCAEVT2: {EPWM_DC_CBC_LATCH_CLR_CNTR_ZERO, EPWM_DC_CBC_LATCH_CLR_ON_CNTR_PERIOD, EPWM_DC_CBC_LATCH_CLR_ON_CNTR_ZERO_PERIOD}, origin=Texas Instruments, set at pre-compile  # Select the CBC Latch clear mode for digital compare module A Event Number 2.
        container CddPwmDigitalCompareBEVT  # CDD PWM Digital Compare Event for channel B.
          enumeration DCBHigh [0..1]: {EPWM_DC_COMBINATIONAL_TRIPIN1, EPWM_DC_COMBINATIONAL_TRIPIN2, EPWM_DC_COMBINATIONAL_TRIPIN3, EPWM_DC_COMBINATIONAL_TRIPIN4, EPWM_DC_COMBINATIONAL_TRIPIN5, EPWM_DC_COMBINATIONAL_TRIPIN6, EPWM_DC_COMBINATIONAL_TRIPIN7, EPWM_DC_COMBINATIONAL_TRIPIN8, EPWM_DC_COMBINATIONAL_TRIPIN9, EPWM_DC_COMBINATIONAL_TRIPIN10, EPWM_DC_COMBINATIONAL_TRIPIN11, EPWM_DC_COMBINATIONAL_TRIPIN12, EPWM_DC_COMBINATIONAL_TRIPIN13, EPWM_DC_COMBINATIONAL_TRIPIN14, EPWM_DC_COMBINATIONAL_TRIPIN15, EPWM_DC_COMBINATIONAL_ALLTRIPS}, origin=Texas Instrument, set at pre-compile in variant pre-compile / post-build in variant post-build  # Select the sources to include in the combination input sources
          enumeration CddPwmDCBHigh: {EPWM_DC_TRIP_TRIPIN1, EPWM_DC_TRIP_TRIPIN2, EPWM_DC_TRIP_TRIPIN3, EPWM_DC_TRIP_TRIPIN4, EPWM_DC_TRIP_TRIPIN5, EPWM_DC_TRIP_TRIPIN6, EPWM_DC_TRIP_TRIPIN7, EPWM_DC_TRIP_TRIPIN8, EPWM_DC_TRIP_TRIPIN9, EPWM_DC_TRIP_TRIPIN10, EPWM_DC_TRIP_TRIPIN11, EPWM_DC_TRIP_TRIPIN12, EPWM_DC_TRIP_TRIPIN13, EPWM_DC_TRIP_TRIPIN14, EPWM_DC_TRIP_TRIPIN15, EPWM_DC_TRIP_COMBINATION}, origin=Texas Instruments, set at pre-compile in variant pre-compile / post-build in variant post-build, default-value=EPWM_DC_TRIP_TRIPIN1  # Trip Input to the DCB High.
          enumeration DCBLow [0..1]: {EPWM_DC_COMBINATIONAL_TRIPIN1, EPWM_DC_COMBINATIONAL_TRIPIN2, EPWM_DC_COMBINATIONAL_TRIPIN3, EPWM_DC_COMBINATIONAL_TRIPIN4, EPWM_DC_COMBINATIONAL_TRIPIN5, EPWM_DC_COMBINATIONAL_TRIPIN6, EPWM_DC_COMBINATIONAL_TRIPIN7, EPWM_DC_COMBINATIONAL_TRIPIN8, EPWM_DC_COMBINATIONAL_TRIPIN9, EPWM_DC_COMBINATIONAL_TRIPIN10, EPWM_DC_COMBINATIONAL_TRIPIN11, EPWM_DC_COMBINATIONAL_TRIPIN12, EPWM_DC_COMBINATIONAL_TRIPIN13, EPWM_DC_COMBINATIONAL_TRIPIN14, EPWM_DC_COMBINATIONAL_TRIPIN15, EPWM_DC_COMBINATIONAL_ALLTRIPS}, origin=Texas Instrument, set at pre-compile in variant pre-compile / post-build in variant post-build  # Select the sources to include in the combination input sources
          enumeration CddPwmDCBLow: {EPWM_DC_TRIP_TRIPIN1, EPWM_DC_TRIP_TRIPIN2, EPWM_DC_TRIP_TRIPIN3, EPWM_DC_TRIP_TRIPIN4, EPWM_DC_TRIP_TRIPIN5, EPWM_DC_TRIP_TRIPIN6, EPWM_DC_TRIP_TRIPIN7, EPWM_DC_TRIP_TRIPIN8, EPWM_DC_TRIP_TRIPIN9, EPWM_DC_TRIP_TRIPIN10, EPWM_DC_TRIP_TRIPIN11, EPWM_DC_TRIP_TRIPIN12, EPWM_DC_TRIP_TRIPIN13, EPWM_DC_TRIP_TRIPIN14, EPWM_DC_TRIP_TRIPIN15, EPWM_DC_TRIP_COMBINATION}, origin=Texas Instruments, set at pre-compile, default-value=EPWM_DC_TRIP_TRIPIN1  # Trip Input to the DCB Low.
          enumeration CddPwmDCBOutputHigh1B: {EPWM_TZ_EVENT_DC_DISABLED, EPWM_TZ_EVENT_DCXH_LOW, EPWM_TZ_EVENT_DCXH_HIGH, EPWM_TZ_EVENT_DCXL_LOW, EPWM_TZ_EVENT_DCXL_HIGH, EPWM_TZ_EVENT_DCXL_HIGH_DCXH_LOW}, origin=Texas Instruments, set at pre-compile, default-value=EPWM_TZ_EVENT_DC_DISABLED  # Condition for DCB output high1 for channel B.
          enumeration CddPwmDCBOutputHigh2B: {EPWM_TZ_EVENT_DC_DISABLED, EPWM_TZ_EVENT_DCXH_LOW, EPWM_TZ_EVENT_DCXH_HIGH, EPWM_TZ_EVENT_DCXL_LOW, EPWM_TZ_EVENT_DCXL_HIGH, EPWM_TZ_EVENT_DCXL_HIGH_DCXH_LOW}, origin=Texas Instruments, set at pre-compile, default-value=EPWM_TZ_EVENT_DC_DISABLED  # Condition for DCB output high2 for channel B.
          boolean CddPwmAdcSocEventB: origin=Texas Instruments, set at pre-compile, default-value=false  # Enables/Disables the ADC SOC Event for Digital compare module B digital compare number 1.
          boolean CddPwmSyncOutEventB: origin=Texas Instruments, set at pre-compile, default-value=false  # Enables/Disables the ADC Syncout Event for Digital compare module B digital compare number 1.
          enumeration CddPwmSyncModeBEVT1: {EPWM_DC_EVENT_INPUT_SYNCED, EPWM_DC_EVENT_INPUT_NOT_SYNCED}, origin=Texas Instruments, set at pre-compile, default-value=EPWM_DC_EVENT_INPUT_SYNCED  # Select the Sync mode for digital compare module B Event Number 1.
          enumeration CddPwmSignalSoureBEVT1: {EPWM_DC_EVENT_SOURCE_ORIG_SIGNAL, EPWM_DC_EVENT_SOURCE_FILT_SIGNAL}, origin=Texas Instruments, set at pre-compile, default-value=EPWM_DC_EVENT_SOURCE_ORIG_SIGNAL  # Select the Sync mode for digital compare module B Event Number 1.
          enumeration CddPwmCBCLatchModeDCBEVT1: {EPWM_DC_CBC_LATCH_DISABLED, EPWM_DC_CBC_LATCH_ENABLED}, origin=Texas Instruments, set at pre-compile, default-value=EPWM_DC_CBC_LATCH_DISABLED  # Select the CBC LAtch mode for digital compare module B Event Number 1.
          enumeration CddPwmCBCLatchClearModeDCBEVT1: {EPWM_DC_CBC_LATCH_CLR_CNTR_ZERO, EPWM_DC_CBC_LATCH_CLR_ON_CNTR_PERIOD, EPWM_DC_CBC_LATCH_CLR_ON_CNTR_ZERO_PERIOD}, origin=Texas Instruments, set at pre-compile, default-value=EPWM_DC_CBC_LATCH_CLR_CNTR_ZERO  # Select the CBC Latch clear mode for digital compare module B Event Number 1.
          enumeration CddPwmSyncModeBEVT2: {EPWM_DC_EVENT_INPUT_SYNCED, EPWM_DC_EVENT_INPUT_NOT_SYNCED}, origin=Texas Instruments, set at pre-compile, default-value=EPWM_DC_EVENT_INPUT_SYNCED  # Select the Sync mode for digital compare module B Event Number 2.
          enumeration CddPwmSignalSoureBEVT2: {EPWM_DC_EVENT_SOURCE_ORIG_SIGNAL, EPWM_DC_EVENT_SOURCE_FILT_SIGNAL}, origin=Texas Instruments, set at pre-compile, default-value=EPWM_DC_EVENT_SOURCE_ORIG_SIGNAL  # Select the Sync mode for digital compare module B Event Number 2.
          enumeration CddPwmCBCLatchModeDCBEVT2: {EPWM_DC_CBC_LATCH_DISABLED, EPWM_DC_CBC_LATCH_ENABLED}, origin=Texas Instruments, set at pre-compile, default-value=EPWM_DC_CBC_LATCH_DISABLED  # Select the CBC LAtch mode for digital compare module B Event Number 2.
          enumeration CddPwmCBCLatchClearModeDCBEVT2: {EPWM_DC_CBC_LATCH_CLR_CNTR_ZERO, EPWM_DC_CBC_LATCH_CLR_ON_CNTR_PERIOD, EPWM_DC_CBC_LATCH_CLR_ON_CNTR_ZERO_PERIOD}, origin=Texas Instruments, set at pre-compile, default-value=EPWM_DC_CBC_LATCH_CLR_CNTR_ZERO  # Select the CBC Latch clear mode for digital compare module B Event Number 2.
        container CddPwmUseBlankingWindow  # CDD PWM Use Blanking window.
          enumeration BlankingWindowStartMixedEvent [0..1]: {EPWM_DC_TBCTR_ZERO, EPWM_DC_TBCTR_PERIOD, EPWM_DC_TBCTR_U_CMPA, EPWM_DC_TBCTR_D_CMPA, EPWM_DC_TBCTR_U_CMPB, EPWM_DC_TBCTR_D_CMPB, EPWM_DC_TBCTR_U_CMPC, EPWM_DC_TBCTR_D_CMPC, EPWM_DC_TBCTR_U_CMPD, EPWM_DC_TBCTR_D_CMPD, EPWM_DC_TBCTR_ALL}, origin=Texas Instrument, set at pre-compile in variant pre-compile / post-build in variant post-build, default-value=EPWM_DC_TBCTR_ZERO  # Select the mixed event source that starts the blanking window counter (And resets the counter)
          enumeration BlankingWindowStartEvent: {EPWM_DC_WINDOW_START_TBCTR_PERIOD, EPWM_DC_WINDOW_START_TBCTR_ZERO, EPWM_DC_WINDOW_START_TBCTR_ZERO_PERIOD, EPWM_DC_WINDOW_START_TBCTR_BLANK_PULSE_MIX}, origin=Texas Instrument, set at pre-compile in variant pre-compile / post-build in variant post-build, default-value=EPWM_DC_WINDOW_START_TBCTR_PERIOD  # Select the event source that starts the blanking window counter (And resets the counter)
          integer BlankingWindowOffset [0..1]: 0..65535, origin=Texas Instruments, set at pre-compile, default-value=0  # Set the offset of the blanking window (TBCLK count).
          integer BlankingWindowLength [0..1]: 0..65535, origin=Texas Instruments, set at pre-compile, default-value=0  # Set the length of the blanking window (TBCLK count).
          boolean CddPwmUseBlankingWindow: origin=Texas Instruments, set at pre-compile in variant pre-compile / post-build in variant post-build, default-value=false  # Use blanking window to blank the DCEVTFILT signal
        container CddPwmUseDCCounterCapture  # CDD PWM Use DC Counter capture.
          boolean CddPwmDCCounterCaptureShadowMode [0..1]: origin=Texas Instruments, set at pre-compile in variant pre-compile / post-build in variant post-build, default-value=false  # Use DC counter capture feature in shadow mode
          boolean CddPwmUseDCCounterCapture: origin=Texas Instruments, set at pre-compile in variant pre-compile / post-build in variant post-build, default-value=false  # Use DC counter capture feature to capture the TBCTR value at the selected event
        container CddPwmUseEdgeFilter  # CDD PWM Use Edge Filter.
          enumeration CddPwmStopValleyCapture [0..1]: {Events_0, Events_1, Events_2, Events_3, Events_4, Events_5, Events_6, Events_7, Events_8, Events_9, Events_10, Events_11, Events_12}, origin=Texas Instrument, set at pre-compile in variant pre-compile / post-build in variant post-build, default-value=Events_0  # The number of trigger events required to stop the valley capture count
          enumeration CddPwmStartValleyCapture [0..1]: {Events_0, Events_1, Events_2, Events_3, Events_4, Events_5, Events_6, Events_7, Events_8, Events_9, Events_10, Events_11, Events_12}, origin=Texas Instrument, set at pre-compile in variant pre-compile / post-build in variant post-build, default-value=Events_0  # The number of trigger events required to start the valley capture count
          enumeration CddPwmUseEdgeFilterCounterCaptureSignal [0..1]: {EPWM_VALLEY_TRIGGER_EVENT_SOFTWARE, EPWM_VALLEY_TRIGGER_EVENT_CNTR_ZERO, EPWM_VALLEY_TRIGGER_EVENT_CNTR_PERIOD, EPWM_VALLEY_TRIGGER_EVENT_CNTR_ZERO_PERIOD, EPWM_VALLEY_TRIGGER_EVENT_DCAEVT1, EPWM_VALLEY_TRIGGER_EVENT_DCAEVT2, EPWM_VALLEY_TRIGGER_EVENT_DCBEVT1, EPWM_VALLEY_TRIGGER_EVENT_DCBEVT2}, origin=Texas Instrument, set at pre-compile in variant pre-compile / post-build in variant post-build, default-value=EPWM_VALLEY_TRIGGER_EVENT_SOFTWARE  # Sets the signal source for valley capture and edge filter counter reset
          enumeration CddPwmEdgeFilterCount [0..1]: {EPWM_DC_EDGEFILT_EDGECNT_0, EPWM_DC_EDGEFILT_EDGECNT_1, EPWM_DC_EDGEFILT_EDGECNT_2, EPWM_DC_EDGEFILT_EDGECNT_3, EPWM_DC_EDGEFILT_EDGECNT_4, EPWM_DC_EDGEFILT_EDGECNT_5, EPWM_DC_EDGEFILT_EDGECNT_6, EPWM_DC_EDGEFILT_EDGECNT_7}, origin=Texas Instrument, set at pre-compile in variant pre-compile / post-build in variant post-build, default-value=EPWM_DC_EDGEFILT_EDGECNT_0  # Sets the number of edges detected bye the digital compare event edge filter mode to generate an event
          enumeration CddPwmEdgeFilterMode [0..1]: {EPWM_DC_EDGEFILT_MODE_RISING, EPWM_DC_EDGEFILT_MODE_FALLING, EPWM_DC_EDGEFILT_MODE_BOTH}, origin=Texas Instrument, set at pre-compile in variant pre-compile / post-build in variant post-build, default-value=EPWM_DC_EDGEFILT_MODE_RISING  # Sets the digital compare event edge filter mode
          enumeration CddPwmValleyDelayDivider [0..1]: {EPWM_VALLEY_DELAY_MODE_SW_DELAY, EPWM_VALLEY_DELAY_MODE_VCNT_DELAY_SW_DELAY, EPWM_VALLEY_DELAY_MODE_VCNT_DELAY_SHIFT_1_SW_DELAY, EPWM_VALLEY_DELAY_MODE_VCNT_DELAY_SHIFT_2_SW_DELAY, EPWM_VALLEY_DELAY_MODE_VCNT_DELAY_SHIFT_4_SW_DELAY}, origin=Texas Instrument, set at pre-compile in variant pre-compile / post-build in variant post-build, default-value=EPWM_VALLEY_DELAY_MODE_SW_DELAY  # The delay divider along with SWVDELVAL will be used calculate the HWDELVAL
          integer SoftwareValleyDelayValue [0..1]: 0..65535, origin=Texas Instruments, set at pre-compile, default-value=0  # Set SWVDELVAL(Software Valley Delay Value).This value along with the valley delay divider will be used to calculate the HWDELVAL
          boolean CddPwmEdgeFilterValleyCapture: origin=Texas Instruments, set at pre-compile in variant pre-compile / post-build in variant post-build, default-value=false  # This will enable valley capturing feature/allows the input signal selected for valley capturing to reset the edge filter count
          boolean CddPwmStartValleyCaptureLogic [0..1]: origin=Texas Instruments, set at pre-compile in variant pre-compile / post-build in variant post-build, default-value=false  # Start the valley capture logic
          boolean CddPwmDelayedOutputEdgeFilter: origin=Texas Instruments, set at pre-compile in variant pre-compile / post-build in variant post-build, default-value=false  # Start the valley capture logic
          boolean CddPwmUseEdgeFilter: origin=Texas Instruments, set at pre-compile in variant pre-compile / post-build in variant post-build, default-value=false  # The DCEVTFILT signal and DCCAP (counter capture) will use the output of the edge filter
      container CddPwmChopper [1..32]  # Configuration of an individual CDD PWM channel.
        integer CddPwmChopperId: 0..255, origin=Texas Instruments, set at pre-compile in variant pre-compile / post-build in variant post-build  # PWM Chopper unit ID.
        boolean CddPwmChopperEnable: origin=Texas Instruments, set at pre-compile in variant pre-compile / post-build in variant post-build, default-value=false  # Enable the Chopper.
        integer CddPwmChopperDuty: 1..8, origin=Texas Instruments, set at pre-compile in variant pre-compile / post-build in variant post-build, default-value=1  # Chopper duty cycle.
        integer CddPwmChopperFreqency: 1..8, origin=Texas Instruments, set at pre-compile in variant pre-compile / post-build in variant post-build, default-value=1  # Chopper freqency.
        integer CddPwmChopperFirstPulseWidth: 1..16, origin=Texas Instruments, set at pre-compile in variant pre-compile / post-build in variant post-build, default-value=1  # Chopper first pulse width.
      container CddPwmHighResolutionPwm [1..32]  # Configuration of an individual CDD PWM channel.
        integer CddPwmHRPwmId: 0..256, origin=Texas Instruments, set at pre-compile in variant pre-compile / post-build in variant post-build  # HR Pwm unit ID.
        boolean CddPwmEnableHRPWM: origin=Texas Instruments, set at pre-compile in variant pre-compile / post-build in variant post-build, default-value=true  # Enable/Disable the HRPWM functionality
        boolean CddPwmAutoHRMStepScaling: origin=Texas Instruments, set at pre-compile in variant pre-compile / post-build in variant post-build, default-value=true  # Enable/Disable the automatic HR step scaling
        container CddPwmDutyPeriodPhaseCtrl  # Configuration of a HR duty and period control for individual CDD PWM channel.
          enumeration CddPwmCtrlModeHRPWMA: {HRPWM_MEP_DUTY_PERIOD_CTRL, HRPWM_MEP_PHASE_CTRL}, origin=Texas Instruments, post-build-variant-value=true, set at pre-compile in variant pre-compile / post-build in variant post-build, default-value=HRPWM_MEP_DUTY_PERIOD_CTRL  # Control Mode For Channel A
          enumeration CddPwmCtrlModeHRPWMB: {HRPWM_MEP_DUTY_PERIOD_CTRL, HRPWM_MEP_PHASE_CTRL}, origin=Texas Instruments, post-build-variant-value=true, set at pre-compile in variant pre-compile / post-build in variant post-build, default-value=HRPWM_MEP_DUTY_PERIOD_CTRL  # Control Mode For Channel B
          enumeration CddPwmEdgeModeHRPWMA: {HRPWM_MEP_CTRL_DISABLE, HRPWM_MEP_CTRL_RISING_EDGE, HRPWM_MEP_CTRL_FALLING_EDGE, HRPWM_MEP_CTRL_RISING_AND_FALLING_EDGE}, origin=Texas Instruments, post-build-variant-value=true, set at pre-compile in variant pre-compile / post-build in variant post-build, default-value=HRPWM_MEP_CTRL_DISABLE  # .
          integer CddPwmCmpHRPWMA: 0..4294967296, origin=Texas Instruments, set at pre-compile in variant pre-compile / post-build in variant post-build, default-value=0  # HR CMPA Value
          enumeration CddPwmShadowActiveLoadEventHRPWMA: {HRPWM_LOAD_ON_CNTR_ZERO, HRPWM_LOAD_ON_CNTR_PERIOD, HRPWM_LOAD_ON_CNTR_ZERO_PERIOD}, origin=Texas Instruments, post-build-variant-value=true, set at pre-compile in variant pre-compile / post-build in variant post-build, default-value=HRPWM_LOAD_ON_CNTR_ZERO  # CMPAHR Shadow To Active Load Event
          enumeration CddPwmEdgeModeHRPWMB: {HRPWM_MEP_CTRL_DISABLE, HRPWM_MEP_CTRL_RISING_EDGE, HRPWM_MEP_CTRL_FALLING_EDGE, HRPWM_MEP_CTRL_RISING_AND_FALLING_EDGE}, origin=Texas Instruments, post-build-variant-value=true, set at pre-compile in variant pre-compile / post-build in variant post-build, default-value=HRPWM_MEP_CTRL_DISABLE  # .
          integer CddPwmCmpHRPWMB: 0..4294967296, origin=Texas Instruments, set at pre-compile in variant pre-compile / post-build in variant post-build, default-value=0  # HR CMPB Value
          enumeration CddPwmShadowActiveLoadEventHRPWMB: {HRPWM_LOAD_ON_CNTR_ZERO, HRPWM_LOAD_ON_CNTR_PERIOD, HRPWM_LOAD_ON_CNTR_ZERO_PERIOD}, origin=Texas Instruments, post-build-variant-value=true, set at pre-compile in variant pre-compile / post-build in variant post-build, default-value=HRPWM_LOAD_ON_CNTR_ZERO  # CMPBHR Shadow To Active Load Event
          boolean CddPwmEnableHRPeriodCtrl: origin=Texas Instruments, set at pre-compile in variant pre-compile / post-build in variant post-build, default-value=true  # Enable/Disable the HRPWM Period
          integer CddPwmHRPeriod: 0..4294967296, origin=Texas Instruments, set at pre-compile in variant pre-compile / post-build in variant post-build, default-value=0  # HR Period Value
          boolean CddPwmEnableHRPhaseCtrl: origin=Texas Instruments, set at pre-compile in variant pre-compile / post-build in variant post-build, default-value=true  # Enable/Disable the HRPWM Phase load
          integer CddPwmHRPhase: 0..4294967296, origin=Texas Instruments, set at pre-compile in variant pre-compile / post-build in variant post-build, default-value=0  # HR Phase Value
          enumeration CddPwmPWMSyncSelect: {HRPWM_PWMSYNC_SOURCE_PERIOD, HRPWM_PWMSYNC_SOURCE_ZERO, HRPWM_PWMSYNC_SOURCE_COMPC_UP, HRPWM_PWMSYNC_SOURCE_COMPC_DOWN, HRPWM_PWMSYNC_SOURCE_COMPD_UP, HRPWM_PWMSYNC_SOURCE_COMPD_DOWN}, origin=Texas Instruments, post-build-variant-value=true, set at pre-compile in variant pre-compile / post-build in variant post-build, default-value=HRPWM_PWMSYNC_SOURCE_ZERO  # HR PWMSYNC Source Select
        container CddPwmDeadbandCtrl  # Configuration of a HR deadband control
          enumeration CddPwmDeadbandEdgeMode: {HRPWM_DB_MEP_CTRL_DISABLE, HRPWM_DB_MEP_CTRL_RED, HRPWM_DB_MEP_CTRL_FED, HRPWM_DB_MEP_CTRL_RED_FED}, origin=Texas Instruments, post-build-variant-value=true, set at pre-compile in variant pre-compile / post-build in variant post-build, default-value=HRPWM_DB_MEP_CTRL_DISABLE  # HR PWM Deadband MEP Edge Mode Selection
          integer CddPwmRisingEdgeDelay: 0..4294967296, origin=Texas Instruments, set at pre-compile in variant pre-compile / post-build in variant post-build, default-value=0  # HR Rising Edge delay value
          enumeration CddPwmRisEdgeShadowActiveLoad: {HRPWM_LOAD_ON_CNTR_ZERO, HRPWM_LOAD_ON_CNTR_PERIOD, HRPWM_LOAD_ON_CNTR_ZERO_PERIOD}, origin=Texas Instruments, post-build-variant-value=true, set at pre-compile in variant pre-compile / post-build in variant post-build, default-value=HRPWM_LOAD_ON_CNTR_ZERO  # DBREDHR Shadow To Active Load Event
          integer CddPwmFallingEdgeDelay: 0..4294967296, origin=Texas Instruments, set at pre-compile in variant pre-compile / post-build in variant post-build, default-value=0  # HR Falling Edge delay value
          enumeration CddPwmFalEdgeShadowActiveLoad: {HRPWM_LOAD_ON_CNTR_ZERO, HRPWM_LOAD_ON_CNTR_PERIOD, HRPWM_LOAD_ON_CNTR_ZERO_PERIOD}, origin=Texas Instruments, post-build-variant-value=true, set at pre-compile in variant pre-compile / post-build in variant post-build, default-value=HRPWM_LOAD_ON_CNTR_ZERO  # DBFEDHR Shadow To Active Load Event
          boolean CddPwmSwapOutputCtrl: origin=Texas Instruments, set at pre-compile in variant pre-compile / post-build in variant post-build, default-value=true  # Swap A and B channels HRPWM outputs
          enumeration CddPwmHROutputCtrlPWMB: {HRPWM_OUTPUT_ON_B_NORMAL, HRPWM_OUTPUT_ON_B_INV_A}, origin=Texas Instruments, post-build-variant-value=true, set at pre-compile in variant pre-compile / post-build in variant post-build, default-value=HRPWM_OUTPUT_ON_B_NORMAL  # EPWMxB Output Selection
