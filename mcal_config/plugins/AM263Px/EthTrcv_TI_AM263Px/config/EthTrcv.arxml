AUTOSAR XML (schema 00044)
package /TI_AM263Px
  module definition EthTrcv [0..*]: post-build-variant-support=true, refined-module-def=EthTrcv, variants link-time/post-build/pre-compile  # Configuration of Ethernet Transceiver Driver module
    container EthTrcvConfigSet  # This container contains the configuration parameters and sub containers of the AUTOSAR EthTrcv module.
      container EthTrcvConfig [1..*]  # Configuration of the individual transceiver
        boolean EthTrcvAutoNegotiationEnabled: post-build-variant-value=true, set at link in variant link-time / post-build in variant post-build / pre-compile in variant pre-compile, default-value=true  # Specifies if Auto-Negotiation is enabled (TRUE) or disabled (FALSE) for determination of the Ethernet transceiver speed.
        enumeration EthTrcvConnNeg: {TRCV_CONN_NEG_AUTO, TRCV_CONN_NEG_MASTER, TRCV_CONN_NEG_SLAVE}, post-build-variant-value=true, set at link in variant link-time / post-build in variant post-build / pre-compile in variant pre-compile, default-value=TRCV_CONN_NEG_AUTO  # Specifies the connection negotiation of the Ethernet transceiver link.
        integer EthTrcvCtrlIdx: 0..255, post-build-variant-value=true, set at link in variant link-time / post-build in variant post-build / pre-compile in variant pre-compile, default-value=0  # Specifies the controller used for MII access to the transceiver
        enumeration EthTrcvDuplexMode: {ETHTRCV_DUPLEX_MODE_FULL, ETHTRCV_DUPLEX_MODE_HALF}, post-build-variant-value=true, set at link in variant link-time / post-build in variant post-build / pre-compile in variant pre-compile, default-value=ETHTRCV_DUPLEX_MODE_FULL  # Specifies the duplex mode of the Ethernet transceiver link if Auto-Negotiation is disabled. This parameter is ignored if Auto-Negotiation is enabled.
        integer EthTrcvIdx: 0..255, scope=ECU, set at pre-compile, symbolic-name-value=true, default-value=0  # Specifies the instance ID of the configured transceiver.
        enumeration EthTrcvPhysLayerType [0..1]: {TRCV_PHYS_LAYER_TYPE_1000BASE_T, TRCV_PHYS_LAYER_TYPE_1000BASE_T1, TRCV_PHYS_LAYER_TYPE_100BASE_T1, TRCV_PHYS_LAYER_TYPE_100BASE_TX}, multiplicity set at link in variant link-time / post-build in variant post-build / pre-compile in variant pre-compile, post-build-variant-multiplicity=true, post-build-variant-value=true, set at link in variant link-time / post-build in variant post-build / pre-compile in variant pre-compile, default-value=TRCV_PHYS_LAYER_TYPE_100BASE_T1  # Specifies the physical layer type of the Ethernet transceiver link.
        enumeration EthTrcvPortMacLayerSpeed [0..1]: {ETH_MAC_LAYER_SPEED_100M, ETH_MAC_LAYER_SPEED_10G, ETH_MAC_LAYER_SPEED_10M, ETH_MAC_LAYER_SPEED_1G}, scope=ECU, multiplicity set at link in variant link-time+post-build / pre-compile in variant pre-compile, post-build-variant-multiplicity=true, post-build-variant-value=true, set at link in variant link-time+post-build / pre-compile in variant pre-compile, default-value=ETH_MAC_LAYER_SPEED_100M  # Defines the baud rate of the MAC layer.
        enumeration EthTrcvPortMacLayerSubType [0..1]: {REDUCED, REVERSED, SERIAL, STANDARD, UNIVERSAL_SERIAL}, scope=ECU, multiplicity set at link in variant link-time+post-build / pre-compile in variant pre-compile, post-build-variant-multiplicity=true, post-build-variant-value=true, set at link in variant link-time+post-build / pre-compile in variant pre-compile, default-value=REDUCED  # Defines the MAC layer subtype of a switch port
        enumeration EthTrcvPortMacLayerType [0..1]: {TRCV_MAC_LAYER_TYPE_XGMII, TRCV_MAC_LAYER_TYPE_XMII, TRCV_MAC_LAYER_TYPE_XXGMII}, scope=ECU, multiplicity set at link in variant link-time / post-build in variant post-build / pre-compile in variant pre-compile, post-build-variant-multiplicity=true, post-build-variant-value=true, set at link in variant link-time / post-build in variant post-build / pre-compile in variant pre-compile, default-value=TRCV_MAC_LAYER_TYPE_XMII  # Defines the MAC layer type of the ethernet transceiver.
        enumeration EthTrcvSpeed: {TRCV_SPEED_10, TRCV_SPEED_100}, post-build-variant-value=true, set at link in variant link-time / post-build in variant post-build / pre-compile in variant pre-compile, default-value=TRCV_SPEED_100  # Specifies the speed of the Ethernet transceiver link in [MBit/s]. If AutoNegotiation is enabled this is the maximum speed advertised for Auto-Negotiation.In AM263Px only TRCV_SPEED_10 and TRCV_SPEED_100 is supported
        function name EthTrcvWakeUpCallout [0..1]: multiplicity set at pre-compile, set at pre-compile  # Configuration of the call-out name.
        boolean EthTrcvEnableLoopback: origin=Texas Instruments, set at pre-compile in variant link-time+pre-compile / post-build in variant post-build, default-value=true  # Phy loopback enable- for Test purpose
        boolean EthTrcvGigabitCapabilityEnabled: origin=Texas Instruments, set at pre-compile in variant link-time+pre-compile / post-build in variant post-build, default-value=true  # Phy loopback enable- for Test purpose
        symbolic name reference EthTrcvIcuChannelRef [0..1]: multiplicity set at pre-compile, set at pre-compile, destination=IcuChannel  # Reference to the IcuChannel to enable/disable the interrupts for wakeups.
        reference EthTrcvPhyAdvertiseCapability [0..32]: multiplicity set at pre-compile in variant link-time+pre-compile / post-build in variant post-build, origin=Texas Instruments, set at pre-compile in variant link-time+pre-compile / post-build in variant post-build, destination=EthTrcvCapabType  # Phy advertisement capability
        reference EthTrcvLinkPartnerCapability [0..32]: multiplicity set at pre-compile in variant link-time+pre-compile / post-build in variant post-build, origin=Texas Instruments, set at pre-compile in variant link-time+pre-compile / post-build in variant post-build, destination=EthTrcvCapabType  # Phy advertisement capability
        container EthTrcvDemEventParameterRefs [0..1]  # Container for the references to DemEventParameter elements which shall be invoked using the API Dem_SetEventStatus in case the corresponding error occurs. The EventId is taken from the referenced DemEventParameter's DemEventId symbolic value. The standardized errors are provided in this container and can be extended by vendor-specific error references.
          symbolic name reference ETHTRCV_E_ACCESS [0..1]: multiplicity set at link in variant link-time / post-build in variant post-build / pre-compile in variant pre-compile, post-build-variant-multiplicity=true, post-build-variant-value=true, set at link in variant link-time / post-build in variant post-build / pre-compile in variant pre-compile, destination=DemEventParameter  # Reference to the DemEventParameter which shall be issued when the error "Transceiver access failed" has occurred.
          symbolic name reference ETHTRCV_E_HARDWARE_ERROR [0..1]: multiplicity set at pre-compile, origin=Texas Instruments, set at pre-compile, destination=DemEventParameter  # Reference to the DemEventParameter which shall be issued when the error "Timeout on blocking API call occurs " has occurred.
        choice container EthTrcvMgmtInterface [0..1]: multiplicity set at pre-compile  # The choice container allow to configure either the EthTrcv is accessed by a MII interface or Switch interface.
          container EthTrcvMiiInterface [0..1]: multiplicity set at pre-compile  # This container includes the MII interface configuration between an Ethernet Controller and the Ethernet Transceiver. If this container is configured the EthTrcv shall call Eth_WriteMii / Eth_ReadMii API to access the hardware ethernet tranceiver.
            integer EthTrcvMiiIdx: 0..255, set at link in variant link-time / post-build in variant post-build / pre-compile in variant pre-compile, default-value=0  # Specifies the transceiver index used for MII access to the transceiver
            enumeration EthTrcvMiiSelection: {LIGHT_MII, MII, RGMII}, set at pre-compile, default-value=RGMII  # This parameter specifies the type of transceiver / controller interface. The interface is either MII, Light-MII or RGMII.
          container EthTrcvSwitchInterface [0..1]: multiplicity set at pre-compile  # This container includes the Switch interface configuration between an Ethernet Switch and an Ethernet Transceiver. If this container is configured the EthTrcv shall call EthSwt_WriteTrcvRegister / EthSwt_WriteTrcvRegister API to access the hardware ethernet transceiver.
            symbolic name reference EthTrcvSwitchPortRef: set at pre-compile, destination=EthSwtPort  # Reference to a switch port and it's not implementated in AM263Px
            symbolic name reference EthTrcvSwitchRef: set at pre-compile, destination=EthSwtConfig  # Reference to a switch configuration container and it's not implementated in AM263Px.
        container EthTrcvWakeupMap [0..7]  # Container for the mapping of wake up reasons to wake up sources. At least one container is needed if EthTrcvWakeUpSupport is not ETHTRCV_WAKEUP_NOT_SUPPORTED.
          enumeration EthTrcvWakeupReason: {ETHTRCV_WUR_BUS, ETHTRCV_WUR_GENERAL, ETHTRCV_WUR_INTERNAL, ETHTRCV_WUR_PIN, ETHTRCV_WUR_POWER_ON, ETHTRCV_WUR_RESET, ETHTRCV_WUR_SYSERR}, post-build-variant-value=true, set at link in variant link-time / post-build in variant post-build / pre-compile in variant pre-compile, default-value=ETHTRCV_WUR_BUS  # This parameter defines the transceiver wake up reasons. This parameter is not used.
          enumeration EthTrcvWakeupReason1: {ETHTRCV_WUR_MAGIC, ETHTRCV_WUR_PATTERN, ETHTRCV_WUR_BROADCAST, ETHTRCV_WUR_UNICAST}, origin=Texas Instruments, post-build-variant-value=true, set at link in variant link-time / post-build in variant post-build / pre-compile in variant pre-compile, default-value=ETHTRCV_WUR_MAGIC  # This parameter defines the transceiver wake up reasons.
          symbolic name reference EthTrcvWakeupSourceRef: set at pre-compile, destination=EcuMWakeupSource  # Configures the wake-up source defined in EcuM.
        container EthTrcvCapabType [0..255]  # Structure for MDIO configuration
          enumeration EthTrcvCapabTypeEnum: {ETHERNET_ADV_CAPAB_10_HALF, ETHERNET_ADV_CAPAB_10_FULL, ETHERNET_ADV_CAPAB_100_HALF, ETHERNET_ADV_CAPAB_100_FULL, ETHERNET_ADV_CAPAB_1000_HALF, ETHERNET_ADV_CAPAB_1000_FULL}, origin=Texas Instruments, set at link in variant link-time / post-build in variant post-build / pre-compile in variant pre-compile, default-value=ETHERNET_ADV_CAPAB_100_FULL  # Enumerates Advertisement configurations
    container EthTrcvGeneral  # General configuration of Ethernet Transceiver Driver module
      integer EthTrcvAutoNegotiationWaitCountTicks: 0..4294967295, origin=Texas Instruments, set at pre-compile, default-value=80000  # Ethernet Tranceiver Tranceiver delay after autonetotiation started to autonegotiation completed. Transceiver (PHY) sets auto-negotiation status bit in status register once it is complete. Depending on Transceiver type, MDIO frequence it will take different time. change count value if transceiver detection fails in auto-negotiation. For auto-negotiation configuring wait count to 100ms
      boolean EthTrcvDevErrorDetect: set at pre-compile, default-value=false  # Switches the development error detection and notification on or off.
      boolean EthTrcvGetBaudRateApi: set at pre-compile, default-value=true  # Enables / Disables EthTrcv_GetBaudRate API
      boolean EthTrcvGetCableDiagnosticsResultApi: set at pre-compile, default-value=true  # Enables / Disables EthTrcv_GetCableDiagnosticsResult API.
      boolean EthTrcvGetDuplexModeApi: set at pre-compile, default-value=true  # Enables / Disables EthTrcv_GetDuplexMode API
      boolean EthTrcvGetLinkStateApi: set at pre-compile, default-value=true  # Enables / Disables EthTrcv_GetLinkState API
      boolean EthTrcvGetPhyIdentifierApi: set at pre-compile, default-value=true  # Enables / Disables EthTrcv_GetPhyIdentifier API.
      boolean EthTrcvGetPhySignalQualityApi: set at pre-compile, default-value=true  # Enables / Disables EthTrcv_GetPhySignalQuality API.
      boolean EthTrcvGetTransceiverModeApi: set at pre-compile, default-value=true  # Enables / Disables EthTrcv_GetTransceiverMode API
      boolean EthTrcvGetTransceiverWakeupModeApi: set at pre-compile, default-value=true  # Enables / Disables EthTrcvGetTransceiverWakeupModeApi API
      integer EthTrcvIndex: 0..255, set at pre-compile, default-value=0  # Specifies the InstanceId of this module instance. If only one instance is present it shall have the Id 0.
      integer EthTrcvLinkStatusWaitCountTicks: 0..4294967295, origin=Texas Instruments, set at pre-compile, default-value=80000  # Wait for link status to become up after configuration
      float EthTrcvMainFunctionPeriod [0..1]: 0.0..INF, multiplicity set at pre-compile, set at pre-compile, default-value=10.0  # Specifies the period of main function EthTrcv_MainFunction in seconds.
      integer EthTrcvMaxControllersSupported: 0..2, origin=Texas Instruments, set at pre-compile, default-value=1
      integer EthTrcvMaxTrcvConfigSupported: 0..2, origin=Texas Instruments, set at pre-compile, default-value=1  # Maximum number of configurations supported. The config Index passed to EthTrcv APIs should be less than this value.
      integer EthTrcvMaxTrcvsSupported: 0..255, set at pre-compile, default-value=1
      boolean EthTrcvSetPhyTestModeApi: set at pre-compile, default-value=true  # Enables / Disables EthTrcv_SetPhyTestMode API.
      boolean EthTrcv1000Mbps_speed [0..1]: origin=Texas Instruments, set at pre-compile, default-value=true  # Enables / Disables EthTrcv1000Mbps_speed.
      boolean EthTrcvSetPhyTxModeApi: set at pre-compile, default-value=false  # Enables / Disables EthTrcv_SetPhyTxMode API.
      boolean EthTrcvSetTransceiverModeApi: set at pre-compile, default-value=true  # Enables / Disables EthTrcv_SetTransceiverMode API
      boolean EthTrcvStartAutoNegotiationApi: set at pre-compile, default-value=true  # Enables / Disables EthTrcv_StartAutoNegotiation API
      boolean EthTrcvVersionInfoApi: set at pre-compile, default-value=false  # Enables / Disables version info API
      boolean EthTrcvVersionInfoApiMacro: set at pre-compile, default-value=false  # Enables / Disables version info API macro implementation
      enumeration EthTrcvWakeUpSupport: {ETHTRCV_WAKEUP_BY_INTERRUPT, ETHTRCV_WAKEUP_BY_POLLING, ETHTRCV_WAKEUP_NOT_SUPPORTED}, set at pre-compile, default-value=ETHTRCV_WAKEUP_NOT_SUPPORTED  # Configures wake-up to polling or interrupt or to not used/not supported. In case no wake up is supported by the hardware, the BSWMD pre-configuration shall be set to ETHTRCV_WAKEUP_NOT_SUPPORTED.
      integer EthTrcvDefaultOSCounterId [0..1]: 0..16, multiplicity set at pre-compile, origin=Texas Instruments, set at pre-compile, default-value=0  # Default Os Counter Id if node reference to OsCounter ref EthTrcvOsCounterRef is not set
      integer EthTrcvTimeoutDuration: 1..4294967295, origin=Texas Instruments, set at pre-compile, default-value=160000  # ETHTRCV timeout - used in ETHTRCV busy wait. Unit is in clock ticks. Configure the timeout according to r5f clock frequency(400MHz/200MHz)
      enumeration EthTrcvInternalLoopbackMode: {ETHTRCV_PHYLOOPBACK_INTERNAL_ANALOG, ETHTRCV_PHYLOOPBACK_INTERNAL_DIGITAL}, origin=Texas Instruments, set at pre-compile, default-value=ETHTRCV_PHYLOOPBACK_INTERNAL_ANALOG  # Configures Internal Loopback mode to Analog or Digital.
      reference EthTrcvOsCounterRef [0..1]: multiplicity set at pre-compile, origin=Texas Instruments, set at pre-compile, destination=OsCounter  # This parameter contains a reference to the OsCounter, which is used by the ETHTRCV driver.
    container EthTrcvPublishedInformation  # Additional published parameters not covered by "Common" Published Information. Note that these parameters have "PUBLISHED-INFORMATION" configuration class setting, since they are published information.
      enumeration EthTrcvDeviceVariant [0..1]: {AM263Px}, origin=Texas Instruments, set at published-information, default-value=AM263Px  # Select SOC variant .This parameter shall be used by driver to impose device specific constraints. The user guide shall detail the device specific constraints
