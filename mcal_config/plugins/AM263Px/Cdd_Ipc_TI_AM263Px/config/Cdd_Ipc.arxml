AUTOSAR XML (schema 00044)
package /TI_AM263Px
  module definition Cdd_Ipc [0..*]: refined-module-def=Cdd, variants post-build  # Configuration of the CDD(Complex device driver) IPC module.
    container CddIpcDriver  # This container contains the configuration parameters and sub containers of the AUTOSAR Complex device driver(CDD) module.
      enumeration CddIpcLocalCoreId: {CDD_IPC_R5FSS0_0_ID, CDD_IPC_R5FSS0_1_ID, CDD_IPC_R5FSS1_0_ID, CDD_IPC_R5FSS1_1_ID}, origin=Texas Instruments, set at post-build, default-value=CDD_IPC_R5FSS0_0_ID  # This param contains the local coreId on which the IPC instance is running.
      container CddIpcRemoteCoreList [1..3]  # Refers to the list of coreId that are valid for the particular platform.
        enumeration CddIpcRemoteCoreIdIndex: {CDD_IPC_R5FSS0_0_ID, CDD_IPC_R5FSS0_1_ID, CDD_IPC_R5FSS1_0_ID, CDD_IPC_R5FSS1_1_ID}, origin=Texas Instruments, set at post-build, default-value=CDD_IPC_R5FSS0_0_ID  # The cores that are participating the IPC message exchange (Exclude the local core from these)
        boolean CddIpcSafeIpcCoresEnable [0..1]: multiplicity set at pre-compile, origin=Texas Instruments, set at pre-compile, default-value=false  # Switch to enable Safe Ipc between local and remote core.
      container CddIpcEndPtConfig [0..63]  # This is required only in case of RpMsg is being used. To enable this make sure the CddIpcRpMsgEnable box is enabled.
        integer CddIpcLocalEndPt [0..1]: 0..63, multiplicity set at post-build, origin=Texas Instruments, set at post-build, default-value=12  # This parameter is used to register a local call back especially for receiving or sending a RPMsg message
        function name CddIpcRecvCallBack [0..1]: multiplicity set at post-build, origin=Texas Instruments, set at post-build, default-value=NULL_PTR  # Function pointer to RPMSG callback function
        function name CddIpcrecvCallbackArguments [0..1]: multiplicity set at post-build, origin=Texas Instruments, set at post-build, default-value=NULL_PTR  # Function Pointer to recv callback function's arguments
        function name CddIpcrecvNotifyCallback [0..1]: multiplicity set at post-build, origin=Texas Instruments, set at post-build, default-value=NULL_PTR  # Function pointer to IPC notify message Callback function. User can pass a pointer to a custom defined arguments structure and the callback passes this pointer when a notify interrupt is received
        function name CddIpcrecvNotifyCallbackArguments [0..1]: multiplicity set at post-build, origin=Texas Instruments, set at post-build, default-value=NULL_PTR  # Pointer to IPC notify message callback function's arguments
    container CddIpcGeneral  # General configuration settings for Complex device driver
      boolean CddVersionInfoApi: origin=Texas Instruments, set at post-build, default-value=true  # Switches the Cdd_IpcGetVersionInfo function ON or OFF.
      boolean CddDeinitApi: origin=Texas Instruments, set at post-build, default-value=true  # Switches the Cdd_IpcDeinit function ON or OFF.
      boolean CddIpcWriteApi: origin=Texas Instruments, set at post-build, default-value=true  # Switches the Cdd_IpcWrite function ON or OFF.
      boolean CddIpcReadApi: origin=Texas Instruments, set at post-build, default-value=true  # Switches the Cdd_IpcRead function ON or OFF.
      boolean CddIpcRpMsgEnable: origin=Texas Instruments, set at post-build, default-value=true  # Switch to enable RpMsg API's to be enabled or not.
      boolean CddIpcRecvCallBackEnable [0..1]: multiplicity set at post-build, origin=Texas Instruments, set at post-build, default-value=true  # Switch to Enable RPMsg Recv Callback (This is different from Notify Callback).
      boolean CddIpcRecvNotifyCallbackEnable [0..1]: multiplicity set at post-build, origin=Texas Instruments, set at post-build, default-value=false  # Switch to enable RPMsg Notify message Recv Callback.
      boolean CddRegisterReadBackApi: origin=Texas Instruments, set at post-build, default-value=true  # Switches the Cdd_IpcRegisterReadBack function ON or OFF.
      boolean CddDevErrorDetect: origin=Texas Instruments, set at post-build, default-value=true  # Switches the Development Error Detection and Notification ON or OFF.
      boolean CddIpcSafeIpcEnable: origin=Texas Instruments, set at pre-compile, default-value=false  # Switch to enable Safe Ipc to be enabled or not.
      boolean CddIpcCrcEnable: origin=Texas Instruments, set at pre-compile, default-value=false  # Switch to enable Crc to be enabled or not.
      function name CddIpcCrcHookFunc [0..1]: multiplicity set at post-build, origin=Texas Instruments, set at post-build, default-value=NULL_PTR  # Hook function in application for Crc Calculation
      enumeration CddIrqType: {CDD_IPC_ISR_VOID, CDD_IPC_ISR_CAT1, CDD_IPC_ISR_CAT2}, origin=Texas Instruments, set at post-build, default-value=CDD_IPC_ISR_VOID  # Type of Isr function: void functionname(void) CAT1 : interrupt void func(void) CAT2 : ISR(func)
      integer CddIpcTimeout: 0..2147483648, origin=Texas Instruments, set at post-build, default-value=2000000  # Timeout value for send/receive/wait API's. Unit is in clock ticks
      integer CddIpcNumOfBuffers: origin=Texas Instruments, set at post-build, default-value=8  # This parameter indicates the number of buffers for sending RPMsg
      integer CddIpcMaxBufferSize: origin=Texas Instruments, set at post-build, default-value=128  # This parameter indicates the Max size of each buffer. Note that the actual size available is 16 bytes less than the above chosen value (16 bytes are used for the header in RPMsg)
      integer CddDefaultOSCounterId [0..1]: 0..16, multiplicity set at post-build, origin=Texas Instruments, set at post-build, default-value=0  # Default Os Counter Id if node reference to OsCounter ref CddOsCounterRef is not set
      reference CddOsCounterRef [0..1]: multiplicity set at post-build, origin=Texas Instruments, set at post-build, destination=OsCounter  # This parameter contains a reference to the OsCounter, which is used by the GPT driver.
    container CddPublishedInformation  # Container holding all Complex driver specific published information parameters
      enumeration CddDeviceVariant: {AM263PX}, origin=Texas Instruments, set at post-build, default-value=AM263PX  # Device variant AM263PX
