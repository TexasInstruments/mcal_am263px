AUTOSAR XML (schema 00044)
package /TI_AM263Px
  module definition Adc [0..1]: post-build-variant-support=true, refined-module-def=Adc, variants post-build/pre-compile  # Configuration of the Adc (Analog Digital Conversion) module.
    container AdcConfigSet  # This container contains the configuration parameters and sub containers of the AUTOSAR Adc module.
      container AdcHwUnit [1..*]  # This container contains the Driver configuration (parameters) depending on grouping of channels
        enumeration AdcClockSource [0..1]: {NONE}, multiplicity set at post-build in variant post-build / pre-compile in variant pre-compile, post-build-variant-multiplicity=true, post-build-variant-value=true, set at post-build in variant post-build / pre-compile in variant pre-compile, default-value=NONE  # The ADC module specific clock input for the conversion unit can statically be configured to select different clock sources if provided by hardware. Enumeration literals are defined vendor specific.
        enumeration AdcHwUnitId: {ADC_HWUNIT_0, ADC_HWUNIT_1, ADC_HWUNIT_2, ADC_HWUNIT_3, ADC_HWUNIT_4, ADC_HWUNIT_5, ADC_HWUNIT_6}, post-build-variant-value=true, set at post-build in variant post-build / pre-compile in variant pre-compile, default-value=ADC_HWUNIT_0  # Description: Numeric ID of the HW Unit. This symbolic name allows accessing Hw Unit data. Enumeration literals are defined vendor specific. Number of instances can vary depending on SOC variant.Corresponding error checks are added in template files
        enumeration AdcHwUnitResolution: {ADC_RESOLUTION_12BIT}, origin=Texas Instrument, post-build-variant-value=true, set at post-build in variant post-build / pre-compile in variant pre-compile, default-value=ADC_RESOLUTION_12BIT  # Description: ADC Resolution of Hardware unit.
        integer AdcPrescale [0..1]: 0..65535, multiplicity set at post-build in variant post-build / pre-compile in variant pre-compile, post-build-variant-multiplicity=true, post-build-variant-value=true, set at post-build in variant post-build / pre-compile in variant pre-compile  # Optional ADC module specific clock prescale factor, if supported by hardware.
        enumeration AdcHwPrescale [0..1]: {ADC_CLK_DIV_1_0, ADC_CLK_DIV_2_0, ADC_CLK_DIV_2_5, ADC_CLK_DIV_3_0, ADC_CLK_DIV_3_5, ADC_CLK_DIV_4_0, ADC_CLK_DIV_4_5, ADC_CLK_DIV_5_0, ADC_CLK_DIV_5_5, ADC_CLK_DIV_6_0, ADC_CLK_DIV_6_5, ADC_CLK_DIV_7_0, ADC_CLK_DIV_7_5, ADC_CLK_DIV_8_0, ADC_CLK_DIV_8_5}, multiplicity set at post-build in variant post-build / pre-compile in variant pre-compile, origin=Texas Instrument, post-build-variant-value=true, set at post-build in variant post-build / pre-compile in variant pre-compile, default-value=ADC_CLK_DIV_1_0  # Optional ADC module specific clock prescale factor, if supported by hardware.
        container AdcChannel [1..6]  # This container contains the channel configuration (parameters) depending on the hardware capability.
          integer AdcChannelConvTime [0..1]: 0..4294967295, multiplicity set at post-build in variant post-build / pre-compile in variant pre-compile, post-build-variant-multiplicity=true, post-build-variant-value=true, set at post-build in variant post-build / pre-compile in variant pre-compile  # Configuration of conversion time, i.e. the time during which the analogue value is converted into digital representation, (in clock cycles) for each channel, if supported by hardware.
          integer AdcChannelId: 0..5, post-build-variant-value=true, set at post-build in variant post-build / pre-compile in variant pre-compile, default-value=0  # This parameter defines the assignment of the channel to the physical ADC hardware channel.
          integer AdcChannelResolution [0..1]: 1..63, multiplicity set at post-build in variant post-build / pre-compile in variant pre-compile, post-build-variant-multiplicity=true, post-build-variant-value=true, set at post-build in variant post-build / pre-compile in variant pre-compile, default-value=12  # Channel resolution in bits.
          boolean AdcChannelLimitCheck [0..1]: multiplicity set at pre-compile, set at pre-compile  # Enables or disables limit checking for an ADC channel.
          integer AdcChannelHighLimit [0..1]: 0..4095, multiplicity set at pre-compile, set at pre-compile, default-value=4095  # High limit - used for limit checking.
          integer AdcChannelLowLimit [0..1]: 0..4096, multiplicity set at pre-compile, set at pre-compile, default-value=0  # Low limit - used for limit checking.
          enumeration AdcChannelRangeSelect [0..1]: {ADC_RANGE_ALWAYS, ADC_RANGE_BETWEEN, ADC_RANGE_NOT_BETWEEN, ADC_RANGE_NOT_OVER_HIGH, ADC_RANGE_NOT_UNDER_LOW, ADC_RANGE_OVER_HIGH, ADC_RANGE_UNDER_LOW}, multiplicity set at pre-compile, set at pre-compile, default-value=ADC_RANGE_ALWAYS  # In case of active limit checking: defines which conversion values are taken into account related to the boarders defined with AdcChannelLowLimit and AdcChannelHighLimit.
          enumeration AdcChannelRefVoltsrcHigh [0..1]: {NONE}, multiplicity set at post-build in variant post-build / pre-compile in variant pre-compile, post-build-variant-multiplicity=true, post-build-variant-value=true, set at post-build in variant post-build / pre-compile in variant pre-compile, default-value=NONE  # Upper reference voltage source for each channel.
          enumeration AdcChannelRefVoltsrcLow [0..1]: {NONE}, multiplicity set at post-build in variant post-build / pre-compile in variant pre-compile, post-build-variant-multiplicity=true, post-build-variant-value=true, set at post-build in variant post-build / pre-compile in variant pre-compile, default-value=NONE  # Lower reference voltage source for each channel.
          integer AdcChannelSampTime [0..1]: 0..4294967295, multiplicity set at post-build in variant post-build / pre-compile in variant pre-compile, post-build-variant-multiplicity=true, post-build-variant-value=true, set at post-build in variant post-build / pre-compile in variant pre-compile  # Configuration of sampling time, i.e. the time during which the value is sampled, (in clock cycles) for each channel, if supported by hardware.
          integer AdcChannelSampleWindow [0..1]: 1..512, multiplicity set at post-build in variant post-build / pre-compile in variant pre-compile, origin=Texas Instruments, post-build-variant-multiplicity=true, post-build-variant-value=true, set at post-build in variant post-build / pre-compile in variant pre-compile  # The sampleWindow parameter is the acquisition window duration in SYSCLK cycles. It should be a value between 1 and 512 cycles inclusive. The selected duration must be at least as long as one ADCCLK cycle. Also, the datasheet will specify a minimum window duration requirement in nanoseconds.
        container AdcGroup [1..1024]  # This container contains the Group configuration (parameters).
          enumeration AdcGroupAccessMode: {ADC_ACCESS_MODE_SINGLE, ADC_ACCESS_MODE_STREAMING}, post-build-variant-value=true, set at post-build in variant post-build / pre-compile in variant pre-compile, default-value=ADC_ACCESS_MODE_SINGLE  # Type of access mode to group conversion results.
          enumeration AdcGroupConversionMode: {ADC_CONV_MODE_CONTINUOUS, ADC_CONV_MODE_ONESHOT}, post-build-variant-value=true, set at post-build in variant post-build / pre-compile in variant pre-compile, default-value=ADC_CONV_MODE_CONTINUOUS  # Type of conversion mode supported by the driver.
          integer AdcGroupId: 0..1023, set at pre-compile, symbolic-name-value=true  # Numeric ID of the group. This parameter is the symbolic name to be used on the API. This symbolic name allows accessing Channel Group data. This value will be assigned to the symbolic name derived of the AdcGroup container shortName.This parameter is calculated internally
          integer AdcGroupPriority [0..1]: 0..255, multiplicity set at post-build in variant post-build / pre-compile in variant pre-compile, post-build-variant-multiplicity=true, post-build-variant-value=true, set at post-build in variant post-build / pre-compile in variant pre-compile, default-value=0  # Priority level of the AdcGroup.
          enumeration AdcGroupDataAccessMethod [0..1]: {ADC_GROUP_INTERRUPT_ACCESS, ADC_GROUP_POLLING_ACCESS, ADC_GROUP_DMA_ACCESS}, multiplicity set at post-build in variant post-build / pre-compile in variant pre-compile, origin=Texas Instrument, post-build-variant-multiplicity=true, post-build-variant-value=true, set at post-build in variant post-build / pre-compile in variant pre-compile, default-value=ADC_GROUP_INTERRUPT_ACCESS  # Replacement mechanism, which is used on ADC group level, if a group conversion is interrupted by a group which has a higher priority.
          enumeration AdcGroupReplacement [0..1]: {ADC_GROUP_REPL_ABORT_RESTART, ADC_GROUP_REPL_SUSPEND_RESUME}, multiplicity set at post-build in variant post-build / pre-compile in variant pre-compile, post-build-variant-multiplicity=true, post-build-variant-value=true, set at post-build in variant post-build / pre-compile in variant pre-compile, default-value=ADC_GROUP_REPL_SUSPEND_RESUME  # Replacement mechanism, which is used on ADC group level, if a group conversion is interrupted by a group which has a higher priority.
          enumeration AdcGroupTriggSrc: {ADC_TRIGG_SRC_HW, ADC_TRIGG_SRC_SW}, post-build-variant-value=true, set at post-build in variant post-build / pre-compile in variant pre-compile, default-value=ADC_TRIGG_SRC_SW  # Type of source event that starts a group conversion.
          enumeration AdcHwTrigSignal [0..1]: {ADC_HW_TRIG_BOTH_EDGES, ADC_HW_TRIG_FALLING_EDGE, ADC_HW_TRIG_RISING_EDGE}, multiplicity set at post-build in variant post-build / pre-compile in variant pre-compile, post-build-variant-multiplicity=true, post-build-variant-value=true, set at post-build in variant post-build / pre-compile in variant pre-compile  # Configures on which edge of the hardware trigger signal the driver should react, i.e. start the conversion (only if supported by the ADC hardware).
          integer AdcHwTrigTimer [0..1]: 0..4294967295, multiplicity set at post-build in variant post-build / pre-compile in variant pre-compile, post-build-variant-multiplicity=true, post-build-variant-value=true, set at post-build in variant post-build / pre-compile in variant pre-compile  # Reload value of the ADC module embedded timer (only if supported by ADC hardware).
          enumeration AdcExtHwTrigTimer: {ADC_TRIGGER_RTI0, ADC_TRIGGER_RTI1, ADC_TRIGGER_RTI2, ADC_TRIGGER_RTI3, ADC_TRIGGER_INPUT_XBAR_OUT5, ADC_TRIGGER_EPWM0_SOCA, ADC_TRIGGER_EPWM0_SOCB, ADC_TRIGGER_EPWM1_SOCA, ADC_TRIGGER_EPWM1_SOCB, ADC_TRIGGER_EPWM2_SOCA, ADC_TRIGGER_EPWM2_SOCB, ADC_TRIGGER_EPWM3_SOCA, ADC_TRIGGER_EPWM3_SOCB, ADC_TRIGGER_EPWM4_SOCA, ADC_TRIGGER_EPWM4_SOCB, ADC_TRIGGER_EPWM5_SOCA, ADC_TRIGGER_EPWM5_SOCB, ADC_TRIGGER_EPWM6_SOCA, ADC_TRIGGER_EPWM6_SOCB, ADC_TRIGGER_EPWM7_SOCA, ADC_TRIGGER_EPWM7_SOCB, ADC_TRIGGER_EPWM8_SOCA, ADC_TRIGGER_EPWM8_SOCB, ADC_TRIGGER_EPWM9_SOCA, ADC_TRIGGER_EPWM9_SOCB, ADC_TRIGGER_EPWM10_SOCA, ADC_TRIGGER_EPWM10_SOCB, ADC_TRIGGER_EPWM11_SOCA, ADC_TRIGGER_EPWM11_SOCB, ADC_TRIGGER_EPWM12_SOCA, ADC_TRIGGER_EPWM12_SOCB, ADC_TRIGGER_EPWM13_SOCA, ADC_TRIGGER_EPWM13_SOCB, ADC_TRIGGER_EPWM14_SOCA, ADC_TRIGGER_EPWM14_SOCB, ADC_TRIGGER_EPWM15_SOCA, ADC_TRIGGER_EPWM15_SOCB, ADC_TRIGGER_EPWM16_SOCA, ADC_TRIGGER_EPWM16_SOCB, ADC_TRIGGER_EPWM17_SOCA, ADC_TRIGGER_EPWM17_SOCB, ADC_TRIGGER_EPWM18_SOCA, ADC_TRIGGER_EPWM18_SOCB, ADC_TRIGGER_EPWM19_SOCA, ADC_TRIGGER_EPWM19_SOCB, ADC_TRIGGER_EPWM20_SOCA, ADC_TRIGGER_EPWM20_SOCB, ADC_TRIGGER_EPWM21_SOCA, ADC_TRIGGER_EPWM21_SOCB, ADC_TRIGGER_EPWM22_SOCA, ADC_TRIGGER_EPWM22_SOCB, ADC_TRIGGER_EPWM23_SOCA, ADC_TRIGGER_EPWM23_SOCB, ADC_TRIGGER_EPWM24_SOCA, ADC_TRIGGER_EPWM24_SOCB, ADC_TRIGGER_EPWM25_SOCA, ADC_TRIGGER_EPWM25_SOCB, ADC_TRIGGER_EPWM26_SOCA, ADC_TRIGGER_EPWM26_SOCB, ADC_TRIGGER_EPWM27_SOCA, ADC_TRIGGER_EPWM27_SOCB, ADC_TRIGGER_EPWM28_SOCA, ADC_TRIGGER_EPWM28_SOCB, ADC_TRIGGER_EPWM29_SOCA, ADC_TRIGGER_EPWM29_SOCB, ADC_TRIGGER_EPWM30_SOCA, ADC_TRIGGER_EPWM30_SOCB, ADC_TRIGGER_EPWM31_SOCA, ADC_TRIGGER_EPWM31_SOCB, ADC_TRIGGER_ECAP0, ADC_TRIGGER_ECAP1, ADC_TRIGGER_ECAP2, ADC_TRIGGER_ECAP3, ADC_TRIGGER_ECAP4, ADC_TRIGGER_ECAP5, ADC_TRIGGER_ECAP6, ADC_TRIGGER_ECAP7, ADC_TRIGGER_ECAP8, ADC_TRIGGER_ECAP9}, origin=Texas Instrument, post-build-variant-value=true, set at post-build in variant post-build / pre-compile in variant pre-compile, default-value=ADC_TRIGGER_EPWM0_SOCA  # Configure streaming buffer as "linear buffer" (i.e. the ADC Driver stops the conversion as soon as the stream buffer is full) or as "ring buffer" (wraps around if the end of the stream buffer is reached).
          function name AdcNotification [0..1]: multiplicity set at post-build in variant post-build / pre-compile in variant pre-compile, post-build-variant-multiplicity=true, post-build-variant-value=true, set at post-build in variant post-build / pre-compile in variant pre-compile, default-value=NULL_PTR  # Callback function for each group
          enumeration AdcStreamingBufferMode: {ADC_STREAM_BUFFER_CIRCULAR, ADC_STREAM_BUFFER_LINEAR}, post-build-variant-value=true, set at post-build in variant post-build / pre-compile in variant pre-compile, default-value=ADC_STREAM_BUFFER_LINEAR  # Configure streaming buffer as "linear buffer" (i.e. the ADC Driver stops the conversion as soon as the stream buffer is full) or as "ring buffer" (wraps around if the end of the stream buffer is reached).
          integer AdcStreamingNumSamples: 1..255, post-build-variant-value=true, set at post-build in variant post-build / pre-compile in variant pre-compile, default-value=1  # Number of ADC values to be acquired per channel in streaming access mode.
          reference AdcDmaReference [0..1]: multiplicity set at post-build in variant post-build / pre-compile in variant pre-compile, origin=Texas Instruments, set at post-build in variant post-build / pre-compile in variant pre-compile, destination=CddDmaDriverHandler  # Reference to the DMA Group Channel
          reference AdcGroupDefinition [1..6]: multiplicity set at post-build in variant post-build / pre-compile in variant pre-compile, post-build-variant-multiplicity=true, post-build-variant-value=true, set at post-build in variant post-build / pre-compile in variant pre-compile, destination=AdcChannel  # Assignment of AdcChannels to a AdcGroups.
    container AdcGeneral  # General configuration (parameters) of the ADC Driver software module.
      boolean AdcDeInitApi: set at pre-compile, default-value=true  # Adds / removes the service Adc_DeInit() from the code.
      boolean AdcDevErrorDetect: set at pre-compile, default-value=true  # Switches the development error detection and notification on or off.
      boolean AdcEnableLimitCheck: set at pre-compile, default-value=false  # Enables or disables limit checking feature in the ADC driver.
      boolean AdcEnableQueuing: set at pre-compile, default-value=true  # Determines, if the queuing mechanism is active in case of priority mechanism disabled.
      boolean AdcEnableStartStopGroupApi: set at pre-compile, default-value=true  # Adds / removes the services Adc_StartGroupConversion() and Adc_StopGroupConversion() from the code.
      integer AdcMaxDmaChannelId: origin=Texas Instruments, set at published-information, default-value=63  # Number of actual DMA channels. This is of type published information and not editable
      integer AdcDmaInstance: origin=Texas Instruments, set at published-information, default-value=0  # Number of actual DMA channels. This is of type published information and not editable
      boolean AdcGrpNotifCapability: set at pre-compile, default-value=true  # Determines, if the group notification mechanism (the functions to enable and disable the notifications) is available at runtime.
      boolean AdcHwTriggerApi: set at pre-compile, default-value=false  # Adds / removes the services Adc_EnableHardwareTrigger() and Adc_DisableHardwareTrigger() from the code.
      boolean AdcLowPowerStatesSupport [0..1]: multiplicity set at pre-compile, set at pre-compile, default-value=false  # Adds / removes all power state management related APIs (ADC_SetPowerState, ADC_GetCurrentPowerState, ADC_GetTargetPowerState, ADC_PreparePowerState, ADC_Main_PowerTransitionManager), indicating if the HW offers low power state management.
      boolean AdcPowerStateAsynchTransitionMode [0..1]: multiplicity set at pre-compile, set at pre-compile, default-value=false  # Enables / disables support of the ADCDriver to the asynchronous power state transition.
      enumeration AdcPriorityImplementation: {ADC_PRIORITY_HW, ADC_PRIORITY_HW_SW, ADC_PRIORITY_NONE}, set at pre-compile, default-value=ADC_PRIORITY_HW_SW  # Determines whether a priority mechanism is available for prioritization of the conversion requests and if available, the type of prioritization mechanism. The selection applies for groups with trigger source software and trigger source hardware. Two
      boolean AdcReadGroupApi: set at pre-compile, default-value=true  # Adds / removes the service Adc_ReadGroup() and from the code.
      enumeration AdcResultAlignment: {ADC_ALIGN_LEFT, ADC_ALIGN_RIGHT}, set at pre-compile, default-value=ADC_ALIGN_RIGHT  # Alignment of ADC raw results in ADC result buffer (left/right alignment).
      boolean AdcVersionInfoApi: set at pre-compile, default-value=true  # Adds / removes the service Adc_GetVersionInfo() from the code.
      boolean AdcReadTemperatureApi [0..0]: origin=Texas Instruments, set at pre-compile, default-value=false  # Adds / removes the service AdcReadTemperatureApi() from the code.
      boolean AdcGroupLog: origin=Texas Instruments, set at pre-compile, default-value=true  # Enables/Disables ADC Group logging.Useful in debugging
      boolean AdcErrorLog: origin=Texas Instruments, set at pre-compile, default-value=true  # Enables/Disables ADC Group Error logging.Useful in debugging
      integer AdcGroupLogMaxLen: 0..1024, origin=Texas Instruments, set at pre-compile, default-value=100  # Maximum length of Group log buffer that can be used
      boolean AdcFifoErrLog: origin=Texas Instruments, set at pre-compile, default-value=true  # Enables/Disables ADC Fifo error logging.Useful in debugging
      integer AdcErrLogMaxLen: 0..1024, origin=Texas Instruments, set at pre-compile, default-value=100  # Max length of error log buffer that can be used
      integer AdcDefaultOSCounterId: 0..16, origin=Texas Instruments, set at pre-compile, default-value=0  # Default Os Counter Id if node reference to OsCounter ref AdcOsCounterRef is not set
      integer AdcMaxGroupCount: 1..1024, origin=Texas Instruments, set at pre-compile, default-value=10  # Maximum group count across all hwunits configured
      integer AdcMaxChannelCount: 1..15, origin=Texas Instruments, set at pre-compile, default-value=10  # Maximum Channels count across all hwunits configured
      integer AdcMaxHwUnitCount: 1..7, origin=Texas Instruments, set at pre-compile, default-value=7  # Maximum HW unit count - This should match the sum of the units of ISR
      boolean AdcHwUnitActive [0..0]: origin=Texas Instruments, set at pre-compile, default-value=true  # Enables/Disable HW UNIT
      boolean AdcEnableRegisterReadbackApi: origin=Texas Instruments, set at pre-compile, default-value=true  # Enable API to readback ADC critical registers
      boolean AdcPollingMainFunctionApi: origin=Texas Instruments, set at pre-compile, default-value=false  # Enable API to do the polling operation
      enumeration AdcTypeofInterruptFunction: {ADC_ISR_VOID, ADC_ISR_CAT1, ADC_ISR_CAT2}, origin=Texas Instruments, set at pre-compile, default-value=ADC_ISR_CAT1  # Type of ISR function
      boolean AdcDMAEnable: origin=Texas Instruments, set at pre-compile, default-value=false  # Enables DMA Access method for ADC Channel Group.
      enumeration AdcDeviceVariant: {AM263Px}, origin=Texas Instruments, set at pre-compile, default-value=AM263Px  # Select SOC variant .This parameter shall be used by driver to impose device specific constraints. The user guide shall detail the device specific constraints
      reference AdcOsCounterRef [0..1]: origin=Texas Instruments, set at pre-compile, destination=OsCounter  # This parameter contains a reference to the OsCounter, which is used by the ADC driver.
      container AdcPowerStateConfig [0..*]  # Each instance of this parameter defines a power state and the callback to be called when this power state is reached.
        integer AdcPowerState [0..0]: 0..4294967295, set at pre-compile, symbolic-name-value=true  # Each instance of this parameter describes a different power state supported by the ADC HW. It should be defined by the HW supplier and used by the ADCDriver to reference specific HW configurations which set the ADC HW module in the referenced power state.
        function name AdcPowerStateReadyCbkRef [0..0]: set at pre-compile  # Each instance of this parameter contains a reference to a power mode callback defined in a CDD or IoHwAbs component.
    container AdcPublishedInformation  # Additional published parameters not covered by "Common" Published Information. Note that these parameters have "PUBLISHED-INFORMATION" configuration class setting, since they are published information.
      boolean AdcChannelValueSigned: set at published-information, default-value=false  # Information whether the result value of the ADC driver has sign information (true) or not (false). If the result shall be interpreted as signed value it shall apply to C-language rules.
      boolean AdcGroupFirstChannelFixed: set at published-information, default-value=false  # Information whether the first channel of an ADC Channel group can be configured (false) or is fixed (true) to a value determined by the ADC HW Unit.
      integer AdcMaxChannelResolution: 1..63, set at published-information, default-value=12  # Maximum Channel resolution in bits (does not specify accuracy).
      integer AdcMinRange: origin=Texas Instruments, set at published-information, default-value=0  # Minimum value of range for ADC sampled data. This is of type published information and not editable.
      integer AdcMaxNumChannels: origin=Texas Instruments, set at published-information, default-value=6  # Number of MCAL channels - in terms of ADC HW, this represents the number of hardware steps.This is a fixed value as per the ADC module and can't be changed. This is of type published information and not editable
      integer AdcMaxHwChannelId: origin=Texas Instruments, set at published-information, default-value=5  # Number of actual HW channels - in terms of ADC HW the actual channel input to the ADC module. This is of type published information and not editable
      integer AdcMinHwChannelId: origin=Texas Instruments, set at published-information, default-value=0  # Number of actual HW channels - in terms of ADC HW the actual channel input to the ADC module. This is of type published information and not editable
