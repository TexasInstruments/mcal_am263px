AUTOSAR XML (schema 00044)
package /TI_AM263Px
  module definition Cdd_I2c [0..*]: refined-module-def=Cdd, variants pre-compile  # Configuration of the CDD(Complex device driver) I2C module.
    container I2cGeneral  # General configuration settings for Complex device driver
      boolean CddI2cDevErrorDetect: origin=Texas Instruments, set at pre-compile, default-value=true  # I2c Dev Error ON/OFF.
      boolean CddI2cUseInterrupts: origin=Texas Instruments, set at pre-compile, default-value=false  # Switches to activate or deactivate interrupt controlled job processing(ON/OFF).
      boolean CddI2cVersionInfoApi: origin=Texas Instruments, set at pre-compile, default-value=true  # Pre-processor switch to enable/disable the API to read out the modules version information.
      boolean CddI2cCancelCheck: origin=Texas Instruments, set at pre-compile, default-value=false  # Switches to activate or deactivate the Cancel channel transmission API(ON/OFF).
      boolean CddI2cStatusCheck: origin=Texas Instruments, set at pre-compile, default-value=false  # Switches to activate or deactivate Cdd_I2c_GetStatus API(ON/OFF).
      enumeration CddIrqType [0..1]: {CDD_I2C_ISR_VOID, CDD_I2C_ISR_CAT1, CDD_I2C_ISR_CAT2}, multiplicity set at pre-compile, origin=Texas Instruments, set at pre-compile, default-value=CDD_I2C_ISR_VOID  # Type of Isr function: void functionname(void) CAT1 : interrupt void func(void) CAT2 : ISR(func)
      integer CddI2cHwUnitsUsed: 1..4, origin=Texas Instruments, set at pre-compile, default-value=1  # Maximum number of I2c hardware units used
      boolean CddI2cEnableRegisterReadbackApi: origin=Texas Instruments, set at pre-compile, default-value=true  # Switch to indicate that the Cdd_I2c_RegisterReadBack is supported
      float CddI2cMainFunctionPeriod [0..1]: 0.0..INF, multiplicity set at pre-compile, origin=Texas Instruments, set at pre-compile, default-value=0.01  # This parameter describes the period for cyclic call to Cdd_I2c_MainFunction. Unit is seconds.
    container CddI2cHwConfig [1..4]: multiplicity set at pre-compile  # This container contains the HW unit initialization parameters
      enumeration CddI2cHwUnitType: {CDD_I2C_HW_UNIT_0, CDD_I2C_HW_UNIT_1, CDD_I2C_HW_UNIT_2, CDD_I2C_HW_UNIT_3}, origin=Texas Instruments, set at pre-compile, default-value=CDD_I2C_HW_UNIT_0  # I2c HW unit to use.
      enumeration CddI2cChannelBitRate: {CDD_I2C_100KHZ, CDD_I2C_400KHZ}, scope=ECU, origin=Texas Instruments, set at pre-compile, default-value=CDD_I2C_100KHZ  # Selection of Channel Bit Rate.
      integer CddI2cHwUnitFrequency: 6700000..13300000, scope=ECU, origin=Texas Instruments, set at pre-compile, default-value=8000000  # Frequency which the HW unit will utilize(Range = 6.7 MHz - 13.3 MHz), please note that this differs from the bus frequency used for communication
      integer CddI2cClkInputSrc: 0..4294967295, scope=ECU, origin=Texas Instruments, set at pre-compile, default-value=200000000  # Please ensure that the frequency used here should be the same as mcu clk settings for I2c, as this is required internally to calculate pre-scalar which is needed to set the bus frequency
      integer CddI2cOwnAddress: 0..1023, scope=ECU, origin=Texas Instruments, set at pre-compile, default-value=127  # Own address - used in both 7 and 10-bit address mode.
    container CddI2cChannelConfig [0..*]: multiplicity set at pre-compile  # This container contains the Channel configurations
      enumeration CddI2cChannelDirection: {CDD_I2C_WRITE, CDD_I2C_READ}, scope=ECU, origin=Texas Instruments, set at pre-compile, default-value=CDD_I2C_WRITE  # Selection of Channel direction.
      integer CddI2cChannelSlaveAddress: 0..65535, scope=ECU, origin=Texas Instruments, set at pre-compile, default-value=50  # Set slave address for channel
      enumeration I2cSlaveAddressScheme: {CDD_I2C_7_BIT_ADDRESS, CDD_I2C_10_BIT_ADDRESS}, scope=ECU, origin=Texas Instruments, set at pre-compile, default-value=CDD_I2C_7_BIT_ADDRESS  # Specifies whether channel is 7 bit or 10 bit.
    container CddI2cSequenceConfig [0..*]: multiplicity set at pre-compile  # This container contains the Sequence configurations
      enumeration CddI2cSequenceHwUnitType: {CDD_I2C_HW_UNIT_0, CDD_I2C_HW_UNIT_1, CDD_I2C_HW_UNIT_2, CDD_I2C_HW_UNIT_3}, origin=Texas Instruments, set at pre-compile, default-value=CDD_I2C_HW_UNIT_0  # I2c HW unit to use.
      integer CddI2cNumberOfChannelsInSequence: 1..255, scope=ECU, origin=Texas Instruments, set at pre-compile, default-value=1  # Set the number of channels in the sequence
      function name CddI2cSequenceCompleteNotify: origin=Texas Instruments, set at pre-compile, default-value=NULL_PTR  # Function pointer to callback function sequence complete notify
      function name CddI2cSequenceErrorNotify: origin=Texas Instruments, set at pre-compile, default-value=NULL_PTR  # Function pointer to callback function sequence complete notify
      enumeration CddI2cRestartModeType: {CDD_I2C_RESTART_MODE_STOP, CDD_I2C_RESTART_MODE_NOSTOP}, origin=Texas Instruments, set at pre-compile, default-value=CDD_I2C_RESTART_MODE_STOP  # I2c transfer mode.
      container I2cChannelList [1..*]: multiplicity set at pre-compile  # References to I2c channels and their order within the Sequence.
        integer I2cChannelIndex: 0..255, origin=Texas Instruments, set at pre-compile, default-value=0  # This parameter specifies the order of Channels within the Sequence.
        reference I2cChannelAssignment: origin=Texas Instruments, set at pre-compile, destination=CddI2cChannelConfig  # A Sequence reference to a I2c channel.
