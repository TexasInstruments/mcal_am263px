[part 2 of 2]
<AUTOSAR xmlns="http://autosar.org/schema/r4.0" xmlns:xsi="http://www.w3.org/2001/XMLSchema-instance" xsi:schemaLocation="http://autosar.org/schema/r4.0 AUTOSAR_00044.xsd">  (continued)
  <AR-PACKAGES>  (continued)
    <AR-PACKAGE UUID="7433391b-1e6c-4b89-b26c-f55aa54fa2ac">  (continued)
      <AR-PACKAGES>
        <AR-PACKAGE UUID="702bad5a-4a69-4ee3-a45f-eacecc0cdb3b">
          <SHORT-NAME>Pwm_ModuleEntry</SHORT-NAME>
          <ELEMENTS>
            <BSW-MODULE-ENTRY UUID="4135ef4f-a356-45bd-8a39-8c540ec8cfa6">
              <SHORT-NAME>Pwm_Ch0Isr</SHORT-NAME>
              <IS-REENTRANT>false</IS-REENTRANT>
              <IS-SYNCHRONOUS>true</IS-SYNCHRONOUS>
              <CALL-TYPE>INTERRUPT</CALL-TYPE>
              [!IF "as:modconf('Pwm')[1]/PwmGeneral/PwmTypeofInterruptFunction = 'PWM_ISR_CAT2'"!][!//
              <EXECUTION-CONTEXT>INTERRUPT-CAT-2</EXECUTION-CONTEXT>
              [!ELSE!][!//
              <EXECUTION-CONTEXT>INTERRUPT-CAT-1</EXECUTION-CONTEXT>
              [!ENDIF!][!//
              <SW-SERVICE-IMPL-POLICY>STANDARD</SW-SERVICE-IMPL-POLICY>
              <BSW-ENTRY-KIND>CONCRETE</BSW-ENTRY-KIND>
            </BSW-MODULE-ENTRY>
            <BSW-MODULE-ENTRY UUID="1df7969e-60e4-4d3c-bc4a-35596bb56a04">
              <SHORT-NAME>Pwm_Ch100Isr</SHORT-NAME>
              <IS-REENTRANT>false</IS-REENTRANT>
              <IS-SYNCHRONOUS>true</IS-SYNCHRONOUS>
              <CALL-TYPE>INTERRUPT</CALL-TYPE>
              [!IF "as:modconf('Pwm')[1]/PwmGeneral/PwmTypeofInterruptFunction = 'PWM_ISR_CAT2'"!][!//
              <EXECUTION-CONTEXT>INTERRUPT-CAT-2</EXECUTION-CONTEXT>
              [!ELSE!][!//
              <EXECUTION-CONTEXT>INTERRUPT-CAT-1</EXECUTION-CONTEXT>
              [!ENDIF!][!//
              <SW-SERVICE-IMPL-POLICY>STANDARD</SW-SERVICE-IMPL-POLICY>
              <BSW-ENTRY-KIND>CONCRETE</BSW-ENTRY-KIND>
            </BSW-MODULE-ENTRY>
            <BSW-MODULE-ENTRY UUID="2e6648e8-56a4-4818-ad6b-3b965339506c">
              <SHORT-NAME>Pwm_Ch101Isr</SHORT-NAME>
              <IS-REENTRANT>false</IS-REENTRANT>
              <IS-SYNCHRONOUS>true</IS-SYNCHRONOUS>
              <CALL-TYPE>INTERRUPT</CALL-TYPE>
              [!IF "as:modconf('Pwm')[1]/PwmGeneral/PwmTypeofInterruptFunction = 'PWM_ISR_CAT2'"!][!//
              <EXECUTION-CONTEXT>INTERRUPT-CAT-2</EXECUTION-CONTEXT>
              [!ELSE!][!//
              <EXECUTION-CONTEXT>INTERRUPT-CAT-1</EXECUTION-CONTEXT>
              [!ENDIF!][!//
              <SW-SERVICE-IMPL-POLICY>STANDARD</SW-SERVICE-IMPL-POLICY>
              <BSW-ENTRY-KIND>CONCRETE</BSW-ENTRY-KIND>
            </BSW-MODULE-ENTRY>
            <BSW-MODULE-ENTRY UUID="be309607-5990-49a8-bf9e-6d9fb06c0eb9">
              <SHORT-NAME>Pwm_Ch102Isr</SHORT-NAME>
              <IS-REENTRANT>false</IS-REENTRANT>
              <IS-SYNCHRONOUS>true</IS-SYNCHRONOUS>
              <CALL-TYPE>INTERRUPT</CALL-TYPE>
              [!IF "as:modconf('Pwm')[1]/PwmGeneral/PwmTypeofInterruptFunction = 'PWM_ISR_CAT2'"!][!//
              <EXECUTION-CONTEXT>INTERRUPT-CAT-2</EXECUTION-CONTEXT>
              [!ELSE!][!//
              <EXECUTION-CONTEXT>INTERRUPT-CAT-1</EXECUTION-CONTEXT>
              [!ENDIF!][!//
              <SW-SERVICE-IMPL-POLICY>STANDARD</SW-SERVICE-IMPL-POLICY>
              <BSW-ENTRY-KIND>CONCRETE</BSW-ENTRY-KIND>
            </BSW-MODULE-ENTRY>
            <BSW-MODULE-ENTRY UUID="52987845-b681-4ae6-a20a-33da05aaf731">
              <SHORT-NAME>Pwm_Ch103Isr</SHORT-NAME>
              <IS-REENTRANT>false</IS-REENTRANT>
              <IS-SYNCHRONOUS>true</IS-SYNCHRONOUS>
              <CALL-TYPE>INTERRUPT</CALL-TYPE>
              [!IF "as:modconf('Pwm')[1]/PwmGeneral/PwmTypeofInterruptFunction = 'PWM_ISR_CAT2'"!][!//
              <EXECUTION-CONTEXT>INTERRUPT-CAT-2</EXECUTION-CONTEXT>
              [!ELSE!][!//
              <EXECUTION-CONTEXT>INTERRUPT-CAT-1</EXECUTION-CONTEXT>
              [!ENDIF!][!//
              <SW-SERVICE-IMPL-POLICY>STANDARD</SW-SERVICE-IMPL-POLICY>
              <BSW-ENTRY-KIND>CONCRETE</BSW-ENTRY-KIND>
            </BSW-MODULE-ENTRY>
            <BSW-MODULE-ENTRY UUID="2fedec81-53a6-4e85-9dc4-66078bccb7f8">
              <SHORT-NAME>Pwm_Ch104Isr</SHORT-NAME>
              <IS-REENTRANT>false</IS-REENTRANT>
              <IS-SYNCHRONOUS>true</IS-SYNCHRONOUS>
              <CALL-TYPE>INTERRUPT</CALL-TYPE>
              [!IF "as:modconf('Pwm')[1]/PwmGeneral/PwmTypeofInterruptFunction = 'PWM_ISR_CAT2'"!][!//
              <EXECUTION-CONTEXT>INTERRUPT-CAT-2</EXECUTION-CONTEXT>
              [!ELSE!][!//
              <EXECUTION-CONTEXT>INTERRUPT-CAT-1</EXECUTION-CONTEXT>
              [!ENDIF!][!//
              <SW-SERVICE-IMPL-POLICY>STANDARD</SW-SERVICE-IMPL-POLICY>
              <BSW-ENTRY-KIND>CONCRETE</BSW-ENTRY-KIND>
            </BSW-MODULE-ENTRY>
            <BSW-MODULE-ENTRY UUID="6f811039-793a-480e-9ab9-dbc73ca0269c">
              <SHORT-NAME>Pwm_Ch105Isr</SHORT-NAME>
              <IS-REENTRANT>false</IS-REENTRANT>
              <IS-SYNCHRONOUS>true</IS-SYNCHRONOUS>
              <CALL-TYPE>INTERRUPT</CALL-TYPE>
              [!IF "as:modconf('Pwm')[1]/PwmGeneral/PwmTypeofInterruptFunction = 'PWM_ISR_CAT2'"!][!//
              <EXECUTION-CONTEXT>INTERRUPT-CAT-2</EXECUTION-CONTEXT>
              [!ELSE!][!//
              <EXECUTION-CONTEXT>INTERRUPT-CAT-1</EXECUTION-CONTEXT>
              [!ENDIF!][!//
              <SW-SERVICE-IMPL-POLICY>STANDARD</SW-SERVICE-IMPL-POLICY>
              <BSW-ENTRY-KIND>CONCRETE</BSW-ENTRY-KIND>
            </BSW-MODULE-ENTRY>
            <BSW-MODULE-ENTRY UUID="ad97c665-aa4a-4aaa-b365-fa2792dfcc84">
              <SHORT-NAME>Pwm_Ch106Isr</SHORT-NAME>
              <IS-REENTRANT>false</IS-REENTRANT>
              <IS-SYNCHRONOUS>true</IS-SYNCHRONOUS>
              <CALL-TYPE>INTERRUPT</CALL-TYPE>
              [!IF "as:modconf('Pwm')[1]/PwmGeneral/PwmTypeofInterruptFunction = 'PWM_ISR_CAT2'"!][!//
              <EXECUTION-CONTEXT>INTERRUPT-CAT-2</EXECUTION-CONTEXT>
              [!ELSE!][!//
              <EXECUTION-CONTEXT>INTERRUPT-CAT-1</EXECUTION-CONTEXT>
              [!ENDIF!][!//
              <SW-SERVICE-IMPL-POLICY>STANDARD</SW-SERVICE-IMPL-POLICY>
              <BSW-ENTRY-KIND>CONCRETE</BSW-ENTRY-KIND>
            </BSW-MODULE-ENTRY>
            <BSW-MODULE-ENTRY UUID="d7de6f0b-dec3-4ad0-9f4f-ee864736d004">
              <SHORT-NAME>Pwm_Ch107Isr</SHORT-NAME>
              <IS-REENTRANT>false</IS-REENTRANT>
              <IS-SYNCHRONOUS>true</IS-SYNCHRONOUS>
              <CALL-TYPE>INTERRUPT</CALL-TYPE>
              [!IF "as:modconf('Pwm')[1]/PwmGeneral/PwmTypeofInterruptFunction = 'PWM_ISR_CAT2'"!][!//
              <EXECUTION-CONTEXT>INTERRUPT-CAT-2</EXECUTION-CONTEXT>
              [!ELSE!][!//
              <EXECUTION-CONTEXT>INTERRUPT-CAT-1</EXECUTION-CONTEXT>
              [!ENDIF!][!//
              <SW-SERVICE-IMPL-POLICY>STANDARD</SW-SERVICE-IMPL-POLICY>
              <BSW-ENTRY-KIND>CONCRETE</BSW-ENTRY-KIND>
            </BSW-MODULE-ENTRY>
            <BSW-MODULE-ENTRY UUID="ad8193b9-0fd7-4123-a1bf-39b6ea8d3f11">
              <SHORT-NAME>Pwm_Ch108Isr</SHORT-NAME>
              <IS-REENTRANT>false</IS-REENTRANT>
              <IS-SYNCHRONOUS>true</IS-SYNCHRONOUS>
              <CALL-TYPE>INTERRUPT</CALL-TYPE>
              [!IF "as:modconf('Pwm')[1]/PwmGeneral/PwmTypeofInterruptFunction = 'PWM_ISR_CAT2'"!][!//
              <EXECUTION-CONTEXT>INTERRUPT-CAT-2</EXECUTION-CONTEXT>
              [!ELSE!][!//
              <EXECUTION-CONTEXT>INTERRUPT-CAT-1</EXECUTION-CONTEXT>
              [!ENDIF!][!//
              <SW-SERVICE-IMPL-POLICY>STANDARD</SW-SERVICE-IMPL-POLICY>
              <BSW-ENTRY-KIND>CONCRETE</BSW-ENTRY-KIND>
            </BSW-MODULE-ENTRY>
            <BSW-MODULE-ENTRY UUID="bc634cc7-2c11-4505-8a41-ad6cacedcf61">
              <SHORT-NAME>Pwm_Ch109Isr</SHORT-NAME>
              <IS-REENTRANT>false</IS-REENTRANT>
              <IS-SYNCHRONOUS>true</IS-SYNCHRONOUS>
              <CALL-TYPE>INTERRUPT</CALL-TYPE>
              [!IF "as:modconf('Pwm')[1]/PwmGeneral/PwmTypeofInterruptFunction = 'PWM_ISR_CAT2'"!][!//
              <EXECUTION-CONTEXT>INTERRUPT-CAT-2</EXECUTION-CONTEXT>
              [!ELSE!][!//
              <EXECUTION-CONTEXT>INTERRUPT-CAT-1</EXECUTION-CONTEXT>
              [!ENDIF!][!//
              <SW-SERVICE-IMPL-POLICY>STANDARD</SW-SERVICE-IMPL-POLICY>
              <BSW-ENTRY-KIND>CONCRETE</BSW-ENTRY-KIND>
            </BSW-MODULE-ENTRY>
            <BSW-MODULE-ENTRY UUID="c0945af3-ab2c-4ff7-83d0-54377b78613e">
              <SHORT-NAME>Pwm_Ch10Isr</SHORT-NAME>
              <IS-REENTRANT>false</IS-REENTRANT>
              <IS-SYNCHRONOUS>true</IS-SYNCHRONOUS>
              <CALL-TYPE>INTERRUPT</CALL-TYPE>
              [!IF "as:modconf('Pwm')[1]/PwmGeneral/PwmTypeofInterruptFunction = 'PWM_ISR_CAT2'"!][!//
              <EXECUTION-CONTEXT>INTERRUPT-CAT-2</EXECUTION-CONTEXT>
              [!ELSE!][!//
              <EXECUTION-CONTEXT>INTERRUPT-CAT-1</EXECUTION-CONTEXT>
              [!ENDIF!][!//
              <SW-SERVICE-IMPL-POLICY>STANDARD</SW-SERVICE-IMPL-POLICY>
              <BSW-ENTRY-KIND>CONCRETE</BSW-ENTRY-KIND>
            </BSW-MODULE-ENTRY>
            <BSW-MODULE-ENTRY UUID="a9e9864a-33bf-44de-84b7-61e80ed9a6b6">
              <SHORT-NAME>Pwm_Ch110Isr</SHORT-NAME>
              <IS-REENTRANT>false</IS-REENTRANT>
              <IS-SYNCHRONOUS>true</IS-SYNCHRONOUS>
              <CALL-TYPE>INTERRUPT</CALL-TYPE>
              [!IF "as:modconf('Pwm')[1]/PwmGeneral/PwmTypeofInterruptFunction = 'PWM_ISR_CAT2'"!][!//
              <EXECUTION-CONTEXT>INTERRUPT-CAT-2</EXECUTION-CONTEXT>
              [!ELSE!][!//
              <EXECUTION-CONTEXT>INTERRUPT-CAT-1</EXECUTION-CONTEXT>
              [!ENDIF!][!//
              <SW-SERVICE-IMPL-POLICY>STANDARD</SW-SERVICE-IMPL-POLICY>
              <BSW-ENTRY-KIND>CONCRETE</BSW-ENTRY-KIND>
            </BSW-MODULE-ENTRY>
            <BSW-MODULE-ENTRY UUID="2e026066-9a72-43c6-b128-fd3d519f51ca">
              <SHORT-NAME>Pwm_Ch111Isr</SHORT-NAME>
              <IS-REENTRANT>false</IS-REENTRANT>
              <IS-SYNCHRONOUS>true</IS-SYNCHRONOUS>
              <CALL-TYPE>INTERRUPT</CALL-TYPE>
              [!IF "as:modconf('Pwm')[1]/PwmGeneral/PwmTypeofInterruptFunction = 'PWM_ISR_CAT2'"!][!//
              <EXECUTION-CONTEXT>INTERRUPT-CAT-2</EXECUTION-CONTEXT>
              [!ELSE!][!//
              <EXECUTION-CONTEXT>INTERRUPT-CAT-1</EXECUTION-CONTEXT>
              [!ENDIF!][!//
              <SW-SERVICE-IMPL-POLICY>STANDARD</SW-SERVICE-IMPL-POLICY>
              <BSW-ENTRY-KIND>CONCRETE</BSW-ENTRY-KIND>
            </BSW-MODULE-ENTRY>
            <BSW-MODULE-ENTRY UUID="89c0c67d-508f-46c9-8e93-97d1c7c87eee">
              <SHORT-NAME>Pwm_Ch112Isr</SHORT-NAME>
              <IS-REENTRANT>false</IS-REENTRANT>
              <IS-SYNCHRONOUS>true</IS-SYNCHRONOUS>
              <CALL-TYPE>INTERRUPT</CALL-TYPE>
              [!IF "as:modconf('Pwm')[1]/PwmGeneral/PwmTypeofInterruptFunction = 'PWM_ISR_CAT2'"!][!//
              <EXECUTION-CONTEXT>INTERRUPT-CAT-2</EXECUTION-CONTEXT>
              [!ELSE!][!//
              <EXECUTION-CONTEXT>INTERRUPT-CAT-1</EXECUTION-CONTEXT>
              [!ENDIF!][!//
              <SW-SERVICE-IMPL-POLICY>STANDARD</SW-SERVICE-IMPL-POLICY>
              <BSW-ENTRY-KIND>CONCRETE</BSW-ENTRY-KIND>
            </BSW-MODULE-ENTRY>
            <BSW-MODULE-ENTRY UUID="86378c27-d2c4-4db3-a19a-4c6915400182">
              <SHORT-NAME>Pwm_Ch113Isr</SHORT-NAME>
              <IS-REENTRANT>false</IS-REENTRANT>
              <IS-SYNCHRONOUS>true</IS-SYNCHRONOUS>
              <CALL-TYPE>INTERRUPT</CALL-TYPE>
              [!IF "as:modconf('Pwm')[1]/PwmGeneral/PwmTypeofInterruptFunction = 'PWM_ISR_CAT2'"!][!//
              <EXECUTION-CONTEXT>INTERRUPT-CAT-2</EXECUTION-CONTEXT>
              [!ELSE!][!//
              <EXECUTION-CONTEXT>INTERRUPT-CAT-1</EXECUTION-CONTEXT>
              [!ENDIF!][!//
              <SW-SERVICE-IMPL-POLICY>STANDARD</SW-SERVICE-IMPL-POLICY>
              <BSW-ENTRY-KIND>CONCRETE</BSW-ENTRY-KIND>
            </BSW-MODULE-ENTRY>
            <BSW-MODULE-ENTRY UUID="73ca8508-40c8-4a20-aefc-7560423cd37d">
              <SHORT-NAME>Pwm_Ch114Isr</SHORT-NAME>
              <IS-REENTRANT>false</IS-REENTRANT>
              <IS-SYNCHRONOUS>true</IS-SYNCHRONOUS>
              <CALL-TYPE>INTERRUPT</CALL-TYPE>
              [!IF "as:modconf('Pwm')[1]/PwmGeneral/PwmTypeofInterruptFunction = 'PWM_ISR_CAT2'"!][!//
              <EXECUTION-CONTEXT>INTERRUPT-CAT-2</EXECUTION-CONTEXT>
              [!ELSE!][!//
              <EXECUTION-CONTEXT>INTERRUPT-CAT-1</EXECUTION-CONTEXT>
              [!ENDIF!][!//
              <SW-SERVICE-IMPL-POLICY>STANDARD</SW-SERVICE-IMPL-POLICY>
              <BSW-ENTRY-KIND>CONCRETE</BSW-ENTRY-KIND>
            </BSW-MODULE-ENTRY>
            <BSW-MODULE-ENTRY UUID="42ac5caa-8380-4921-a894-e5626a43f0c2">
              <SHORT-NAME>Pwm_Ch115Isr</SHORT-NAME>
              <IS-REENTRANT>false</IS-REENTRANT>
              <IS-SYNCHRONOUS>true</IS-SYNCHRONOUS>
              <CALL-TYPE>INTERRUPT</CALL-TYPE>
              [!IF "as:modconf('Pwm')[1]/PwmGeneral/PwmTypeofInterruptFunction = 'PWM_ISR_CAT2'"!][!//
              <EXECUTION-CONTEXT>INTERRUPT-CAT-2</EXECUTION-CONTEXT>
              [!ELSE!][!//
              <EXECUTION-CONTEXT>INTERRUPT-CAT-1</EXECUTION-CONTEXT>
              [!ENDIF!][!//
              <SW-SERVICE-IMPL-POLICY>STANDARD</SW-SERVICE-IMPL-POLICY>
              <BSW-ENTRY-KIND>CONCRETE</BSW-ENTRY-KIND>
            </BSW-MODULE-ENTRY>
            <BSW-MODULE-ENTRY UUID="27298c18-b35a-44e1-85d4-0b80aca95db1">
              <SHORT-NAME>Pwm_Ch116Isr</SHORT-NAME>
              <IS-REENTRANT>false</IS-REENTRANT>
              <IS-SYNCHRONOUS>true</IS-SYNCHRONOUS>
              <CALL-TYPE>INTERRUPT</CALL-TYPE>
              [!IF "as:modconf('Pwm')[1]/PwmGeneral/PwmTypeofInterruptFunction = 'PWM_ISR_CAT2'"!][!//
              <EXECUTION-CONTEXT>INTERRUPT-CAT-2</EXECUTION-CONTEXT>
              [!ELSE!][!//
              <EXECUTION-CONTEXT>INTERRUPT-CAT-1</EXECUTION-CONTEXT>
              [!ENDIF!][!//
              <SW-SERVICE-IMPL-POLICY>STANDARD</SW-SERVICE-IMPL-POLICY>
              <BSW-ENTRY-KIND>CONCRETE</BSW-ENTRY-KIND>
            </BSW-MODULE-ENTRY>
            <BSW-MODULE-ENTRY UUID="44c79c2b-7510-478a-9729-af2e66af5f65">
              <SHORT-NAME>Pwm_Ch117Isr</SHORT-NAME>
              <IS-REENTRANT>false</IS-REENTRANT>
              <IS-SYNCHRONOUS>true</IS-SYNCHRONOUS>
              <CALL-TYPE>INTERRUPT</CALL-TYPE>
              [!IF "as:modconf('Pwm')[1]/PwmGeneral/PwmTypeofInterruptFunction = 'PWM_ISR_CAT2'"!][!//
              <EXECUTION-CONTEXT>INTERRUPT-CAT-2</EXECUTION-CONTEXT>
              [!ELSE!][!//
              <EXECUTION-CONTEXT>INTERRUPT-CAT-1</EXECUTION-CONTEXT>
              [!ENDIF!][!//
              <SW-SERVICE-IMPL-POLICY>STANDARD</SW-SERVICE-IMPL-POLICY>
              <BSW-ENTRY-KIND>CONCRETE</BSW-ENTRY-KIND>
            </BSW-MODULE-ENTRY>
            <BSW-MODULE-ENTRY UUID="74225462-0573-4661-9287-109b936f33df">
              <SHORT-NAME>Pwm_Ch118Isr</SHORT-NAME>
              <IS-REENTRANT>false</IS-REENTRANT>
              <IS-SYNCHRONOUS>true</IS-SYNCHRONOUS>
              <CALL-TYPE>INTERRUPT</CALL-TYPE>
              [!IF "as:modconf('Pwm')[1]/PwmGeneral/PwmTypeofInterruptFunction = 'PWM_ISR_CAT2'"!][!//
              <EXECUTION-CONTEXT>INTERRUPT-CAT-2</EXECUTION-CONTEXT>
              [!ELSE!][!//
              <EXECUTION-CONTEXT>INTERRUPT-CAT-1</EXECUTION-CONTEXT>
              [!ENDIF!][!//
              <SW-SERVICE-IMPL-POLICY>STANDARD</SW-SERVICE-IMPL-POLICY>
              <BSW-ENTRY-KIND>CONCRETE</BSW-ENTRY-KIND>
            </BSW-MODULE-ENTRY>
            <BSW-MODULE-ENTRY UUID="23af75bb-212d-4618-b5a5-c2fdd71114ad">
              <SHORT-NAME>Pwm_Ch119Isr</SHORT-NAME>
              <IS-REENTRANT>false</IS-REENTRANT>
              <IS-SYNCHRONOUS>true</IS-SYNCHRONOUS>
              <CALL-TYPE>INTERRUPT</CALL-TYPE>
              [!IF "as:modconf('Pwm')[1]/PwmGeneral/PwmTypeofInterruptFunction = 'PWM_ISR_CAT2'"!][!//
              <EXECUTION-CONTEXT>INTERRUPT-CAT-2</EXECUTION-CONTEXT>
              [!ELSE!][!//
              <EXECUTION-CONTEXT>INTERRUPT-CAT-1</EXECUTION-CONTEXT>
              [!ENDIF!][!//
              <SW-SERVICE-IMPL-POLICY>STANDARD</SW-SERVICE-IMPL-POLICY>
              <BSW-ENTRY-KIND>CONCRETE</BSW-ENTRY-KIND>
            </BSW-MODULE-ENTRY>
            <BSW-MODULE-ENTRY UUID="10027e2a-7e80-40f5-ad85-e8c94ddcdc57">
              <SHORT-NAME>Pwm_Ch11Isr</SHORT-NAME>
              <IS-REENTRANT>false</IS-REENTRANT>
              <IS-SYNCHRONOUS>true</IS-SYNCHRONOUS>
              <CALL-TYPE>INTERRUPT</CALL-TYPE>
              [!IF "as:modconf('Pwm')[1]/PwmGeneral/PwmTypeofInterruptFunction = 'PWM_ISR_CAT2'"!][!//
              <EXECUTION-CONTEXT>INTERRUPT-CAT-2</EXECUTION-CONTEXT>
              [!ELSE!][!//
              <EXECUTION-CONTEXT>INTERRUPT-CAT-1</EXECUTION-CONTEXT>
              [!ENDIF!][!//
              <SW-SERVICE-IMPL-POLICY>STANDARD</SW-SERVICE-IMPL-POLICY>
              <BSW-ENTRY-KIND>CONCRETE</BSW-ENTRY-KIND>
            </BSW-MODULE-ENTRY>
            <BSW-MODULE-ENTRY UUID="b2ba8e2a-1154-4aec-bd96-6ffd7abfa6d1">
              <SHORT-NAME>Pwm_Ch120Isr</SHORT-NAME>
              <IS-REENTRANT>false</IS-REENTRANT>
              <IS-SYNCHRONOUS>true</IS-SYNCHRONOUS>
              <CALL-TYPE>INTERRUPT</CALL-TYPE>
              [!IF "as:modconf('Pwm')[1]/PwmGeneral/PwmTypeofInterruptFunction = 'PWM_ISR_CAT2'"!][!//
              <EXECUTION-CONTEXT>INTERRUPT-CAT-2</EXECUTION-CONTEXT>
              [!ELSE!][!//
              <EXECUTION-CONTEXT>INTERRUPT-CAT-1</EXECUTION-CONTEXT>
              [!ENDIF!][!//
              <SW-SERVICE-IMPL-POLICY>STANDARD</SW-SERVICE-IMPL-POLICY>
              <BSW-ENTRY-KIND>CONCRETE</BSW-ENTRY-KIND>
            </BSW-MODULE-ENTRY>
            <BSW-MODULE-ENTRY UUID="c9c3db2b-8d0b-47bf-a96a-a007d4f41e5c">
              <SHORT-NAME>Pwm_Ch121Isr</SHORT-NAME>
              <IS-REENTRANT>false</IS-REENTRANT>
              <IS-SYNCHRONOUS>true</IS-SYNCHRONOUS>
              <CALL-TYPE>INTERRUPT</CALL-TYPE>
              [!IF "as:modconf('Pwm')[1]/PwmGeneral/PwmTypeofInterruptFunction = 'PWM_ISR_CAT2'"!][!//
              <EXECUTION-CONTEXT>INTERRUPT-CAT-2</EXECUTION-CONTEXT>
              [!ELSE!][!//
              <EXECUTION-CONTEXT>INTERRUPT-CAT-1</EXECUTION-CONTEXT>
              [!ENDIF!][!//
              <SW-SERVICE-IMPL-POLICY>STANDARD</SW-SERVICE-IMPL-POLICY>
              <BSW-ENTRY-KIND>CONCRETE</BSW-ENTRY-KIND>
            </BSW-MODULE-ENTRY>
            <BSW-MODULE-ENTRY UUID="d32e0c23-295a-4dbc-8a12-e51cd3a560ce">
              <SHORT-NAME>Pwm_Ch122Isr</SHORT-NAME>
              <IS-REENTRANT>false</IS-REENTRANT>
              <IS-SYNCHRONOUS>true</IS-SYNCHRONOUS>
              <CALL-TYPE>INTERRUPT</CALL-TYPE>
              [!IF "as:modconf('Pwm')[1]/PwmGeneral/PwmTypeofInterruptFunction = 'PWM_ISR_CAT2'"!][!//
              <EXECUTION-CONTEXT>INTERRUPT-CAT-2</EXECUTION-CONTEXT>
              [!ELSE!][!//
              <EXECUTION-CONTEXT>INTERRUPT-CAT-1</EXECUTION-CONTEXT>
              [!ENDIF!][!//
              <SW-SERVICE-IMPL-POLICY>STANDARD</SW-SERVICE-IMPL-POLICY>
              <BSW-ENTRY-KIND>CONCRETE</BSW-ENTRY-KIND>
            </BSW-MODULE-ENTRY>
            <BSW-MODULE-ENTRY UUID="a62fb0fc-398f-43ed-80d4-1b747606ea15">
              <SHORT-NAME>Pwm_Ch123Isr</SHORT-NAME>
              <IS-REENTRANT>false</IS-REENTRANT>
              <IS-SYNCHRONOUS>true</IS-SYNCHRONOUS>
              <CALL-TYPE>INTERRUPT</CALL-TYPE>
              [!IF "as:modconf('Pwm')[1]/PwmGeneral/PwmTypeofInterruptFunction = 'PWM_ISR_CAT2'"!][!//
              <EXECUTION-CONTEXT>INTERRUPT-CAT-2</EXECUTION-CONTEXT>
              [!ELSE!][!//
              <EXECUTION-CONTEXT>INTERRUPT-CAT-1</EXECUTION-CONTEXT>
              [!ENDIF!][!//
              <SW-SERVICE-IMPL-POLICY>STANDARD</SW-SERVICE-IMPL-POLICY>
              <BSW-ENTRY-KIND>CONCRETE</BSW-ENTRY-KIND>
            </BSW-MODULE-ENTRY>
            <BSW-MODULE-ENTRY UUID="15dd9a85-e79d-47f5-9562-70193cb9de89">
              <SHORT-NAME>Pwm_Ch124Isr</SHORT-NAME>
              <IS-REENTRANT>false</IS-REENTRANT>
              <IS-SYNCHRONOUS>true</IS-SYNCHRONOUS>
              <CALL-TYPE>INTERRUPT</CALL-TYPE>
              [!IF "as:modconf('Pwm')[1]/PwmGeneral/PwmTypeofInterruptFunction = 'PWM_ISR_CAT2'"!][!//
              <EXECUTION-CONTEXT>INTERRUPT-CAT-2</EXECUTION-CONTEXT>
              [!ELSE!][!//
              <EXECUTION-CONTEXT>INTERRUPT-CAT-1</EXECUTION-CONTEXT>
              [!ENDIF!][!//
              <SW-SERVICE-IMPL-POLICY>STANDARD</SW-SERVICE-IMPL-POLICY>
              <BSW-ENTRY-KIND>CONCRETE</BSW-ENTRY-KIND>
            </BSW-MODULE-ENTRY>
            <BSW-MODULE-ENTRY UUID="f64ac7ad-d164-4fd8-9d20-6cb95b487fb5">
              <SHORT-NAME>Pwm_Ch125Isr</SHORT-NAME>
              <IS-REENTRANT>false</IS-REENTRANT>
              <IS-SYNCHRONOUS>true</IS-SYNCHRONOUS>
              <CALL-TYPE>INTERRUPT</CALL-TYPE>
              [!IF "as:modconf('Pwm')[1]/PwmGeneral/PwmTypeofInterruptFunction = 'PWM_ISR_CAT2'"!][!//
              <EXECUTION-CONTEXT>INTERRUPT-CAT-2</EXECUTION-CONTEXT>
              [!ELSE!][!//
              <EXECUTION-CONTEXT>INTERRUPT-CAT-1</EXECUTION-CONTEXT>
              [!ENDIF!][!//
              <SW-SERVICE-IMPL-POLICY>STANDARD</SW-SERVICE-IMPL-POLICY>
              <BSW-ENTRY-KIND>CONCRETE</BSW-ENTRY-KIND>
            </BSW-MODULE-ENTRY>
            <BSW-MODULE-ENTRY UUID="5f4501fc-4e29-44f8-bf9d-d70dcc4a8380">
              <SHORT-NAME>Pwm_Ch126Isr</SHORT-NAME>
              <IS-REENTRANT>false</IS-REENTRANT>
              <IS-SYNCHRONOUS>true</IS-SYNCHRONOUS>
              <CALL-TYPE>INTERRUPT</CALL-TYPE>
              [!IF "as:modconf('Pwm')[1]/PwmGeneral/PwmTypeofInterruptFunction = 'PWM_ISR_CAT2'"!][!//
              <EXECUTION-CONTEXT>INTERRUPT-CAT-2</EXECUTION-CONTEXT>
              [!ELSE!][!//
              <EXECUTION-CONTEXT>INTERRUPT-CAT-1</EXECUTION-CONTEXT>
              [!ENDIF!][!//
              <SW-SERVICE-IMPL-POLICY>STANDARD</SW-SERVICE-IMPL-POLICY>
              <BSW-ENTRY-KIND>CONCRETE</BSW-ENTRY-KIND>
            </BSW-MODULE-ENTRY>
            <BSW-MODULE-ENTRY UUID="d9ed27eb-3760-4ccb-81be-94c718b8fb85">
              <SHORT-NAME>Pwm_Ch127Isr</SHORT-NAME>
              <IS-REENTRANT>false</IS-REENTRANT>
              <IS-SYNCHRONOUS>true</IS-SYNCHRONOUS>
              <CALL-TYPE>INTERRUPT</CALL-TYPE>
              [!IF "as:modconf('Pwm')[1]/PwmGeneral/PwmTypeofInterruptFunction = 'PWM_ISR_CAT2'"!][!//
              <EXECUTION-CONTEXT>INTERRUPT-CAT-2</EXECUTION-CONTEXT>
              [!ELSE!][!//
              <EXECUTION-CONTEXT>INTERRUPT-CAT-1</EXECUTION-CONTEXT>
              [!ENDIF!][!//
              <SW-SERVICE-IMPL-POLICY>STANDARD</SW-SERVICE-IMPL-POLICY>
              <BSW-ENTRY-KIND>CONCRETE</BSW-ENTRY-KIND>
            </BSW-MODULE-ENTRY>
            <BSW-MODULE-ENTRY UUID="c3180176-860a-431e-8902-aa1454b62973">
              <SHORT-NAME>Pwm_Ch12Isr</SHORT-NAME>
              <IS-REENTRANT>false</IS-REENTRANT>
              <IS-SYNCHRONOUS>true</IS-SYNCHRONOUS>
              <CALL-TYPE>INTERRUPT</CALL-TYPE>
              [!IF "as:modconf('Pwm')[1]/PwmGeneral/PwmTypeofInterruptFunction = 'PWM_ISR_CAT2'"!][!//
              <EXECUTION-CONTEXT>INTERRUPT-CAT-2</EXECUTION-CONTEXT>
              [!ELSE!][!//
              <EXECUTION-CONTEXT>INTERRUPT-CAT-1</EXECUTION-CONTEXT>
              [!ENDIF!][!//
              <SW-SERVICE-IMPL-POLICY>STANDARD</SW-SERVICE-IMPL-POLICY>
              <BSW-ENTRY-KIND>CONCRETE</BSW-ENTRY-KIND>
            </BSW-MODULE-ENTRY>
            <BSW-MODULE-ENTRY UUID="1c8b661f-61e3-4eef-8448-ef188117971e">
              <SHORT-NAME>Pwm_Ch13Isr</SHORT-NAME>
              <IS-REENTRANT>false</IS-REENTRANT>
              <IS-SYNCHRONOUS>true</IS-SYNCHRONOUS>
              <CALL-TYPE>INTERRUPT</CALL-TYPE>
              [!IF "as:modconf('Pwm')[1]/PwmGeneral/PwmTypeofInterruptFunction = 'PWM_ISR_CAT2'"!][!//
              <EXECUTION-CONTEXT>INTERRUPT-CAT-2</EXECUTION-CONTEXT>
              [!ELSE!][!//
              <EXECUTION-CONTEXT>INTERRUPT-CAT-1</EXECUTION-CONTEXT>
              [!ENDIF!][!//
              <SW-SERVICE-IMPL-POLICY>STANDARD</SW-SERVICE-IMPL-POLICY>
              <BSW-ENTRY-KIND>CONCRETE</BSW-ENTRY-KIND>
            </BSW-MODULE-ENTRY>
            <BSW-MODULE-ENTRY UUID="b080fe41-1348-48ae-9ea9-538de0887fca">
              <SHORT-NAME>Pwm_Ch14Isr</SHORT-NAME>
              <IS-REENTRANT>false</IS-REENTRANT>
              <IS-SYNCHRONOUS>true</IS-SYNCHRONOUS>
              <CALL-TYPE>INTERRUPT</CALL-TYPE>
              [!IF "as:modconf('Pwm')[1]/PwmGeneral/PwmTypeofInterruptFunction = 'PWM_ISR_CAT2'"!][!//
              <EXECUTION-CONTEXT>INTERRUPT-CAT-2</EXECUTION-CONTEXT>
              [!ELSE!][!//
              <EXECUTION-CONTEXT>INTERRUPT-CAT-1</EXECUTION-CONTEXT>
              [!ENDIF!][!//
              <SW-SERVICE-IMPL-POLICY>STANDARD</SW-SERVICE-IMPL-POLICY>
              <BSW-ENTRY-KIND>CONCRETE</BSW-ENTRY-KIND>
            </BSW-MODULE-ENTRY>
            <BSW-MODULE-ENTRY UUID="866eb68a-a291-4d0a-aa93-6dfb3e92582a">
              <SHORT-NAME>Pwm_Ch15Isr</SHORT-NAME>
              <IS-REENTRANT>false</IS-REENTRANT>
              <IS-SYNCHRONOUS>true</IS-SYNCHRONOUS>
              <CALL-TYPE>INTERRUPT</CALL-TYPE>
              [!IF "as:modconf('Pwm')[1]/PwmGeneral/PwmTypeofInterruptFunction = 'PWM_ISR_CAT2'"!][!//
              <EXECUTION-CONTEXT>INTERRUPT-CAT-2</EXECUTION-CONTEXT>
              [!ELSE!][!//
              <EXECUTION-CONTEXT>INTERRUPT-CAT-1</EXECUTION-CONTEXT>
              [!ENDIF!][!//
              <SW-SERVICE-IMPL-POLICY>STANDARD</SW-SERVICE-IMPL-POLICY>
              <BSW-ENTRY-KIND>CONCRETE</BSW-ENTRY-KIND>
            </BSW-MODULE-ENTRY>
            <BSW-MODULE-ENTRY UUID="18a62d57-9d3c-4127-b5e4-f5544371d047">
              <SHORT-NAME>Pwm_Ch16Isr</SHORT-NAME>
              <IS-REENTRANT>false</IS-REENTRANT>
              <IS-SYNCHRONOUS>true</IS-SYNCHRONOUS>
              <CALL-TYPE>INTERRUPT</CALL-TYPE>
              [!IF "as:modconf('Pwm')[1]/PwmGeneral/PwmTypeofInterruptFunction = 'PWM_ISR_CAT2'"!][!//
              <EXECUTION-CONTEXT>INTERRUPT-CAT-2</EXECUTION-CONTEXT>
              [!ELSE!][!//
              <EXECUTION-CONTEXT>INTERRUPT-CAT-1</EXECUTION-CONTEXT>
              [!ENDIF!][!//
              <SW-SERVICE-IMPL-POLICY>STANDARD</SW-SERVICE-IMPL-POLICY>
              <BSW-ENTRY-KIND>CONCRETE</BSW-ENTRY-KIND>
            </BSW-MODULE-ENTRY>
            <BSW-MODULE-ENTRY UUID="31c9127b-d71f-4354-aec7-527e2ab347f4">
              <SHORT-NAME>Pwm_Ch17Isr</SHORT-NAME>
              <IS-REENTRANT>false</IS-REENTRANT>
              <IS-SYNCHRONOUS>true</IS-SYNCHRONOUS>
              <CALL-TYPE>INTERRUPT</CALL-TYPE>
              [!IF "as:modconf('Pwm')[1]/PwmGeneral/PwmTypeofInterruptFunction = 'PWM_ISR_CAT2'"!][!//
              <EXECUTION-CONTEXT>INTERRUPT-CAT-2</EXECUTION-CONTEXT>
              [!ELSE!][!//
              <EXECUTION-CONTEXT>INTERRUPT-CAT-1</EXECUTION-CONTEXT>
              [!ENDIF!][!//
              <SW-SERVICE-IMPL-POLICY>STANDARD</SW-SERVICE-IMPL-POLICY>
              <BSW-ENTRY-KIND>CONCRETE</BSW-ENTRY-KIND>
            </BSW-MODULE-ENTRY>
            <BSW-MODULE-ENTRY UUID="d0fae181-2a83-4957-86d7-6aa1c2800965">
              <SHORT-NAME>Pwm_Ch18Isr</SHORT-NAME>
              <IS-REENTRANT>false</IS-REENTRANT>
              <IS-SYNCHRONOUS>true</IS-SYNCHRONOUS>
              <CALL-TYPE>INTERRUPT</CALL-TYPE>
              [!IF "as:modconf('Pwm')[1]/PwmGeneral/PwmTypeofInterruptFunction = 'PWM_ISR_CAT2'"!][!//
              <EXECUTION-CONTEXT>INTERRUPT-CAT-2</EXECUTION-CONTEXT>
              [!ELSE!][!//
              <EXECUTION-CONTEXT>INTERRUPT-CAT-1</EXECUTION-CONTEXT>
              [!ENDIF!][!//
              <SW-SERVICE-IMPL-POLICY>STANDARD</SW-SERVICE-IMPL-POLICY>
              <BSW-ENTRY-KIND>CONCRETE</BSW-ENTRY-KIND>
            </BSW-MODULE-ENTRY>
            <BSW-MODULE-ENTRY UUID="66c5b65b-93e3-4ea6-9097-b29056fa8564">
              <SHORT-NAME>Pwm_Ch19Isr</SHORT-NAME>
              <IS-REENTRANT>false</IS-REENTRANT>
              <IS-SYNCHRONOUS>true</IS-SYNCHRONOUS>
              <CALL-TYPE>INTERRUPT</CALL-TYPE>
              [!IF "as:modconf('Pwm')[1]/PwmGeneral/PwmTypeofInterruptFunction = 'PWM_ISR_CAT2'"!][!//
              <EXECUTION-CONTEXT>INTERRUPT-CAT-2</EXECUTION-CONTEXT>
              [!ELSE!][!//
              <EXECUTION-CONTEXT>INTERRUPT-CAT-1</EXECUTION-CONTEXT>
              [!ENDIF!][!//
              <SW-SERVICE-IMPL-POLICY>STANDARD</SW-SERVICE-IMPL-POLICY>
              <BSW-ENTRY-KIND>CONCRETE</BSW-ENTRY-KIND>
            </BSW-MODULE-ENTRY>
            <BSW-MODULE-ENTRY UUID="ac384057-6bbb-4fdb-985c-144bbf17ce08">
              <SHORT-NAME>Pwm_Ch1Isr</SHORT-NAME>
              <IS-REENTRANT>false</IS-REENTRANT>
              <IS-SYNCHRONOUS>true</IS-SYNCHRONOUS>
              <CALL-TYPE>INTERRUPT</CALL-TYPE>
              [!IF "as:modconf('Pwm')[1]/PwmGeneral/PwmTypeofInterruptFunction = 'PWM_ISR_CAT2'"!][!//
              <EXECUTION-CONTEXT>INTERRUPT-CAT-2</EXECUTION-CONTEXT>
              [!ELSE!][!//
              <EXECUTION-CONTEXT>INTERRUPT-CAT-1</EXECUTION-CONTEXT>
              [!ENDIF!][!//
              <SW-SERVICE-IMPL-POLICY>STANDARD</SW-SERVICE-IMPL-POLICY>
              <BSW-ENTRY-KIND>CONCRETE</BSW-ENTRY-KIND>
            </BSW-MODULE-ENTRY>
            <BSW-MODULE-ENTRY UUID="8a16793d-d181-4fcd-abee-cb7e6af62bf0">
              <SHORT-NAME>Pwm_Ch20Isr</SHORT-NAME>
              <IS-REENTRANT>false</IS-REENTRANT>
              <IS-SYNCHRONOUS>true</IS-SYNCHRONOUS>
              <CALL-TYPE>INTERRUPT</CALL-TYPE>
              [!IF "as:modconf('Pwm')[1]/PwmGeneral/PwmTypeofInterruptFunction = 'PWM_ISR_CAT2'"!][!//
              <EXECUTION-CONTEXT>INTERRUPT-CAT-2</EXECUTION-CONTEXT>
              [!ELSE!][!//
              <EXECUTION-CONTEXT>INTERRUPT-CAT-1</EXECUTION-CONTEXT>
              [!ENDIF!][!//
              <SW-SERVICE-IMPL-POLICY>STANDARD</SW-SERVICE-IMPL-POLICY>
              <BSW-ENTRY-KIND>CONCRETE</BSW-ENTRY-KIND>
            </BSW-MODULE-ENTRY>
            <BSW-MODULE-ENTRY UUID="4a32b8a0-ed76-40b6-8335-4cf8de4be239">
              <SHORT-NAME>Pwm_Ch21Isr</SHORT-NAME>
              <IS-REENTRANT>false</IS-REENTRANT>
              <IS-SYNCHRONOUS>true</IS-SYNCHRONOUS>
              <CALL-TYPE>INTERRUPT</CALL-TYPE>
              [!IF "as:modconf('Pwm')[1]/PwmGeneral/PwmTypeofInterruptFunction = 'PWM_ISR_CAT2'"!][!//
              <EXECUTION-CONTEXT>INTERRUPT-CAT-2</EXECUTION-CONTEXT>
              [!ELSE!][!//
              <EXECUTION-CONTEXT>INTERRUPT-CAT-1</EXECUTION-CONTEXT>
              [!ENDIF!][!//
              <SW-SERVICE-IMPL-POLICY>STANDARD</SW-SERVICE-IMPL-POLICY>
              <BSW-ENTRY-KIND>CONCRETE</BSW-ENTRY-KIND>
            </BSW-MODULE-ENTRY>
            <BSW-MODULE-ENTRY UUID="270dca1c-3f67-4d46-9135-3d95fd4d8114">
              <SHORT-NAME>Pwm_Ch22Isr</SHORT-NAME>
              <IS-REENTRANT>false</IS-REENTRANT>
              <IS-SYNCHRONOUS>true</IS-SYNCHRONOUS>
              <CALL-TYPE>INTERRUPT</CALL-TYPE>
              [!IF "as:modconf('Pwm')[1]/PwmGeneral/PwmTypeofInterruptFunction = 'PWM_ISR_CAT2'"!][!//
              <EXECUTION-CONTEXT>INTERRUPT-CAT-2</EXECUTION-CONTEXT>
              [!ELSE!][!//
              <EXECUTION-CONTEXT>INTERRUPT-CAT-1</EXECUTION-CONTEXT>
              [!ENDIF!][!//
              <SW-SERVICE-IMPL-POLICY>STANDARD</SW-SERVICE-IMPL-POLICY>
              <BSW-ENTRY-KIND>CONCRETE</BSW-ENTRY-KIND>
            </BSW-MODULE-ENTRY>
            <BSW-MODULE-ENTRY UUID="bf18c7c6-c39f-4563-aa7e-ddd8ec1dd177">
              <SHORT-NAME>Pwm_Ch23Isr</SHORT-NAME>
              <IS-REENTRANT>false</IS-REENTRANT>
              <IS-SYNCHRONOUS>true</IS-SYNCHRONOUS>
              <CALL-TYPE>INTERRUPT</CALL-TYPE>
              [!IF "as:modconf('Pwm')[1]/PwmGeneral/PwmTypeofInterruptFunction = 'PWM_ISR_CAT2'"!][!//
              <EXECUTION-CONTEXT>INTERRUPT-CAT-2</EXECUTION-CONTEXT>
              [!ELSE!][!//
              <EXECUTION-CONTEXT>INTERRUPT-CAT-1</EXECUTION-CONTEXT>
              [!ENDIF!][!//
              <SW-SERVICE-IMPL-POLICY>STANDARD</SW-SERVICE-IMPL-POLICY>
              <BSW-ENTRY-KIND>CONCRETE</BSW-ENTRY-KIND>
            </BSW-MODULE-ENTRY>
            <BSW-MODULE-ENTRY UUID="20e0c431-d84d-428c-93ff-4447a647efc4">
              <SHORT-NAME>Pwm_Ch24Isr</SHORT-NAME>
              <IS-REENTRANT>false</IS-REENTRANT>
              <IS-SYNCHRONOUS>true</IS-SYNCHRONOUS>
              <CALL-TYPE>INTERRUPT</CALL-TYPE>
              [!IF "as:modconf('Pwm')[1]/PwmGeneral/PwmTypeofInterruptFunction = 'PWM_ISR_CAT2'"!][!//
              <EXECUTION-CONTEXT>INTERRUPT-CAT-2</EXECUTION-CONTEXT>
              [!ELSE!][!//
              <EXECUTION-CONTEXT>INTERRUPT-CAT-1</EXECUTION-CONTEXT>
              [!ENDIF!][!//
              <SW-SERVICE-IMPL-POLICY>STANDARD</SW-SERVICE-IMPL-POLICY>
              <BSW-ENTRY-KIND>CONCRETE</BSW-ENTRY-KIND>
            </BSW-MODULE-ENTRY>
            <BSW-MODULE-ENTRY UUID="8b4ce232-b346-447c-a35e-60f025a856b8">
              <SHORT-NAME>Pwm_Ch25Isr</SHORT-NAME>
              <IS-REENTRANT>false</IS-REENTRANT>
              <IS-SYNCHRONOUS>true</IS-SYNCHRONOUS>
              <CALL-TYPE>INTERRUPT</CALL-TYPE>
              [!IF "as:modconf('Pwm')[1]/PwmGeneral/PwmTypeofInterruptFunction = 'PWM_ISR_CAT2'"!][!//
              <EXECUTION-CONTEXT>INTERRUPT-CAT-2</EXECUTION-CONTEXT>
              [!ELSE!][!//
              <EXECUTION-CONTEXT>INTERRUPT-CAT-1</EXECUTION-CONTEXT>
              [!ENDIF!][!//
              <SW-SERVICE-IMPL-POLICY>STANDARD</SW-SERVICE-IMPL-POLICY>
              <BSW-ENTRY-KIND>CONCRETE</BSW-ENTRY-KIND>
            </BSW-MODULE-ENTRY>
            <BSW-MODULE-ENTRY UUID="4db72afc-cb8a-4071-8055-15c721edd0e1">
              <SHORT-NAME>Pwm_Ch26Isr</SHORT-NAME>
              <IS-REENTRANT>false</IS-REENTRANT>
              <IS-SYNCHRONOUS>true</IS-SYNCHRONOUS>
              <CALL-TYPE>INTERRUPT</CALL-TYPE>
              [!IF "as:modconf('Pwm')[1]/PwmGeneral/PwmTypeofInterruptFunction = 'PWM_ISR_CAT2'"!][!//
              <EXECUTION-CONTEXT>INTERRUPT-CAT-2</EXECUTION-CONTEXT>
              [!ELSE!][!//
              <EXECUTION-CONTEXT>INTERRUPT-CAT-1</EXECUTION-CONTEXT>
              [!ENDIF!][!//
              <SW-SERVICE-IMPL-POLICY>STANDARD</SW-SERVICE-IMPL-POLICY>
              <BSW-ENTRY-KIND>CONCRETE</BSW-ENTRY-KIND>
            </BSW-MODULE-ENTRY>
            <BSW-MODULE-ENTRY UUID="e4aa3ffb-6934-40a2-815d-be5240d99aca">
              <SHORT-NAME>Pwm_Ch27Isr</SHORT-NAME>
              <IS-REENTRANT>false</IS-REENTRANT>
              <IS-SYNCHRONOUS>true</IS-SYNCHRONOUS>
              <CALL-TYPE>INTERRUPT</CALL-TYPE>
              [!IF "as:modconf('Pwm')[1]/PwmGeneral/PwmTypeofInterruptFunction = 'PWM_ISR_CAT2'"!][!//
              <EXECUTION-CONTEXT>INTERRUPT-CAT-2</EXECUTION-CONTEXT>
              [!ELSE!][!//
              <EXECUTION-CONTEXT>INTERRUPT-CAT-1</EXECUTION-CONTEXT>
              [!ENDIF!][!//
              <SW-SERVICE-IMPL-POLICY>STANDARD</SW-SERVICE-IMPL-POLICY>
              <BSW-ENTRY-KIND>CONCRETE</BSW-ENTRY-KIND>
            </BSW-MODULE-ENTRY>
            <BSW-MODULE-ENTRY UUID="07705ded-31c0-4507-a907-631d8ed48286">
              <SHORT-NAME>Pwm_Ch28Isr</SHORT-NAME>
              <IS-REENTRANT>false</IS-REENTRANT>
              <IS-SYNCHRONOUS>true</IS-SYNCHRONOUS>
              <CALL-TYPE>INTERRUPT</CALL-TYPE>
              [!IF "as:modconf('Pwm')[1]/PwmGeneral/PwmTypeofInterruptFunction = 'PWM_ISR_CAT2'"!][!//
              <EXECUTION-CONTEXT>INTERRUPT-CAT-2</EXECUTION-CONTEXT>
              [!ELSE!][!//
              <EXECUTION-CONTEXT>INTERRUPT-CAT-1</EXECUTION-CONTEXT>
              [!ENDIF!][!//
              <SW-SERVICE-IMPL-POLICY>STANDARD</SW-SERVICE-IMPL-POLICY>
              <BSW-ENTRY-KIND>CONCRETE</BSW-ENTRY-KIND>
            </BSW-MODULE-ENTRY>
            <BSW-MODULE-ENTRY UUID="132f8594-be0e-415d-92c5-78b09bd4298f">
              <SHORT-NAME>Pwm_Ch29Isr</SHORT-NAME>
              <IS-REENTRANT>false</IS-REENTRANT>
              <IS-SYNCHRONOUS>true</IS-SYNCHRONOUS>
              <CALL-TYPE>INTERRUPT</CALL-TYPE>
              [!IF "as:modconf('Pwm')[1]/PwmGeneral/PwmTypeofInterruptFunction = 'PWM_ISR_CAT2'"!][!//
              <EXECUTION-CONTEXT>INTERRUPT-CAT-2</EXECUTION-CONTEXT>
              [!ELSE!][!//
              <EXECUTION-CONTEXT>INTERRUPT-CAT-1</EXECUTION-CONTEXT>
              [!ENDIF!][!//
              <SW-SERVICE-IMPL-POLICY>STANDARD</SW-SERVICE-IMPL-POLICY>
              <BSW-ENTRY-KIND>CONCRETE</BSW-ENTRY-KIND>
            </BSW-MODULE-ENTRY>
            <BSW-MODULE-ENTRY UUID="3e924fb7-f485-4897-a830-ea0c3022f5b2">
              <SHORT-NAME>Pwm_Ch2Isr</SHORT-NAME>
              <IS-REENTRANT>false</IS-REENTRANT>
              <IS-SYNCHRONOUS>true</IS-SYNCHRONOUS>
              <CALL-TYPE>INTERRUPT</CALL-TYPE>
              [!IF "as:modconf('Pwm')[1]/PwmGeneral/PwmTypeofInterruptFunction = 'PWM_ISR_CAT2'"!][!//
              <EXECUTION-CONTEXT>INTERRUPT-CAT-2</EXECUTION-CONTEXT>
              [!ELSE!][!//
              <EXECUTION-CONTEXT>INTERRUPT-CAT-1</EXECUTION-CONTEXT>
              [!ENDIF!][!//
              <SW-SERVICE-IMPL-POLICY>STANDARD</SW-SERVICE-IMPL-POLICY>
              <BSW-ENTRY-KIND>CONCRETE</BSW-ENTRY-KIND>
            </BSW-MODULE-ENTRY>
            <BSW-MODULE-ENTRY UUID="f413c18d-0bc9-41f5-92f5-ed42920575e5">
              <SHORT-NAME>Pwm_Ch30Isr</SHORT-NAME>
              <IS-REENTRANT>false</IS-REENTRANT>
              <IS-SYNCHRONOUS>true</IS-SYNCHRONOUS>
              <CALL-TYPE>INTERRUPT</CALL-TYPE>
              [!IF "as:modconf('Pwm')[1]/PwmGeneral/PwmTypeofInterruptFunction = 'PWM_ISR_CAT2'"!][!//
              <EXECUTION-CONTEXT>INTERRUPT-CAT-2</EXECUTION-CONTEXT>
              [!ELSE!][!//
              <EXECUTION-CONTEXT>INTERRUPT-CAT-1</EXECUTION-CONTEXT>
              [!ENDIF!][!//
              <SW-SERVICE-IMPL-POLICY>STANDARD</SW-SERVICE-IMPL-POLICY>
              <BSW-ENTRY-KIND>CONCRETE</BSW-ENTRY-KIND>
            </BSW-MODULE-ENTRY>
            <BSW-MODULE-ENTRY UUID="0ec2c695-5b83-4057-9712-8b2ad6431288">
              <SHORT-NAME>Pwm_Ch31Isr</SHORT-NAME>
              <IS-REENTRANT>false</IS-REENTRANT>
              <IS-SYNCHRONOUS>true</IS-SYNCHRONOUS>
              <CALL-TYPE>INTERRUPT</CALL-TYPE>
              [!IF "as:modconf('Pwm')[1]/PwmGeneral/PwmTypeofInterruptFunction = 'PWM_ISR_CAT2'"!][!//
              <EXECUTION-CONTEXT>INTERRUPT-CAT-2</EXECUTION-CONTEXT>
              [!ELSE!][!//
              <EXECUTION-CONTEXT>INTERRUPT-CAT-1</EXECUTION-CONTEXT>
              [!ENDIF!][!//
              <SW-SERVICE-IMPL-POLICY>STANDARD</SW-SERVICE-IMPL-POLICY>
              <BSW-ENTRY-KIND>CONCRETE</BSW-ENTRY-KIND>
            </BSW-MODULE-ENTRY>
            <BSW-MODULE-ENTRY UUID="2f755039-a214-4afa-b431-0fc18bbbf598">
              <SHORT-NAME>Pwm_Ch32Isr</SHORT-NAME>
              <IS-REENTRANT>false</IS-REENTRANT>
              <IS-SYNCHRONOUS>true</IS-SYNCHRONOUS>
              <CALL-TYPE>INTERRUPT</CALL-TYPE>
              [!IF "as:modconf('Pwm')[1]/PwmGeneral/PwmTypeofInterruptFunction = 'PWM_ISR_CAT2'"!][!//
              <EXECUTION-CONTEXT>INTERRUPT-CAT-2</EXECUTION-CONTEXT>
              [!ELSE!][!//
              <EXECUTION-CONTEXT>INTERRUPT-CAT-1</EXECUTION-CONTEXT>
              [!ENDIF!][!//
              <SW-SERVICE-IMPL-POLICY>STANDARD</SW-SERVICE-IMPL-POLICY>
              <BSW-ENTRY-KIND>CONCRETE</BSW-ENTRY-KIND>
            </BSW-MODULE-ENTRY>
            <BSW-MODULE-ENTRY UUID="ec74b576-a0af-4d9a-a192-dba45c2bd41a">
              <SHORT-NAME>Pwm_Ch33Isr</SHORT-NAME>
              <IS-REENTRANT>false</IS-REENTRANT>
              <IS-SYNCHRONOUS>true</IS-SYNCHRONOUS>
              <CALL-TYPE>INTERRUPT</CALL-TYPE>
              [!IF "as:modconf('Pwm')[1]/PwmGeneral/PwmTypeofInterruptFunction = 'PWM_ISR_CAT2'"!][!//
              <EXECUTION-CONTEXT>INTERRUPT-CAT-2</EXECUTION-CONTEXT>
              [!ELSE!][!//
              <EXECUTION-CONTEXT>INTERRUPT-CAT-1</EXECUTION-CONTEXT>
              [!ENDIF!][!//
              <SW-SERVICE-IMPL-POLICY>STANDARD</SW-SERVICE-IMPL-POLICY>
              <BSW-ENTRY-KIND>CONCRETE</BSW-ENTRY-KIND>
            </BSW-MODULE-ENTRY>
            <BSW-MODULE-ENTRY UUID="9f7753d6-29a1-4aec-b0b7-43a58f97c748">
              <SHORT-NAME>Pwm_Ch34Isr</SHORT-NAME>
              <IS-REENTRANT>false</IS-REENTRANT>
              <IS-SYNCHRONOUS>true</IS-SYNCHRONOUS>
              <CALL-TYPE>INTERRUPT</CALL-TYPE>
              [!IF "as:modconf('Pwm')[1]/PwmGeneral/PwmTypeofInterruptFunction = 'PWM_ISR_CAT2'"!][!//
              <EXECUTION-CONTEXT>INTERRUPT-CAT-2</EXECUTION-CONTEXT>
              [!ELSE!][!//
              <EXECUTION-CONTEXT>INTERRUPT-CAT-1</EXECUTION-CONTEXT>
              [!ENDIF!][!//
              <SW-SERVICE-IMPL-POLICY>STANDARD</SW-SERVICE-IMPL-POLICY>
              <BSW-ENTRY-KIND>CONCRETE</BSW-ENTRY-KIND>
            </BSW-MODULE-ENTRY>
            <BSW-MODULE-ENTRY UUID="1ae602b5-db38-471c-83cc-36eef5a96491">
              <SHORT-NAME>Pwm_Ch35Isr</SHORT-NAME>
              <IS-REENTRANT>false</IS-REENTRANT>
              <IS-SYNCHRONOUS>true</IS-SYNCHRONOUS>
              <CALL-TYPE>INTERRUPT</CALL-TYPE>
              [!IF "as:modconf('Pwm')[1]/PwmGeneral/PwmTypeofInterruptFunction = 'PWM_ISR_CAT2'"!][!//
              <EXECUTION-CONTEXT>INTERRUPT-CAT-2</EXECUTION-CONTEXT>
              [!ELSE!][!//
              <EXECUTION-CONTEXT>INTERRUPT-CAT-1</EXECUTION-CONTEXT>
              [!ENDIF!][!//
              <SW-SERVICE-IMPL-POLICY>STANDARD</SW-SERVICE-IMPL-POLICY>
              <BSW-ENTRY-KIND>CONCRETE</BSW-ENTRY-KIND>
            </BSW-MODULE-ENTRY>
            <BSW-MODULE-ENTRY UUID="e97c8a37-f3ae-4b45-a4ac-377266966489">
              <SHORT-NAME>Pwm_Ch36Isr</SHORT-NAME>
              <IS-REENTRANT>false</IS-REENTRANT>
              <IS-SYNCHRONOUS>true</IS-SYNCHRONOUS>
              <CALL-TYPE>INTERRUPT</CALL-TYPE>
              [!IF "as:modconf('Pwm')[1]/PwmGeneral/PwmTypeofInterruptFunction = 'PWM_ISR_CAT2'"!][!//
              <EXECUTION-CONTEXT>INTERRUPT-CAT-2</EXECUTION-CONTEXT>
              [!ELSE!][!//
              <EXECUTION-CONTEXT>INTERRUPT-CAT-1</EXECUTION-CONTEXT>
              [!ENDIF!][!//
              <SW-SERVICE-IMPL-POLICY>STANDARD</SW-SERVICE-IMPL-POLICY>
              <BSW-ENTRY-KIND>CONCRETE</BSW-ENTRY-KIND>
            </BSW-MODULE-ENTRY>
            <BSW-MODULE-ENTRY UUID="0b8125bf-d90f-49e2-8e35-b5f7c7f1e12f">
              <SHORT-NAME>Pwm_Ch37Isr</SHORT-NAME>
              <IS-REENTRANT>false</IS-REENTRANT>
              <IS-SYNCHRONOUS>true</IS-SYNCHRONOUS>
              <CALL-TYPE>INTERRUPT</CALL-TYPE>
              [!IF "as:modconf('Pwm')[1]/PwmGeneral/PwmTypeofInterruptFunction = 'PWM_ISR_CAT2'"!][!//
              <EXECUTION-CONTEXT>INTERRUPT-CAT-2</EXECUTION-CONTEXT>
              [!ELSE!][!//
              <EXECUTION-CONTEXT>INTERRUPT-CAT-1</EXECUTION-CONTEXT>
              [!ENDIF!][!//
              <SW-SERVICE-IMPL-POLICY>STANDARD</SW-SERVICE-IMPL-POLICY>
              <BSW-ENTRY-KIND>CONCRETE</BSW-ENTRY-KIND>
            </BSW-MODULE-ENTRY>
            <BSW-MODULE-ENTRY UUID="61279a80-d59b-43b7-8897-424845fe7e37">
              <SHORT-NAME>Pwm_Ch38Isr</SHORT-NAME>
              <IS-REENTRANT>false</IS-REENTRANT>
              <IS-SYNCHRONOUS>true</IS-SYNCHRONOUS>
              <CALL-TYPE>INTERRUPT</CALL-TYPE>
              [!IF "as:modconf('Pwm')[1]/PwmGeneral/PwmTypeofInterruptFunction = 'PWM_ISR_CAT2'"!][!//
              <EXECUTION-CONTEXT>INTERRUPT-CAT-2</EXECUTION-CONTEXT>
              [!ELSE!][!//
              <EXECUTION-CONTEXT>INTERRUPT-CAT-1</EXECUTION-CONTEXT>
              [!ENDIF!][!//
              <SW-SERVICE-IMPL-POLICY>STANDARD</SW-SERVICE-IMPL-POLICY>
              <BSW-ENTRY-KIND>CONCRETE</BSW-ENTRY-KIND>
            </BSW-MODULE-ENTRY>
            <BSW-MODULE-ENTRY UUID="8fcd38de-64df-4a7e-bd98-a07682bcbc7d">
              <SHORT-NAME>Pwm_Ch39Isr</SHORT-NAME>
              <IS-REENTRANT>false</IS-REENTRANT>
              <IS-SYNCHRONOUS>true</IS-SYNCHRONOUS>
              <CALL-TYPE>INTERRUPT</CALL-TYPE>
              [!IF "as:modconf('Pwm')[1]/PwmGeneral/PwmTypeofInterruptFunction = 'PWM_ISR_CAT2'"!][!//
              <EXECUTION-CONTEXT>INTERRUPT-CAT-2</EXECUTION-CONTEXT>
              [!ELSE!][!//
              <EXECUTION-CONTEXT>INTERRUPT-CAT-1</EXECUTION-CONTEXT>
              [!ENDIF!][!//
              <SW-SERVICE-IMPL-POLICY>STANDARD</SW-SERVICE-IMPL-POLICY>
              <BSW-ENTRY-KIND>CONCRETE</BSW-ENTRY-KIND>
            </BSW-MODULE-ENTRY>
            <BSW-MODULE-ENTRY UUID="258aac4a-777a-4205-a453-50fb6f672137">
              <SHORT-NAME>Pwm_Ch3Isr</SHORT-NAME>
              <IS-REENTRANT>false</IS-REENTRANT>
              <IS-SYNCHRONOUS>true</IS-SYNCHRONOUS>
              <CALL-TYPE>INTERRUPT</CALL-TYPE>
              [!IF "as:modconf('Pwm')[1]/PwmGeneral/PwmTypeofInterruptFunction = 'PWM_ISR_CAT2'"!][!//
              <EXECUTION-CONTEXT>INTERRUPT-CAT-2</EXECUTION-CONTEXT>
              [!ELSE!][!//
              <EXECUTION-CONTEXT>INTERRUPT-CAT-1</EXECUTION-CONTEXT>
              [!ENDIF!][!//
              <SW-SERVICE-IMPL-POLICY>STANDARD</SW-SERVICE-IMPL-POLICY>
              <BSW-ENTRY-KIND>CONCRETE</BSW-ENTRY-KIND>
            </BSW-MODULE-ENTRY>
            <BSW-MODULE-ENTRY UUID="2ea504d0-eb9f-4a42-9686-72eb6e3a0e43">
              <SHORT-NAME>Pwm_Ch40Isr</SHORT-NAME>
              <IS-REENTRANT>false</IS-REENTRANT>
              <IS-SYNCHRONOUS>true</IS-SYNCHRONOUS>
              <CALL-TYPE>INTERRUPT</CALL-TYPE>
              [!IF "as:modconf('Pwm')[1]/PwmGeneral/PwmTypeofInterruptFunction = 'PWM_ISR_CAT2'"!][!//
              <EXECUTION-CONTEXT>INTERRUPT-CAT-2</EXECUTION-CONTEXT>
              [!ELSE!][!//
              <EXECUTION-CONTEXT>INTERRUPT-CAT-1</EXECUTION-CONTEXT>
              [!ENDIF!][!//
              <SW-SERVICE-IMPL-POLICY>STANDARD</SW-SERVICE-IMPL-POLICY>
              <BSW-ENTRY-KIND>CONCRETE</BSW-ENTRY-KIND>
            </BSW-MODULE-ENTRY>
            <BSW-MODULE-ENTRY UUID="b3f39d09-d310-49da-872f-b4e00e7b73eb">
              <SHORT-NAME>Pwm_Ch41Isr</SHORT-NAME>
              <IS-REENTRANT>false</IS-REENTRANT>
              <IS-SYNCHRONOUS>true</IS-SYNCHRONOUS>
              <CALL-TYPE>INTERRUPT</CALL-TYPE>
              [!IF "as:modconf('Pwm')[1]/PwmGeneral/PwmTypeofInterruptFunction = 'PWM_ISR_CAT2'"!][!//
              <EXECUTION-CONTEXT>INTERRUPT-CAT-2</EXECUTION-CONTEXT>
              [!ELSE!][!//
              <EXECUTION-CONTEXT>INTERRUPT-CAT-1</EXECUTION-CONTEXT>
              [!ENDIF!][!//
              <SW-SERVICE-IMPL-POLICY>STANDARD</SW-SERVICE-IMPL-POLICY>
              <BSW-ENTRY-KIND>CONCRETE</BSW-ENTRY-KIND>
            </BSW-MODULE-ENTRY>
            <BSW-MODULE-ENTRY UUID="1c550826-522d-4128-b11d-1cb062ec7c11">
              <SHORT-NAME>Pwm_Ch42Isr</SHORT-NAME>
              <IS-REENTRANT>false</IS-REENTRANT>
              <IS-SYNCHRONOUS>true</IS-SYNCHRONOUS>
              <CALL-TYPE>INTERRUPT</CALL-TYPE>
              [!IF "as:modconf('Pwm')[1]/PwmGeneral/PwmTypeofInterruptFunction = 'PWM_ISR_CAT2'"!][!//
              <EXECUTION-CONTEXT>INTERRUPT-CAT-2</EXECUTION-CONTEXT>
              [!ELSE!][!//
              <EXECUTION-CONTEXT>INTERRUPT-CAT-1</EXECUTION-CONTEXT>
              [!ENDIF!][!//
              <SW-SERVICE-IMPL-POLICY>STANDARD</SW-SERVICE-IMPL-POLICY>
              <BSW-ENTRY-KIND>CONCRETE</BSW-ENTRY-KIND>
            </BSW-MODULE-ENTRY>
            <BSW-MODULE-ENTRY UUID="64a1b54b-1283-43c7-8a4e-78344bb8bcee">
              <SHORT-NAME>Pwm_Ch43Isr</SHORT-NAME>
              <IS-REENTRANT>false</IS-REENTRANT>
              <IS-SYNCHRONOUS>true</IS-SYNCHRONOUS>
              <CALL-TYPE>INTERRUPT</CALL-TYPE>
              [!IF "as:modconf('Pwm')[1]/PwmGeneral/PwmTypeofInterruptFunction = 'PWM_ISR_CAT2'"!][!//
              <EXECUTION-CONTEXT>INTERRUPT-CAT-2</EXECUTION-CONTEXT>
              [!ELSE!][!//
              <EXECUTION-CONTEXT>INTERRUPT-CAT-1</EXECUTION-CONTEXT>
              [!ENDIF!][!//
              <SW-SERVICE-IMPL-POLICY>STANDARD</SW-SERVICE-IMPL-POLICY>
              <BSW-ENTRY-KIND>CONCRETE</BSW-ENTRY-KIND>
            </BSW-MODULE-ENTRY>
            <BSW-MODULE-ENTRY UUID="fcf3dd33-8f93-46ff-85c4-51d6489c67d6">
              <SHORT-NAME>Pwm_Ch44Isr</SHORT-NAME>
              <IS-REENTRANT>false</IS-REENTRANT>
              <IS-SYNCHRONOUS>true</IS-SYNCHRONOUS>
              <CALL-TYPE>INTERRUPT</CALL-TYPE>
              [!IF "as:modconf('Pwm')[1]/PwmGeneral/PwmTypeofInterruptFunction = 'PWM_ISR_CAT2'"!][!//
              <EXECUTION-CONTEXT>INTERRUPT-CAT-2</EXECUTION-CONTEXT>
              [!ELSE!][!//
              <EXECUTION-CONTEXT>INTERRUPT-CAT-1</EXECUTION-CONTEXT>
              [!ENDIF!][!//
              <SW-SERVICE-IMPL-POLICY>STANDARD</SW-SERVICE-IMPL-POLICY>
              <BSW-ENTRY-KIND>CONCRETE</BSW-ENTRY-KIND>
            </BSW-MODULE-ENTRY>
            <BSW-MODULE-ENTRY UUID="5537bce4-79da-4282-a1d4-23670c2359d7">
              <SHORT-NAME>Pwm_Ch45Isr</SHORT-NAME>
              <IS-REENTRANT>false</IS-REENTRANT>
              <IS-SYNCHRONOUS>true</IS-SYNCHRONOUS>
              <CALL-TYPE>INTERRUPT</CALL-TYPE>
              [!IF "as:modconf('Pwm')[1]/PwmGeneral/PwmTypeofInterruptFunction = 'PWM_ISR_CAT2'"!][!//
              <EXECUTION-CONTEXT>INTERRUPT-CAT-2</EXECUTION-CONTEXT>
              [!ELSE!][!//
              <EXECUTION-CONTEXT>INTERRUPT-CAT-1</EXECUTION-CONTEXT>
              [!ENDIF!][!//
              <SW-SERVICE-IMPL-POLICY>STANDARD</SW-SERVICE-IMPL-POLICY>
              <BSW-ENTRY-KIND>CONCRETE</BSW-ENTRY-KIND>
            </BSW-MODULE-ENTRY>
            <BSW-MODULE-ENTRY UUID="1f4d812d-530c-4964-81df-781acaafb0b1">
              <SHORT-NAME>Pwm_Ch46Isr</SHORT-NAME>
              <IS-REENTRANT>false</IS-REENTRANT>
              <IS-SYNCHRONOUS>true</IS-SYNCHRONOUS>
              <CALL-TYPE>INTERRUPT</CALL-TYPE>
              [!IF "as:modconf('Pwm')[1]/PwmGeneral/PwmTypeofInterruptFunction = 'PWM_ISR_CAT2'"!][!//
              <EXECUTION-CONTEXT>INTERRUPT-CAT-2</EXECUTION-CONTEXT>
              [!ELSE!][!//
              <EXECUTION-CONTEXT>INTERRUPT-CAT-1</EXECUTION-CONTEXT>
              [!ENDIF!][!//
              <SW-SERVICE-IMPL-POLICY>STANDARD</SW-SERVICE-IMPL-POLICY>
              <BSW-ENTRY-KIND>CONCRETE</BSW-ENTRY-KIND>
            </BSW-MODULE-ENTRY>
            <BSW-MODULE-ENTRY UUID="4bdce1c4-e181-415a-8a95-3b858eab82f3">
              <SHORT-NAME>Pwm_Ch47Isr</SHORT-NAME>
              <IS-REENTRANT>false</IS-REENTRANT>
              <IS-SYNCHRONOUS>true</IS-SYNCHRONOUS>
              <CALL-TYPE>INTERRUPT</CALL-TYPE>
              [!IF "as:modconf('Pwm')[1]/PwmGeneral/PwmTypeofInterruptFunction = 'PWM_ISR_CAT2'"!][!//
              <EXECUTION-CONTEXT>INTERRUPT-CAT-2</EXECUTION-CONTEXT>
              [!ELSE!][!//
              <EXECUTION-CONTEXT>INTERRUPT-CAT-1</EXECUTION-CONTEXT>
              [!ENDIF!][!//
              <SW-SERVICE-IMPL-POLICY>STANDARD</SW-SERVICE-IMPL-POLICY>
              <BSW-ENTRY-KIND>CONCRETE</BSW-ENTRY-KIND>
            </BSW-MODULE-ENTRY>
            <BSW-MODULE-ENTRY UUID="22f3efa7-ed08-4261-9861-0e19d2214d87">
              <SHORT-NAME>Pwm_Ch48Isr</SHORT-NAME>
              <IS-REENTRANT>false</IS-REENTRANT>
              <IS-SYNCHRONOUS>true</IS-SYNCHRONOUS>
              <CALL-TYPE>INTERRUPT</CALL-TYPE>
              [!IF "as:modconf('Pwm')[1]/PwmGeneral/PwmTypeofInterruptFunction = 'PWM_ISR_CAT2'"!][!//
              <EXECUTION-CONTEXT>INTERRUPT-CAT-2</EXECUTION-CONTEXT>
              [!ELSE!][!//
              <EXECUTION-CONTEXT>INTERRUPT-CAT-1</EXECUTION-CONTEXT>
              [!ENDIF!][!//
              <SW-SERVICE-IMPL-POLICY>STANDARD</SW-SERVICE-IMPL-POLICY>
              <BSW-ENTRY-KIND>CONCRETE</BSW-ENTRY-KIND>
            </BSW-MODULE-ENTRY>
            <BSW-MODULE-ENTRY UUID="0b4b985d-d9f0-43ad-86ec-d9661bddd2df">
              <SHORT-NAME>Pwm_Ch49Isr</SHORT-NAME>
              <IS-REENTRANT>false</IS-REENTRANT>
              <IS-SYNCHRONOUS>true</IS-SYNCHRONOUS>
              <CALL-TYPE>INTERRUPT</CALL-TYPE>
              [!IF "as:modconf('Pwm')[1]/PwmGeneral/PwmTypeofInterruptFunction = 'PWM_ISR_CAT2'"!][!//
              <EXECUTION-CONTEXT>INTERRUPT-CAT-2</EXECUTION-CONTEXT>
              [!ELSE!][!//
              <EXECUTION-CONTEXT>INTERRUPT-CAT-1</EXECUTION-CONTEXT>
              [!ENDIF!][!//
              <SW-SERVICE-IMPL-POLICY>STANDARD</SW-SERVICE-IMPL-POLICY>
              <BSW-ENTRY-KIND>CONCRETE</BSW-ENTRY-KIND>
            </BSW-MODULE-ENTRY>
            <BSW-MODULE-ENTRY UUID="fd8aa9f9-17c3-482c-9d53-b09b01639a8f">
              <SHORT-NAME>Pwm_Ch4Isr</SHORT-NAME>
              <IS-REENTRANT>false</IS-REENTRANT>
              <IS-SYNCHRONOUS>true</IS-SYNCHRONOUS>
              <CALL-TYPE>INTERRUPT</CALL-TYPE>
              [!IF "as:modconf('Pwm')[1]/PwmGeneral/PwmTypeofInterruptFunction = 'PWM_ISR_CAT2'"!][!//
              <EXECUTION-CONTEXT>INTERRUPT-CAT-2</EXECUTION-CONTEXT>
              [!ELSE!][!//
              <EXECUTION-CONTEXT>INTERRUPT-CAT-1</EXECUTION-CONTEXT>
              [!ENDIF!][!//
              <SW-SERVICE-IMPL-POLICY>STANDARD</SW-SERVICE-IMPL-POLICY>
              <BSW-ENTRY-KIND>CONCRETE</BSW-ENTRY-KIND>
            </BSW-MODULE-ENTRY>
            <BSW-MODULE-ENTRY UUID="aa03aa7f-a63a-44c4-b7bb-bab7bd380d13">
              <SHORT-NAME>Pwm_Ch50Isr</SHORT-NAME>
              <IS-REENTRANT>false</IS-REENTRANT>
              <IS-SYNCHRONOUS>true</IS-SYNCHRONOUS>
              <CALL-TYPE>INTERRUPT</CALL-TYPE>
              [!IF "as:modconf('Pwm')[1]/PwmGeneral/PwmTypeofInterruptFunction = 'PWM_ISR_CAT2'"!][!//
              <EXECUTION-CONTEXT>INTERRUPT-CAT-2</EXECUTION-CONTEXT>
              [!ELSE!][!//
              <EXECUTION-CONTEXT>INTERRUPT-CAT-1</EXECUTION-CONTEXT>
              [!ENDIF!][!//
              <SW-SERVICE-IMPL-POLICY>STANDARD</SW-SERVICE-IMPL-POLICY>
              <BSW-ENTRY-KIND>CONCRETE</BSW-ENTRY-KIND>
            </BSW-MODULE-ENTRY>
            <BSW-MODULE-ENTRY UUID="1fab13aa-0794-4c40-8d2f-e9e540c25ee2">
              <SHORT-NAME>Pwm_Ch51Isr</SHORT-NAME>
              <IS-REENTRANT>false</IS-REENTRANT>
              <IS-SYNCHRONOUS>true</IS-SYNCHRONOUS>
              <CALL-TYPE>INTERRUPT</CALL-TYPE>
              [!IF "as:modconf('Pwm')[1]/PwmGeneral/PwmTypeofInterruptFunction = 'PWM_ISR_CAT2'"!][!//
              <EXECUTION-CONTEXT>INTERRUPT-CAT-2</EXECUTION-CONTEXT>
              [!ELSE!][!//
              <EXECUTION-CONTEXT>INTERRUPT-CAT-1</EXECUTION-CONTEXT>
              [!ENDIF!][!//
              <SW-SERVICE-IMPL-POLICY>STANDARD</SW-SERVICE-IMPL-POLICY>
              <BSW-ENTRY-KIND>CONCRETE</BSW-ENTRY-KIND>
            </BSW-MODULE-ENTRY>
            <BSW-MODULE-ENTRY UUID="16097cbe-16c3-417d-bc49-43e7f6fca6ea">
              <SHORT-NAME>Pwm_Ch52Isr</SHORT-NAME>
              <IS-REENTRANT>false</IS-REENTRANT>
              <IS-SYNCHRONOUS>true</IS-SYNCHRONOUS>
              <CALL-TYPE>INTERRUPT</CALL-TYPE>
              [!IF "as:modconf('Pwm')[1]/PwmGeneral/PwmTypeofInterruptFunction = 'PWM_ISR_CAT2'"!][!//
              <EXECUTION-CONTEXT>INTERRUPT-CAT-2</EXECUTION-CONTEXT>
              [!ELSE!][!//
              <EXECUTION-CONTEXT>INTERRUPT-CAT-1</EXECUTION-CONTEXT>
              [!ENDIF!][!//
              <SW-SERVICE-IMPL-POLICY>STANDARD</SW-SERVICE-IMPL-POLICY>
              <BSW-ENTRY-KIND>CONCRETE</BSW-ENTRY-KIND>
            </BSW-MODULE-ENTRY>
            <BSW-MODULE-ENTRY UUID="52138819-3f8d-44b5-a5fa-9da8d802a55a">
              <SHORT-NAME>Pwm_Ch53Isr</SHORT-NAME>
              <IS-REENTRANT>false</IS-REENTRANT>
              <IS-SYNCHRONOUS>true</IS-SYNCHRONOUS>
              <CALL-TYPE>INTERRUPT</CALL-TYPE>
              [!IF "as:modconf('Pwm')[1]/PwmGeneral/PwmTypeofInterruptFunction = 'PWM_ISR_CAT2'"!][!//
              <EXECUTION-CONTEXT>INTERRUPT-CAT-2</EXECUTION-CONTEXT>
              [!ELSE!][!//
              <EXECUTION-CONTEXT>INTERRUPT-CAT-1</EXECUTION-CONTEXT>
              [!ENDIF!][!//
              <SW-SERVICE-IMPL-POLICY>STANDARD</SW-SERVICE-IMPL-POLICY>
              <BSW-ENTRY-KIND>CONCRETE</BSW-ENTRY-KIND>
            </BSW-MODULE-ENTRY>
            <BSW-MODULE-ENTRY UUID="e981078a-46c0-4dba-9b26-e7cb442ed6fb">
              <SHORT-NAME>Pwm_Ch54Isr</SHORT-NAME>
              <IS-REENTRANT>false</IS-REENTRANT>
              <IS-SYNCHRONOUS>true</IS-SYNCHRONOUS>
              <CALL-TYPE>INTERRUPT</CALL-TYPE>
              [!IF "as:modconf('Pwm')[1]/PwmGeneral/PwmTypeofInterruptFunction = 'PWM_ISR_CAT2'"!][!//
              <EXECUTION-CONTEXT>INTERRUPT-CAT-2</EXECUTION-CONTEXT>
              [!ELSE!][!//
              <EXECUTION-CONTEXT>INTERRUPT-CAT-1</EXECUTION-CONTEXT>
              [!ENDIF!][!//
              <SW-SERVICE-IMPL-POLICY>STANDARD</SW-SERVICE-IMPL-POLICY>
              <BSW-ENTRY-KIND>CONCRETE</BSW-ENTRY-KIND>
            </BSW-MODULE-ENTRY>
            <BSW-MODULE-ENTRY UUID="7494bebe-f545-46cb-b7b0-92edccdc1d0a">
              <SHORT-NAME>Pwm_Ch55Isr</SHORT-NAME>
              <IS-REENTRANT>false</IS-REENTRANT>
              <IS-SYNCHRONOUS>true</IS-SYNCHRONOUS>
              <CALL-TYPE>INTERRUPT</CALL-TYPE>
              [!IF "as:modconf('Pwm')[1]/PwmGeneral/PwmTypeofInterruptFunction = 'PWM_ISR_CAT2'"!][!//
              <EXECUTION-CONTEXT>INTERRUPT-CAT-2</EXECUTION-CONTEXT>
              [!ELSE!][!//
              <EXECUTION-CONTEXT>INTERRUPT-CAT-1</EXECUTION-CONTEXT>
              [!ENDIF!][!//
              <SW-SERVICE-IMPL-POLICY>STANDARD</SW-SERVICE-IMPL-POLICY>
              <BSW-ENTRY-KIND>CONCRETE</BSW-ENTRY-KIND>
            </BSW-MODULE-ENTRY>
            <BSW-MODULE-ENTRY UUID="7e7cb74e-f52e-43b5-904f-f8ec06f54079">
              <SHORT-NAME>Pwm_Ch56Isr</SHORT-NAME>
              <IS-REENTRANT>false</IS-REENTRANT>
              <IS-SYNCHRONOUS>true</IS-SYNCHRONOUS>
              <CALL-TYPE>INTERRUPT</CALL-TYPE>
              [!IF "as:modconf('Pwm')[1]/PwmGeneral/PwmTypeofInterruptFunction = 'PWM_ISR_CAT2'"!][!//
              <EXECUTION-CONTEXT>INTERRUPT-CAT-2</EXECUTION-CONTEXT>
              [!ELSE!][!//
              <EXECUTION-CONTEXT>INTERRUPT-CAT-1</EXECUTION-CONTEXT>
              [!ENDIF!][!//
              <SW-SERVICE-IMPL-POLICY>STANDARD</SW-SERVICE-IMPL-POLICY>
              <BSW-ENTRY-KIND>CONCRETE</BSW-ENTRY-KIND>
            </BSW-MODULE-ENTRY>
            <BSW-MODULE-ENTRY UUID="a172d3bd-cfaa-4e00-8055-b709fabefb16">
              <SHORT-NAME>Pwm_Ch57Isr</SHORT-NAME>
              <IS-REENTRANT>false</IS-REENTRANT>
              <IS-SYNCHRONOUS>true</IS-SYNCHRONOUS>
              <CALL-TYPE>INTERRUPT</CALL-TYPE>
              [!IF "as:modconf('Pwm')[1]/PwmGeneral/PwmTypeofInterruptFunction = 'PWM_ISR_CAT2'"!][!//
              <EXECUTION-CONTEXT>INTERRUPT-CAT-2</EXECUTION-CONTEXT>
              [!ELSE!][!//
              <EXECUTION-CONTEXT>INTERRUPT-CAT-1</EXECUTION-CONTEXT>
              [!ENDIF!][!//
              <SW-SERVICE-IMPL-POLICY>STANDARD</SW-SERVICE-IMPL-POLICY>
              <BSW-ENTRY-KIND>CONCRETE</BSW-ENTRY-KIND>
            </BSW-MODULE-ENTRY>
            <BSW-MODULE-ENTRY UUID="ab23b1db-75ab-4800-b888-3ff5a9a33580">
              <SHORT-NAME>Pwm_Ch58Isr</SHORT-NAME>
              <IS-REENTRANT>false</IS-REENTRANT>
              <IS-SYNCHRONOUS>true</IS-SYNCHRONOUS>
              <CALL-TYPE>INTERRUPT</CALL-TYPE>
              [!IF "as:modconf('Pwm')[1]/PwmGeneral/PwmTypeofInterruptFunction = 'PWM_ISR_CAT2'"!][!//
              <EXECUTION-CONTEXT>INTERRUPT-CAT-2</EXECUTION-CONTEXT>
              [!ELSE!][!//
              <EXECUTION-CONTEXT>INTERRUPT-CAT-1</EXECUTION-CONTEXT>
              [!ENDIF!][!//
              <SW-SERVICE-IMPL-POLICY>STANDARD</SW-SERVICE-IMPL-POLICY>
              <BSW-ENTRY-KIND>CONCRETE</BSW-ENTRY-KIND>
            </BSW-MODULE-ENTRY>
            <BSW-MODULE-ENTRY UUID="7074c0d5-1c88-4c6c-8736-5219dfa14def">
              <SHORT-NAME>Pwm_Ch59Isr</SHORT-NAME>
              <IS-REENTRANT>false</IS-REENTRANT>
              <IS-SYNCHRONOUS>true</IS-SYNCHRONOUS>
              <CALL-TYPE>INTERRUPT</CALL-TYPE>
              [!IF "as:modconf('Pwm')[1]/PwmGeneral/PwmTypeofInterruptFunction = 'PWM_ISR_CAT2'"!][!//
              <EXECUTION-CONTEXT>INTERRUPT-CAT-2</EXECUTION-CONTEXT>
              [!ELSE!][!//
              <EXECUTION-CONTEXT>INTERRUPT-CAT-1</EXECUTION-CONTEXT>
              [!ENDIF!][!//
              <SW-SERVICE-IMPL-POLICY>STANDARD</SW-SERVICE-IMPL-POLICY>
              <BSW-ENTRY-KIND>CONCRETE</BSW-ENTRY-KIND>
            </BSW-MODULE-ENTRY>
            <BSW-MODULE-ENTRY UUID="6bb4645a-7528-4287-8e82-aca16ac819c3">
              <SHORT-NAME>Pwm_Ch5Isr</SHORT-NAME>
              <IS-REENTRANT>false</IS-REENTRANT>
              <IS-SYNCHRONOUS>true</IS-SYNCHRONOUS>
              <CALL-TYPE>INTERRUPT</CALL-TYPE>
              [!IF "as:modconf('Pwm')[1]/PwmGeneral/PwmTypeofInterruptFunction = 'PWM_ISR_CAT2'"!][!//
              <EXECUTION-CONTEXT>INTERRUPT-CAT-2</EXECUTION-CONTEXT>
              [!ELSE!][!//
              <EXECUTION-CONTEXT>INTERRUPT-CAT-1</EXECUTION-CONTEXT>
              [!ENDIF!][!//
              <SW-SERVICE-IMPL-POLICY>STANDARD</SW-SERVICE-IMPL-POLICY>
              <BSW-ENTRY-KIND>CONCRETE</BSW-ENTRY-KIND>
            </BSW-MODULE-ENTRY>
            <BSW-MODULE-ENTRY UUID="8d44c0b3-833a-4623-913a-ed0965106b58">
              <SHORT-NAME>Pwm_Ch60Isr</SHORT-NAME>
              <IS-REENTRANT>false</IS-REENTRANT>
              <IS-SYNCHRONOUS>true</IS-SYNCHRONOUS>
              <CALL-TYPE>INTERRUPT</CALL-TYPE>
              [!IF "as:modconf('Pwm')[1]/PwmGeneral/PwmTypeofInterruptFunction = 'PWM_ISR_CAT2'"!][!//
              <EXECUTION-CONTEXT>INTERRUPT-CAT-2</EXECUTION-CONTEXT>
              [!ELSE!][!//
              <EXECUTION-CONTEXT>INTERRUPT-CAT-1</EXECUTION-CONTEXT>
              [!ENDIF!][!//
              <SW-SERVICE-IMPL-POLICY>STANDARD</SW-SERVICE-IMPL-POLICY>
              <BSW-ENTRY-KIND>CONCRETE</BSW-ENTRY-KIND>
            </BSW-MODULE-ENTRY>
            <BSW-MODULE-ENTRY UUID="9cf83dd2-29ed-4dc3-9f0d-f714f9c00511">
              <SHORT-NAME>Pwm_Ch61Isr</SHORT-NAME>
              <IS-REENTRANT>false</IS-REENTRANT>
              <IS-SYNCHRONOUS>true</IS-SYNCHRONOUS>
              <CALL-TYPE>INTERRUPT</CALL-TYPE>
              [!IF "as:modconf('Pwm')[1]/PwmGeneral/PwmTypeofInterruptFunction = 'PWM_ISR_CAT2'"!][!//
              <EXECUTION-CONTEXT>INTERRUPT-CAT-2</EXECUTION-CONTEXT>
              [!ELSE!][!//
              <EXECUTION-CONTEXT>INTERRUPT-CAT-1</EXECUTION-CONTEXT>
              [!ENDIF!][!//
              <SW-SERVICE-IMPL-POLICY>STANDARD</SW-SERVICE-IMPL-POLICY>
              <BSW-ENTRY-KIND>CONCRETE</BSW-ENTRY-KIND>
            </BSW-MODULE-ENTRY>
            <BSW-MODULE-ENTRY UUID="7d0173fe-670a-48c9-9ecc-0c8c682486d4">
              <SHORT-NAME>Pwm_Ch62Isr</SHORT-NAME>
              <IS-REENTRANT>false</IS-REENTRANT>
              <IS-SYNCHRONOUS>true</IS-SYNCHRONOUS>
              <CALL-TYPE>INTERRUPT</CALL-TYPE>
              [!IF "as:modconf('Pwm')[1]/PwmGeneral/PwmTypeofInterruptFunction = 'PWM_ISR_CAT2'"!][!//
              <EXECUTION-CONTEXT>INTERRUPT-CAT-2</EXECUTION-CONTEXT>
              [!ELSE!][!//
              <EXECUTION-CONTEXT>INTERRUPT-CAT-1</EXECUTION-CONTEXT>
              [!ENDIF!][!//
              <SW-SERVICE-IMPL-POLICY>STANDARD</SW-SERVICE-IMPL-POLICY>
              <BSW-ENTRY-KIND>CONCRETE</BSW-ENTRY-KIND>
            </BSW-MODULE-ENTRY>
            <BSW-MODULE-ENTRY UUID="410e7064-f7d1-4df1-9b86-ddc06b541cae">
              <SHORT-NAME>Pwm_Ch63Isr</SHORT-NAME>
              <IS-REENTRANT>false</IS-REENTRANT>
              <IS-SYNCHRONOUS>true</IS-SYNCHRONOUS>
              <CALL-TYPE>INTERRUPT</CALL-TYPE>
              [!IF "as:modconf('Pwm')[1]/PwmGeneral/PwmTypeofInterruptFunction = 'PWM_ISR_CAT2'"!][!//
              <EXECUTION-CONTEXT>INTERRUPT-CAT-2</EXECUTION-CONTEXT>
              [!ELSE!][!//
              <EXECUTION-CONTEXT>INTERRUPT-CAT-1</EXECUTION-CONTEXT>
              [!ENDIF!][!//
              <SW-SERVICE-IMPL-POLICY>STANDARD</SW-SERVICE-IMPL-POLICY>
              <BSW-ENTRY-KIND>CONCRETE</BSW-ENTRY-KIND>
            </BSW-MODULE-ENTRY>
            <BSW-MODULE-ENTRY UUID="a84adbac-4b4e-47d0-bee0-54f4e6397c78">
              <SHORT-NAME>Pwm_Ch64Isr</SHORT-NAME>
              <IS-REENTRANT>false</IS-REENTRANT>
              <IS-SYNCHRONOUS>true</IS-SYNCHRONOUS>
              <CALL-TYPE>INTERRUPT</CALL-TYPE>
              [!IF "as:modconf('Pwm')[1]/PwmGeneral/PwmTypeofInterruptFunction = 'PWM_ISR_CAT2'"!][!//
              <EXECUTION-CONTEXT>INTERRUPT-CAT-2</EXECUTION-CONTEXT>
              [!ELSE!][!//
              <EXECUTION-CONTEXT>INTERRUPT-CAT-1</EXECUTION-CONTEXT>
              [!ENDIF!][!//
              <SW-SERVICE-IMPL-POLICY>STANDARD</SW-SERVICE-IMPL-POLICY>
              <BSW-ENTRY-KIND>CONCRETE</BSW-ENTRY-KIND>
            </BSW-MODULE-ENTRY>
            <BSW-MODULE-ENTRY UUID="8156f3dc-8f2a-4f37-8734-99c4e4b71c23">
              <SHORT-NAME>Pwm_Ch65Isr</SHORT-NAME>
              <IS-REENTRANT>false</IS-REENTRANT>
              <IS-SYNCHRONOUS>true</IS-SYNCHRONOUS>
              <CALL-TYPE>INTERRUPT</CALL-TYPE>
              [!IF "as:modconf('Pwm')[1]/PwmGeneral/PwmTypeofInterruptFunction = 'PWM_ISR_CAT2'"!][!//
              <EXECUTION-CONTEXT>INTERRUPT-CAT-2</EXECUTION-CONTEXT>
              [!ELSE!][!//
              <EXECUTION-CONTEXT>INTERRUPT-CAT-1</EXECUTION-CONTEXT>
              [!ENDIF!][!//
              <SW-SERVICE-IMPL-POLICY>STANDARD</SW-SERVICE-IMPL-POLICY>
              <BSW-ENTRY-KIND>CONCRETE</BSW-ENTRY-KIND>
            </BSW-MODULE-ENTRY>
            <BSW-MODULE-ENTRY UUID="a799eecd-0c22-4ed4-b67c-45c406ca7140">
              <SHORT-NAME>Pwm_Ch66Isr</SHORT-NAME>
              <IS-REENTRANT>false</IS-REENTRANT>
              <IS-SYNCHRONOUS>true</IS-SYNCHRONOUS>
              <CALL-TYPE>INTERRUPT</CALL-TYPE>
              [!IF "as:modconf('Pwm')[1]/PwmGeneral/PwmTypeofInterruptFunction = 'PWM_ISR_CAT2'"!][!//
              <EXECUTION-CONTEXT>INTERRUPT-CAT-2</EXECUTION-CONTEXT>
              [!ELSE!][!//
              <EXECUTION-CONTEXT>INTERRUPT-CAT-1</EXECUTION-CONTEXT>
              [!ENDIF!][!//
              <SW-SERVICE-IMPL-POLICY>STANDARD</SW-SERVICE-IMPL-POLICY>
              <BSW-ENTRY-KIND>CONCRETE</BSW-ENTRY-KIND>
            </BSW-MODULE-ENTRY>
            <BSW-MODULE-ENTRY UUID="4f2cc86b-cc63-4f0c-92e2-05b1c978fcaf">
              <SHORT-NAME>Pwm_Ch67Isr</SHORT-NAME>
              <IS-REENTRANT>false</IS-REENTRANT>
              <IS-SYNCHRONOUS>true</IS-SYNCHRONOUS>
              <CALL-TYPE>INTERRUPT</CALL-TYPE>
              [!IF "as:modconf('Pwm')[1]/PwmGeneral/PwmTypeofInterruptFunction = 'PWM_ISR_CAT2'"!][!//
              <EXECUTION-CONTEXT>INTERRUPT-CAT-2</EXECUTION-CONTEXT>
              [!ELSE!][!//
              <EXECUTION-CONTEXT>INTERRUPT-CAT-1</EXECUTION-CONTEXT>
              [!ENDIF!][!//
              <SW-SERVICE-IMPL-POLICY>STANDARD</SW-SERVICE-IMPL-POLICY>
              <BSW-ENTRY-KIND>CONCRETE</BSW-ENTRY-KIND>
            </BSW-MODULE-ENTRY>
            <BSW-MODULE-ENTRY UUID="37c1facf-8311-4593-a6ac-732954213448">
              <SHORT-NAME>Pwm_Ch68Isr</SHORT-NAME>
              <IS-REENTRANT>false</IS-REENTRANT>
              <IS-SYNCHRONOUS>true</IS-SYNCHRONOUS>
              <CALL-TYPE>INTERRUPT</CALL-TYPE>
              [!IF "as:modconf('Pwm')[1]/PwmGeneral/PwmTypeofInterruptFunction = 'PWM_ISR_CAT2'"!][!//
              <EXECUTION-CONTEXT>INTERRUPT-CAT-2</EXECUTION-CONTEXT>
              [!ELSE!][!//
              <EXECUTION-CONTEXT>INTERRUPT-CAT-1</EXECUTION-CONTEXT>
              [!ENDIF!][!//
              <SW-SERVICE-IMPL-POLICY>STANDARD</SW-SERVICE-IMPL-POLICY>
              <BSW-ENTRY-KIND>CONCRETE</BSW-ENTRY-KIND>
            </BSW-MODULE-ENTRY>
            <BSW-MODULE-ENTRY UUID="87f18642-1cd9-44dd-82db-d7e5716333d9">
              <SHORT-NAME>Pwm_Ch69Isr</SHORT-NAME>
              <IS-REENTRANT>false</IS-REENTRANT>
              <IS-SYNCHRONOUS>true</IS-SYNCHRONOUS>
              <CALL-TYPE>INTERRUPT</CALL-TYPE>
              [!IF "as:modconf('Pwm')[1]/PwmGeneral/PwmTypeofInterruptFunction = 'PWM_ISR_CAT2'"!][!//
              <EXECUTION-CONTEXT>INTERRUPT-CAT-2</EXECUTION-CONTEXT>
              [!ELSE!][!//
              <EXECUTION-CONTEXT>INTERRUPT-CAT-1</EXECUTION-CONTEXT>
              [!ENDIF!][!//
              <SW-SERVICE-IMPL-POLICY>STANDARD</SW-SERVICE-IMPL-POLICY>
              <BSW-ENTRY-KIND>CONCRETE</BSW-ENTRY-KIND>
            </BSW-MODULE-ENTRY>
            <BSW-MODULE-ENTRY UUID="01b193c0-0955-48ba-b2a0-8b26b2130e51">
              <SHORT-NAME>Pwm_Ch6Isr</SHORT-NAME>
              <IS-REENTRANT>false</IS-REENTRANT>
              <IS-SYNCHRONOUS>true</IS-SYNCHRONOUS>
              <CALL-TYPE>INTERRUPT</CALL-TYPE>
              [!IF "as:modconf('Pwm')[1]/PwmGeneral/PwmTypeofInterruptFunction = 'PWM_ISR_CAT2'"!][!//
              <EXECUTION-CONTEXT>INTERRUPT-CAT-2</EXECUTION-CONTEXT>
              [!ELSE!][!//
              <EXECUTION-CONTEXT>INTERRUPT-CAT-1</EXECUTION-CONTEXT>
              [!ENDIF!][!//
              <SW-SERVICE-IMPL-POLICY>STANDARD</SW-SERVICE-IMPL-POLICY>
              <BSW-ENTRY-KIND>CONCRETE</BSW-ENTRY-KIND>
            </BSW-MODULE-ENTRY>
            <BSW-MODULE-ENTRY UUID="41bcb954-f5f7-4cf8-a1a0-f5628c9539eb">
              <SHORT-NAME>Pwm_Ch70Isr</SHORT-NAME>
              <IS-REENTRANT>false</IS-REENTRANT>
              <IS-SYNCHRONOUS>true</IS-SYNCHRONOUS>
              <CALL-TYPE>INTERRUPT</CALL-TYPE>
              [!IF "as:modconf('Pwm')[1]/PwmGeneral/PwmTypeofInterruptFunction = 'PWM_ISR_CAT2'"!][!//
              <EXECUTION-CONTEXT>INTERRUPT-CAT-2</EXECUTION-CONTEXT>
              [!ELSE!][!//
              <EXECUTION-CONTEXT>INTERRUPT-CAT-1</EXECUTION-CONTEXT>
              [!ENDIF!][!//
              <SW-SERVICE-IMPL-POLICY>STANDARD</SW-SERVICE-IMPL-POLICY>
              <BSW-ENTRY-KIND>CONCRETE</BSW-ENTRY-KIND>
            </BSW-MODULE-ENTRY>
            <BSW-MODULE-ENTRY UUID="a827658a-610f-439e-94e0-978dfbc51791">
              <SHORT-NAME>Pwm_Ch71Isr</SHORT-NAME>
              <IS-REENTRANT>false</IS-REENTRANT>
              <IS-SYNCHRONOUS>true</IS-SYNCHRONOUS>
              <CALL-TYPE>INTERRUPT</CALL-TYPE>
              [!IF "as:modconf('Pwm')[1]/PwmGeneral/PwmTypeofInterruptFunction = 'PWM_ISR_CAT2'"!][!//
              <EXECUTION-CONTEXT>INTERRUPT-CAT-2</EXECUTION-CONTEXT>
              [!ELSE!][!//
              <EXECUTION-CONTEXT>INTERRUPT-CAT-1</EXECUTION-CONTEXT>
              [!ENDIF!][!//
              <SW-SERVICE-IMPL-POLICY>STANDARD</SW-SERVICE-IMPL-POLICY>
              <BSW-ENTRY-KIND>CONCRETE</BSW-ENTRY-KIND>
            </BSW-MODULE-ENTRY>
            <BSW-MODULE-ENTRY UUID="470942b4-0d74-40e5-87ae-545c917c559e">
              <SHORT-NAME>Pwm_Ch72Isr</SHORT-NAME>
              <IS-REENTRANT>false</IS-REENTRANT>
              <IS-SYNCHRONOUS>true</IS-SYNCHRONOUS>
              <CALL-TYPE>INTERRUPT</CALL-TYPE>
              [!IF "as:modconf('Pwm')[1]/PwmGeneral/PwmTypeofInterruptFunction = 'PWM_ISR_CAT2'"!][!//
              <EXECUTION-CONTEXT>INTERRUPT-CAT-2</EXECUTION-CONTEXT>
              [!ELSE!][!//
              <EXECUTION-CONTEXT>INTERRUPT-CAT-1</EXECUTION-CONTEXT>
              [!ENDIF!][!//
              <SW-SERVICE-IMPL-POLICY>STANDARD</SW-SERVICE-IMPL-POLICY>
              <BSW-ENTRY-KIND>CONCRETE</BSW-ENTRY-KIND>
            </BSW-MODULE-ENTRY>
            <BSW-MODULE-ENTRY UUID="a7d64f4c-5644-4d34-a26f-824846515e0e">
              <SHORT-NAME>Pwm_Ch73Isr</SHORT-NAME>
              <IS-REENTRANT>false</IS-REENTRANT>
              <IS-SYNCHRONOUS>true</IS-SYNCHRONOUS>
              <CALL-TYPE>INTERRUPT</CALL-TYPE>
              [!IF "as:modconf('Pwm')[1]/PwmGeneral/PwmTypeofInterruptFunction = 'PWM_ISR_CAT2'"!][!//
              <EXECUTION-CONTEXT>INTERRUPT-CAT-2</EXECUTION-CONTEXT>
              [!ELSE!][!//
              <EXECUTION-CONTEXT>INTERRUPT-CAT-1</EXECUTION-CONTEXT>
              [!ENDIF!][!//
              <SW-SERVICE-IMPL-POLICY>STANDARD</SW-SERVICE-IMPL-POLICY>
              <BSW-ENTRY-KIND>CONCRETE</BSW-ENTRY-KIND>
            </BSW-MODULE-ENTRY>
            <BSW-MODULE-ENTRY UUID="421f5ab4-3594-4f94-8d63-7c02c868c401">
              <SHORT-NAME>Pwm_Ch74Isr</SHORT-NAME>
              <IS-REENTRANT>false</IS-REENTRANT>
              <IS-SYNCHRONOUS>true</IS-SYNCHRONOUS>
              <CALL-TYPE>INTERRUPT</CALL-TYPE>
              [!IF "as:modconf('Pwm')[1]/PwmGeneral/PwmTypeofInterruptFunction = 'PWM_ISR_CAT2'"!][!//
              <EXECUTION-CONTEXT>INTERRUPT-CAT-2</EXECUTION-CONTEXT>
              [!ELSE!][!//
              <EXECUTION-CONTEXT>INTERRUPT-CAT-1</EXECUTION-CONTEXT>
              [!ENDIF!][!//
              <SW-SERVICE-IMPL-POLICY>STANDARD</SW-SERVICE-IMPL-POLICY>
              <BSW-ENTRY-KIND>CONCRETE</BSW-ENTRY-KIND>
            </BSW-MODULE-ENTRY>
            <BSW-MODULE-ENTRY UUID="3078c226-45f6-4875-9710-1b2f804e01af">
              <SHORT-NAME>Pwm_Ch75Isr</SHORT-NAME>
              <IS-REENTRANT>false</IS-REENTRANT>
              <IS-SYNCHRONOUS>true</IS-SYNCHRONOUS>
              <CALL-TYPE>INTERRUPT</CALL-TYPE>
              [!IF "as:modconf('Pwm')[1]/PwmGeneral/PwmTypeofInterruptFunction = 'PWM_ISR_CAT2'"!][!//
              <EXECUTION-CONTEXT>INTERRUPT-CAT-2</EXECUTION-CONTEXT>
              [!ELSE!][!//
              <EXECUTION-CONTEXT>INTERRUPT-CAT-1</EXECUTION-CONTEXT>
              [!ENDIF!][!//
              <SW-SERVICE-IMPL-POLICY>STANDARD</SW-SERVICE-IMPL-POLICY>
              <BSW-ENTRY-KIND>CONCRETE</BSW-ENTRY-KIND>
            </BSW-MODULE-ENTRY>
            <BSW-MODULE-ENTRY UUID="11b76bc2-e663-4e16-a263-07645e407114">
              <SHORT-NAME>Pwm_Ch76Isr</SHORT-NAME>
              <IS-REENTRANT>false</IS-REENTRANT>
              <IS-SYNCHRONOUS>true</IS-SYNCHRONOUS>
              <CALL-TYPE>INTERRUPT</CALL-TYPE>
              [!IF "as:modconf('Pwm')[1]/PwmGeneral/PwmTypeofInterruptFunction = 'PWM_ISR_CAT2'"!][!//
              <EXECUTION-CONTEXT>INTERRUPT-CAT-2</EXECUTION-CONTEXT>
              [!ELSE!][!//
              <EXECUTION-CONTEXT>INTERRUPT-CAT-1</EXECUTION-CONTEXT>
              [!ENDIF!][!//
              <SW-SERVICE-IMPL-POLICY>STANDARD</SW-SERVICE-IMPL-POLICY>
              <BSW-ENTRY-KIND>CONCRETE</BSW-ENTRY-KIND>
            </BSW-MODULE-ENTRY>
            <BSW-MODULE-ENTRY UUID="e37c4c5e-d177-46d4-acae-69cac2982acf">
              <SHORT-NAME>Pwm_Ch77Isr</SHORT-NAME>
              <IS-REENTRANT>false</IS-REENTRANT>
              <IS-SYNCHRONOUS>true</IS-SYNCHRONOUS>
              <CALL-TYPE>INTERRUPT</CALL-TYPE>
              [!IF "as:modconf('Pwm')[1]/PwmGeneral/PwmTypeofInterruptFunction = 'PWM_ISR_CAT2'"!][!//
              <EXECUTION-CONTEXT>INTERRUPT-CAT-2</EXECUTION-CONTEXT>
              [!ELSE!][!//
              <EXECUTION-CONTEXT>INTERRUPT-CAT-1</EXECUTION-CONTEXT>
              [!ENDIF!][!//
              <SW-SERVICE-IMPL-POLICY>STANDARD</SW-SERVICE-IMPL-POLICY>
              <BSW-ENTRY-KIND>CONCRETE</BSW-ENTRY-KIND>
            </BSW-MODULE-ENTRY>
            <BSW-MODULE-ENTRY UUID="70021b03-b4a1-4063-a3ef-6bf8ac1f27ac">
              <SHORT-NAME>Pwm_Ch78Isr</SHORT-NAME>
              <IS-REENTRANT>false</IS-REENTRANT>
              <IS-SYNCHRONOUS>true</IS-SYNCHRONOUS>
              <CALL-TYPE>INTERRUPT</CALL-TYPE>
              [!IF "as:modconf('Pwm')[1]/PwmGeneral/PwmTypeofInterruptFunction = 'PWM_ISR_CAT2'"!][!//
              <EXECUTION-CONTEXT>INTERRUPT-CAT-2</EXECUTION-CONTEXT>
              [!ELSE!][!//
              <EXECUTION-CONTEXT>INTERRUPT-CAT-1</EXECUTION-CONTEXT>
              [!ENDIF!][!//
              <SW-SERVICE-IMPL-POLICY>STANDARD</SW-SERVICE-IMPL-POLICY>
              <BSW-ENTRY-KIND>CONCRETE</BSW-ENTRY-KIND>
            </BSW-MODULE-ENTRY>
            <BSW-MODULE-ENTRY UUID="b75b3313-4f88-43f8-aa89-3ecb0b8f379c">
              <SHORT-NAME>Pwm_Ch79Isr</SHORT-NAME>
              <IS-REENTRANT>false</IS-REENTRANT>
              <IS-SYNCHRONOUS>true</IS-SYNCHRONOUS>
              <CALL-TYPE>INTERRUPT</CALL-TYPE>
              [!IF "as:modconf('Pwm')[1]/PwmGeneral/PwmTypeofInterruptFunction = 'PWM_ISR_CAT2'"!][!//
              <EXECUTION-CONTEXT>INTERRUPT-CAT-2</EXECUTION-CONTEXT>
              [!ELSE!][!//
              <EXECUTION-CONTEXT>INTERRUPT-CAT-1</EXECUTION-CONTEXT>
              [!ENDIF!][!//
              <SW-SERVICE-IMPL-POLICY>STANDARD</SW-SERVICE-IMPL-POLICY>
              <BSW-ENTRY-KIND>CONCRETE</BSW-ENTRY-KIND>
            </BSW-MODULE-ENTRY>
            <BSW-MODULE-ENTRY UUID="e7f0c5b5-59a6-4ede-a1f5-567d7acd0756">
              <SHORT-NAME>Pwm_Ch7Isr</SHORT-NAME>
              <IS-REENTRANT>false</IS-REENTRANT>
              <IS-SYNCHRONOUS>true</IS-SYNCHRONOUS>
              <CALL-TYPE>INTERRUPT</CALL-TYPE>
              [!IF "as:modconf('Pwm')[1]/PwmGeneral/PwmTypeofInterruptFunction = 'PWM_ISR_CAT2'"!][!//
              <EXECUTION-CONTEXT>INTERRUPT-CAT-2</EXECUTION-CONTEXT>
              [!ELSE!][!//
              <EXECUTION-CONTEXT>INTERRUPT-CAT-1</EXECUTION-CONTEXT>
              [!ENDIF!][!//
              <SW-SERVICE-IMPL-POLICY>STANDARD</SW-SERVICE-IMPL-POLICY>
              <BSW-ENTRY-KIND>CONCRETE</BSW-ENTRY-KIND>
            </BSW-MODULE-ENTRY>
            <BSW-MODULE-ENTRY UUID="8e3036bc-c292-4981-bad3-985bb504df05">
              <SHORT-NAME>Pwm_Ch80Isr</SHORT-NAME>
              <IS-REENTRANT>false</IS-REENTRANT>
              <IS-SYNCHRONOUS>true</IS-SYNCHRONOUS>
              <CALL-TYPE>INTERRUPT</CALL-TYPE>
              [!IF "as:modconf('Pwm')[1]/PwmGeneral/PwmTypeofInterruptFunction = 'PWM_ISR_CAT2'"!][!//
              <EXECUTION-CONTEXT>INTERRUPT-CAT-2</EXECUTION-CONTEXT>
              [!ELSE!][!//
              <EXECUTION-CONTEXT>INTERRUPT-CAT-1</EXECUTION-CONTEXT>
              [!ENDIF!][!//
              <SW-SERVICE-IMPL-POLICY>STANDARD</SW-SERVICE-IMPL-POLICY>
              <BSW-ENTRY-KIND>CONCRETE</BSW-ENTRY-KIND>
            </BSW-MODULE-ENTRY>
            <BSW-MODULE-ENTRY UUID="2b7a829f-318c-4c2b-beb0-ff1d8bb2ace8">
              <SHORT-NAME>Pwm_Ch81Isr</SHORT-NAME>
              <IS-REENTRANT>false</IS-REENTRANT>
              <IS-SYNCHRONOUS>true</IS-SYNCHRONOUS>
              <CALL-TYPE>INTERRUPT</CALL-TYPE>
              [!IF "as:modconf('Pwm')[1]/PwmGeneral/PwmTypeofInterruptFunction = 'PWM_ISR_CAT2'"!][!//
              <EXECUTION-CONTEXT>INTERRUPT-CAT-2</EXECUTION-CONTEXT>
              [!ELSE!][!//
              <EXECUTION-CONTEXT>INTERRUPT-CAT-1</EXECUTION-CONTEXT>
              [!ENDIF!][!//
              <SW-SERVICE-IMPL-POLICY>STANDARD</SW-SERVICE-IMPL-POLICY>
              <BSW-ENTRY-KIND>CONCRETE</BSW-ENTRY-KIND>
            </BSW-MODULE-ENTRY>
            <BSW-MODULE-ENTRY UUID="c3da1ce2-8c10-478c-a1ec-675d7ee6d57b">
              <SHORT-NAME>Pwm_Ch82Isr</SHORT-NAME>
              <IS-REENTRANT>false</IS-REENTRANT>
              <IS-SYNCHRONOUS>true</IS-SYNCHRONOUS>
              <CALL-TYPE>INTERRUPT</CALL-TYPE>
              [!IF "as:modconf('Pwm')[1]/PwmGeneral/PwmTypeofInterruptFunction = 'PWM_ISR_CAT2'"!][!//
              <EXECUTION-CONTEXT>INTERRUPT-CAT-2</EXECUTION-CONTEXT>
              [!ELSE!][!//
              <EXECUTION-CONTEXT>INTERRUPT-CAT-1</EXECUTION-CONTEXT>
              [!ENDIF!][!//
              <SW-SERVICE-IMPL-POLICY>STANDARD</SW-SERVICE-IMPL-POLICY>
              <BSW-ENTRY-KIND>CONCRETE</BSW-ENTRY-KIND>
            </BSW-MODULE-ENTRY>
            <BSW-MODULE-ENTRY UUID="38b146ac-4bef-464c-be21-f86971d251ca">
              <SHORT-NAME>Pwm_Ch83Isr</SHORT-NAME>
              <IS-REENTRANT>false</IS-REENTRANT>
              <IS-SYNCHRONOUS>true</IS-SYNCHRONOUS>
              <CALL-TYPE>INTERRUPT</CALL-TYPE>
              [!IF "as:modconf('Pwm')[1]/PwmGeneral/PwmTypeofInterruptFunction = 'PWM_ISR_CAT2'"!][!//
              <EXECUTION-CONTEXT>INTERRUPT-CAT-2</EXECUTION-CONTEXT>
              [!ELSE!][!//
              <EXECUTION-CONTEXT>INTERRUPT-CAT-1</EXECUTION-CONTEXT>
              [!ENDIF!][!//
              <SW-SERVICE-IMPL-POLICY>STANDARD</SW-SERVICE-IMPL-POLICY>
              <BSW-ENTRY-KIND>CONCRETE</BSW-ENTRY-KIND>
            </BSW-MODULE-ENTRY>
            <BSW-MODULE-ENTRY UUID="f67f0a12-5c84-4dfa-908e-9124687872ef">
              <SHORT-NAME>Pwm_Ch84Isr</SHORT-NAME>
              <IS-REENTRANT>false</IS-REENTRANT>
              <IS-SYNCHRONOUS>true</IS-SYNCHRONOUS>
              <CALL-TYPE>INTERRUPT</CALL-TYPE>
              [!IF "as:modconf('Pwm')[1]/PwmGeneral/PwmTypeofInterruptFunction = 'PWM_ISR_CAT2'"!][!//
              <EXECUTION-CONTEXT>INTERRUPT-CAT-2</EXECUTION-CONTEXT>
              [!ELSE!][!//
              <EXECUTION-CONTEXT>INTERRUPT-CAT-1</EXECUTION-CONTEXT>
              [!ENDIF!][!//
              <SW-SERVICE-IMPL-POLICY>STANDARD</SW-SERVICE-IMPL-POLICY>
              <BSW-ENTRY-KIND>CONCRETE</BSW-ENTRY-KIND>
            </BSW-MODULE-ENTRY>
            <BSW-MODULE-ENTRY UUID="1759047f-b640-4c62-9619-8f4bebc434d1">
              <SHORT-NAME>Pwm_Ch85Isr</SHORT-NAME>
              <IS-REENTRANT>false</IS-REENTRANT>
              <IS-SYNCHRONOUS>true</IS-SYNCHRONOUS>
              <CALL-TYPE>INTERRUPT</CALL-TYPE>
              [!IF "as:modconf('Pwm')[1]/PwmGeneral/PwmTypeofInterruptFunction = 'PWM_ISR_CAT2'"!][!//
              <EXECUTION-CONTEXT>INTERRUPT-CAT-2</EXECUTION-CONTEXT>
              [!ELSE!][!//
              <EXECUTION-CONTEXT>INTERRUPT-CAT-1</EXECUTION-CONTEXT>
              [!ENDIF!][!//
              <SW-SERVICE-IMPL-POLICY>STANDARD</SW-SERVICE-IMPL-POLICY>
              <BSW-ENTRY-KIND>CONCRETE</BSW-ENTRY-KIND>
            </BSW-MODULE-ENTRY>
            <BSW-MODULE-ENTRY UUID="5895567f-bc19-4e5d-be33-e8497619cd90">
              <SHORT-NAME>Pwm_Ch86Isr</SHORT-NAME>
              <IS-REENTRANT>false</IS-REENTRANT>
              <IS-SYNCHRONOUS>true</IS-SYNCHRONOUS>
              <CALL-TYPE>INTERRUPT</CALL-TYPE>
              [!IF "as:modconf('Pwm')[1]/PwmGeneral/PwmTypeofInterruptFunction = 'PWM_ISR_CAT2'"!][!//
              <EXECUTION-CONTEXT>INTERRUPT-CAT-2</EXECUTION-CONTEXT>
              [!ELSE!][!//
              <EXECUTION-CONTEXT>INTERRUPT-CAT-1</EXECUTION-CONTEXT>
              [!ENDIF!][!//
              <SW-SERVICE-IMPL-POLICY>STANDARD</SW-SERVICE-IMPL-POLICY>
              <BSW-ENTRY-KIND>CONCRETE</BSW-ENTRY-KIND>
            </BSW-MODULE-ENTRY>
            <BSW-MODULE-ENTRY UUID="31ae9413-3eb2-416a-b703-487e9a7c8ccd">
              <SHORT-NAME>Pwm_Ch87Isr</SHORT-NAME>
              <IS-REENTRANT>false</IS-REENTRANT>
              <IS-SYNCHRONOUS>true</IS-SYNCHRONOUS>
              <CALL-TYPE>INTERRUPT</CALL-TYPE>
              [!IF "as:modconf('Pwm')[1]/PwmGeneral/PwmTypeofInterruptFunction = 'PWM_ISR_CAT2'"!][!//
              <EXECUTION-CONTEXT>INTERRUPT-CAT-2</EXECUTION-CONTEXT>
              [!ELSE!][!//
              <EXECUTION-CONTEXT>INTERRUPT-CAT-1</EXECUTION-CONTEXT>
              [!ENDIF!][!//
              <SW-SERVICE-IMPL-POLICY>STANDARD</SW-SERVICE-IMPL-POLICY>
              <BSW-ENTRY-KIND>CONCRETE</BSW-ENTRY-KIND>
            </BSW-MODULE-ENTRY>
            <BSW-MODULE-ENTRY UUID="a24c425b-e8f8-4ac1-9fa7-19ac96fb066f">
              <SHORT-NAME>Pwm_Ch88Isr</SHORT-NAME>
              <IS-REENTRANT>false</IS-REENTRANT>
              <IS-SYNCHRONOUS>true</IS-SYNCHRONOUS>
              <CALL-TYPE>INTERRUPT</CALL-TYPE>
              [!IF "as:modconf('Pwm')[1]/PwmGeneral/PwmTypeofInterruptFunction = 'PWM_ISR_CAT2'"!][!//
              <EXECUTION-CONTEXT>INTERRUPT-CAT-2</EXECUTION-CONTEXT>
              [!ELSE!][!//
              <EXECUTION-CONTEXT>INTERRUPT-CAT-1</EXECUTION-CONTEXT>
              [!ENDIF!][!//
              <SW-SERVICE-IMPL-POLICY>STANDARD</SW-SERVICE-IMPL-POLICY>
              <BSW-ENTRY-KIND>CONCRETE</BSW-ENTRY-KIND>
            </BSW-MODULE-ENTRY>
            <BSW-MODULE-ENTRY UUID="d4578b3e-e949-4f82-a3a5-2a952402a685">
              <SHORT-NAME>Pwm_Ch89Isr</SHORT-NAME>
              <IS-REENTRANT>false</IS-REENTRANT>
              <IS-SYNCHRONOUS>true</IS-SYNCHRONOUS>
              <CALL-TYPE>INTERRUPT</CALL-TYPE>
              [!IF "as:modconf('Pwm')[1]/PwmGeneral/PwmTypeofInterruptFunction = 'PWM_ISR_CAT2'"!][!//
              <EXECUTION-CONTEXT>INTERRUPT-CAT-2</EXECUTION-CONTEXT>
              [!ELSE!][!//
              <EXECUTION-CONTEXT>INTERRUPT-CAT-1</EXECUTION-CONTEXT>
              [!ENDIF!][!//
              <SW-SERVICE-IMPL-POLICY>STANDARD</SW-SERVICE-IMPL-POLICY>
              <BSW-ENTRY-KIND>CONCRETE</BSW-ENTRY-KIND>
            </BSW-MODULE-ENTRY>
            <BSW-MODULE-ENTRY UUID="290c7ba9-5e6b-4b49-8ab3-655b354f7648">
              <SHORT-NAME>Pwm_Ch8Isr</SHORT-NAME>
              <IS-REENTRANT>false</IS-REENTRANT>
              <IS-SYNCHRONOUS>true</IS-SYNCHRONOUS>
              <CALL-TYPE>INTERRUPT</CALL-TYPE>
              [!IF "as:modconf('Pwm')[1]/PwmGeneral/PwmTypeofInterruptFunction = 'PWM_ISR_CAT2'"!][!//
              <EXECUTION-CONTEXT>INTERRUPT-CAT-2</EXECUTION-CONTEXT>
              [!ELSE!][!//
              <EXECUTION-CONTEXT>INTERRUPT-CAT-1</EXECUTION-CONTEXT>
              [!ENDIF!][!//
              <SW-SERVICE-IMPL-POLICY>STANDARD</SW-SERVICE-IMPL-POLICY>
              <BSW-ENTRY-KIND>CONCRETE</BSW-ENTRY-KIND>
            </BSW-MODULE-ENTRY>
            <BSW-MODULE-ENTRY UUID="f778cbcf-5a14-49c6-acff-79168a703991">
              <SHORT-NAME>Pwm_Ch90Isr</SHORT-NAME>
              <IS-REENTRANT>false</IS-REENTRANT>
              <IS-SYNCHRONOUS>true</IS-SYNCHRONOUS>
              <CALL-TYPE>INTERRUPT</CALL-TYPE>
              [!IF "as:modconf('Pwm')[1]/PwmGeneral/PwmTypeofInterruptFunction = 'PWM_ISR_CAT2'"!][!//
              <EXECUTION-CONTEXT>INTERRUPT-CAT-2</EXECUTION-CONTEXT>
              [!ELSE!][!//
              <EXECUTION-CONTEXT>INTERRUPT-CAT-1</EXECUTION-CONTEXT>
              [!ENDIF!][!//
              <SW-SERVICE-IMPL-POLICY>STANDARD</SW-SERVICE-IMPL-POLICY>
              <BSW-ENTRY-KIND>CONCRETE</BSW-ENTRY-KIND>
            </BSW-MODULE-ENTRY>
            <BSW-MODULE-ENTRY UUID="19337beb-f253-4c4e-ae1f-9601089a6702">
              <SHORT-NAME>Pwm_Ch91Isr</SHORT-NAME>
              <IS-REENTRANT>false</IS-REENTRANT>
              <IS-SYNCHRONOUS>true</IS-SYNCHRONOUS>
              <CALL-TYPE>INTERRUPT</CALL-TYPE>
              [!IF "as:modconf('Pwm')[1]/PwmGeneral/PwmTypeofInterruptFunction = 'PWM_ISR_CAT2'"!][!//
              <EXECUTION-CONTEXT>INTERRUPT-CAT-2</EXECUTION-CONTEXT>
              [!ELSE!][!//
              <EXECUTION-CONTEXT>INTERRUPT-CAT-1</EXECUTION-CONTEXT>
              [!ENDIF!][!//
              <SW-SERVICE-IMPL-POLICY>STANDARD</SW-SERVICE-IMPL-POLICY>
              <BSW-ENTRY-KIND>CONCRETE</BSW-ENTRY-KIND>
            </BSW-MODULE-ENTRY>
            <BSW-MODULE-ENTRY UUID="51116c13-1faf-4984-9023-78e9311ab5a2">
              <SHORT-NAME>Pwm_Ch92Isr</SHORT-NAME>
              <IS-REENTRANT>false</IS-REENTRANT>
              <IS-SYNCHRONOUS>true</IS-SYNCHRONOUS>
              <CALL-TYPE>INTERRUPT</CALL-TYPE>
              [!IF "as:modconf('Pwm')[1]/PwmGeneral/PwmTypeofInterruptFunction = 'PWM_ISR_CAT2'"!][!//
              <EXECUTION-CONTEXT>INTERRUPT-CAT-2</EXECUTION-CONTEXT>
              [!ELSE!][!//
              <EXECUTION-CONTEXT>INTERRUPT-CAT-1</EXECUTION-CONTEXT>
              [!ENDIF!][!//
              <SW-SERVICE-IMPL-POLICY>STANDARD</SW-SERVICE-IMPL-POLICY>
              <BSW-ENTRY-KIND>CONCRETE</BSW-ENTRY-KIND>
            </BSW-MODULE-ENTRY>
            <BSW-MODULE-ENTRY UUID="fecb6474-7ac5-4684-a372-07c77be8af70">
              <SHORT-NAME>Pwm_Ch93Isr</SHORT-NAME>
              <IS-REENTRANT>false</IS-REENTRANT>
              <IS-SYNCHRONOUS>true</IS-SYNCHRONOUS>
              <CALL-TYPE>INTERRUPT</CALL-TYPE>
              [!IF "as:modconf('Pwm')[1]/PwmGeneral/PwmTypeofInterruptFunction = 'PWM_ISR_CAT2'"!][!//
              <EXECUTION-CONTEXT>INTERRUPT-CAT-2</EXECUTION-CONTEXT>
              [!ELSE!][!//
              <EXECUTION-CONTEXT>INTERRUPT-CAT-1</EXECUTION-CONTEXT>
              [!ENDIF!][!//
              <SW-SERVICE-IMPL-POLICY>STANDARD</SW-SERVICE-IMPL-POLICY>
              <BSW-ENTRY-KIND>CONCRETE</BSW-ENTRY-KIND>
            </BSW-MODULE-ENTRY>
            <BSW-MODULE-ENTRY UUID="0d8a6baa-2acb-4c4b-9f67-3883b61bf5c6">
              <SHORT-NAME>Pwm_Ch94Isr</SHORT-NAME>
              <IS-REENTRANT>false</IS-REENTRANT>
              <IS-SYNCHRONOUS>true</IS-SYNCHRONOUS>
              <CALL-TYPE>INTERRUPT</CALL-TYPE>
              [!IF "as:modconf('Pwm')[1]/PwmGeneral/PwmTypeofInterruptFunction = 'PWM_ISR_CAT2'"!][!//
              <EXECUTION-CONTEXT>INTERRUPT-CAT-2</EXECUTION-CONTEXT>
              [!ELSE!][!//
              <EXECUTION-CONTEXT>INTERRUPT-CAT-1</EXECUTION-CONTEXT>
              [!ENDIF!][!//
              <SW-SERVICE-IMPL-POLICY>STANDARD</SW-SERVICE-IMPL-POLICY>
              <BSW-ENTRY-KIND>CONCRETE</BSW-ENTRY-KIND>
            </BSW-MODULE-ENTRY>
            <BSW-MODULE-ENTRY UUID="d0765beb-773d-492d-b7d5-f89a0cb6d1b4">
              <SHORT-NAME>Pwm_Ch95Isr</SHORT-NAME>
              <IS-REENTRANT>false</IS-REENTRANT>
              <IS-SYNCHRONOUS>true</IS-SYNCHRONOUS>
              <CALL-TYPE>INTERRUPT</CALL-TYPE>
              [!IF "as:modconf('Pwm')[1]/PwmGeneral/PwmTypeofInterruptFunction = 'PWM_ISR_CAT2'"!][!//
              <EXECUTION-CONTEXT>INTERRUPT-CAT-2</EXECUTION-CONTEXT>
              [!ELSE!][!//
              <EXECUTION-CONTEXT>INTERRUPT-CAT-1</EXECUTION-CONTEXT>
              [!ENDIF!][!//
              <SW-SERVICE-IMPL-POLICY>STANDARD</SW-SERVICE-IMPL-POLICY>
              <BSW-ENTRY-KIND>CONCRETE</BSW-ENTRY-KIND>
            </BSW-MODULE-ENTRY>
            <BSW-MODULE-ENTRY UUID="2911c02a-8806-4ac6-9d0a-092b35d0c4f2">
              <SHORT-NAME>Pwm_Ch96Isr</SHORT-NAME>
              <IS-REENTRANT>false</IS-REENTRANT>
              <IS-SYNCHRONOUS>true</IS-SYNCHRONOUS>
              <CALL-TYPE>INTERRUPT</CALL-TYPE>
              [!IF "as:modconf('Pwm')[1]/PwmGeneral/PwmTypeofInterruptFunction = 'PWM_ISR_CAT2'"!][!//
              <EXECUTION-CONTEXT>INTERRUPT-CAT-2</EXECUTION-CONTEXT>
              [!ELSE!][!//
              <EXECUTION-CONTEXT>INTERRUPT-CAT-1</EXECUTION-CONTEXT>
              [!ENDIF!][!//
              <SW-SERVICE-IMPL-POLICY>STANDARD</SW-SERVICE-IMPL-POLICY>
              <BSW-ENTRY-KIND>CONCRETE</BSW-ENTRY-KIND>
            </BSW-MODULE-ENTRY>
            <BSW-MODULE-ENTRY UUID="697b36b9-82dd-43d8-99b5-80cd110e8c4e">
              <SHORT-NAME>Pwm_Ch97Isr</SHORT-NAME>
              <IS-REENTRANT>false</IS-REENTRANT>
              <IS-SYNCHRONOUS>true</IS-SYNCHRONOUS>
              <CALL-TYPE>INTERRUPT</CALL-TYPE>
              [!IF "as:modconf('Pwm')[1]/PwmGeneral/PwmTypeofInterruptFunction = 'PWM_ISR_CAT2'"!][!//
              <EXECUTION-CONTEXT>INTERRUPT-CAT-2</EXECUTION-CONTEXT>
              [!ELSE!][!//
              <EXECUTION-CONTEXT>INTERRUPT-CAT-1</EXECUTION-CONTEXT>
              [!ENDIF!][!//
              <SW-SERVICE-IMPL-POLICY>STANDARD</SW-SERVICE-IMPL-POLICY>
              <BSW-ENTRY-KIND>CONCRETE</BSW-ENTRY-KIND>
            </BSW-MODULE-ENTRY>
            <BSW-MODULE-ENTRY UUID="fc559e32-79a5-42f6-a6f6-69c229e9fb59">
              <SHORT-NAME>Pwm_Ch98Isr</SHORT-NAME>
              <IS-REENTRANT>false</IS-REENTRANT>
              <IS-SYNCHRONOUS>true</IS-SYNCHRONOUS>
              <CALL-TYPE>INTERRUPT</CALL-TYPE>
              [!IF "as:modconf('Pwm')[1]/PwmGeneral/PwmTypeofInterruptFunction = 'PWM_ISR_CAT2'"!][!//
              <EXECUTION-CONTEXT>INTERRUPT-CAT-2</EXECUTION-CONTEXT>
              [!ELSE!][!//
              <EXECUTION-CONTEXT>INTERRUPT-CAT-1</EXECUTION-CONTEXT>
              [!ENDIF!][!//
              <SW-SERVICE-IMPL-POLICY>STANDARD</SW-SERVICE-IMPL-POLICY>
              <BSW-ENTRY-KIND>CONCRETE</BSW-ENTRY-KIND>
            </BSW-MODULE-ENTRY>
            <BSW-MODULE-ENTRY UUID="21841ef6-1fdd-45f3-bc88-2e671dc49efd">
              <SHORT-NAME>Pwm_Ch99Isr</SHORT-NAME>
              <IS-REENTRANT>false</IS-REENTRANT>
              <IS-SYNCHRONOUS>true</IS-SYNCHRONOUS>
              <CALL-TYPE>INTERRUPT</CALL-TYPE>
              [!IF "as:modconf('Pwm')[1]/PwmGeneral/PwmTypeofInterruptFunction = 'PWM_ISR_CAT2'"!][!//
              <EXECUTION-CONTEXT>INTERRUPT-CAT-2</EXECUTION-CONTEXT>
              [!ELSE!][!//
              <EXECUTION-CONTEXT>INTERRUPT-CAT-1</EXECUTION-CONTEXT>
              [!ENDIF!][!//
              <SW-SERVICE-IMPL-POLICY>STANDARD</SW-SERVICE-IMPL-POLICY>
              <BSW-ENTRY-KIND>CONCRETE</BSW-ENTRY-KIND>
            </BSW-MODULE-ENTRY>
            <BSW-MODULE-ENTRY UUID="0ff2262e-dff8-449d-b701-948af0003093">
              <SHORT-NAME>Pwm_Ch9Isr</SHORT-NAME>
              <IS-REENTRANT>false</IS-REENTRANT>
              <IS-SYNCHRONOUS>true</IS-SYNCHRONOUS>
              <CALL-TYPE>INTERRUPT</CALL-TYPE>
              [!IF "as:modconf('Pwm')[1]/PwmGeneral/PwmTypeofInterruptFunction = 'PWM_ISR_CAT2'"!][!//
              <EXECUTION-CONTEXT>INTERRUPT-CAT-2</EXECUTION-CONTEXT>
              [!ELSE!][!//
              <EXECUTION-CONTEXT>INTERRUPT-CAT-1</EXECUTION-CONTEXT>
              [!ENDIF!][!//
              <SW-SERVICE-IMPL-POLICY>STANDARD</SW-SERVICE-IMPL-POLICY>
              <BSW-ENTRY-KIND>CONCRETE</BSW-ENTRY-KIND>
            </BSW-MODULE-ENTRY>
            <BSW-MODULE-ENTRY UUID="20b72aee-1f25-4b7e-bbd8-434498b30967">
              <SHORT-NAME>Pwm_DeInit</SHORT-NAME>
              <SERVICE-ID>1</SERVICE-ID>
              <IS-REENTRANT>false</IS-REENTRANT>
              <IS-SYNCHRONOUS>true</IS-SYNCHRONOUS>
              <CALL-TYPE>REGULAR</CALL-TYPE>
              <EXECUTION-CONTEXT>UNSPECIFIED</EXECUTION-CONTEXT>
              <SW-SERVICE-IMPL-POLICY>STANDARD</SW-SERVICE-IMPL-POLICY>
              <BSW-ENTRY-KIND>CONCRETE</BSW-ENTRY-KIND>
            </BSW-MODULE-ENTRY>
            <BSW-MODULE-ENTRY UUID="4dc56375-51e0-4974-aeb3-9df566238f6a">
              <SHORT-NAME>Pwm_DisableNotification</SHORT-NAME>
              <SERVICE-ID>6</SERVICE-ID>
              <IS-REENTRANT>true</IS-REENTRANT>
              <IS-SYNCHRONOUS>true</IS-SYNCHRONOUS>
              <CALL-TYPE>REGULAR</CALL-TYPE>
              <EXECUTION-CONTEXT>UNSPECIFIED</EXECUTION-CONTEXT>
              <SW-SERVICE-IMPL-POLICY>STANDARD</SW-SERVICE-IMPL-POLICY>
              <BSW-ENTRY-KIND>CONCRETE</BSW-ENTRY-KIND>
            </BSW-MODULE-ENTRY>
            <BSW-MODULE-ENTRY UUID="7fc44031-f7c0-452b-b400-c0e63282d65c">
              <SHORT-NAME>Pwm_EnableNotification</SHORT-NAME>
              <SERVICE-ID>7</SERVICE-ID>
              <IS-REENTRANT>true</IS-REENTRANT>
              <IS-SYNCHRONOUS>true</IS-SYNCHRONOUS>
              <CALL-TYPE>REGULAR</CALL-TYPE>
              <EXECUTION-CONTEXT>UNSPECIFIED</EXECUTION-CONTEXT>
              <SW-SERVICE-IMPL-POLICY>STANDARD</SW-SERVICE-IMPL-POLICY>
              <BSW-ENTRY-KIND>CONCRETE</BSW-ENTRY-KIND>
            </BSW-MODULE-ENTRY>
            <BSW-MODULE-ENTRY UUID="5567d779-53b0-498d-847a-85ed48e5013b">
              <SHORT-NAME>Pwm_GetOutputState</SHORT-NAME>
              <SERVICE-ID>5</SERVICE-ID>
              <IS-REENTRANT>true</IS-REENTRANT>
              <IS-SYNCHRONOUS>true</IS-SYNCHRONOUS>
              <CALL-TYPE>REGULAR</CALL-TYPE>
              <EXECUTION-CONTEXT>UNSPECIFIED</EXECUTION-CONTEXT>
              <SW-SERVICE-IMPL-POLICY>STANDARD</SW-SERVICE-IMPL-POLICY>
              <BSW-ENTRY-KIND>CONCRETE</BSW-ENTRY-KIND>
            </BSW-MODULE-ENTRY>
            <BSW-MODULE-ENTRY UUID="70fd6bbd-fb5d-4e74-bfaa-f0f62238b72e">
              <SHORT-NAME>Pwm_GetVersionInfo</SHORT-NAME>
              <SERVICE-ID>8</SERVICE-ID>
              <IS-REENTRANT>true</IS-REENTRANT>
              <IS-SYNCHRONOUS>true</IS-SYNCHRONOUS>
              <CALL-TYPE>REGULAR</CALL-TYPE>
              <EXECUTION-CONTEXT>UNSPECIFIED</EXECUTION-CONTEXT>
              <SW-SERVICE-IMPL-POLICY>STANDARD</SW-SERVICE-IMPL-POLICY>
              <BSW-ENTRY-KIND>CONCRETE</BSW-ENTRY-KIND>
            </BSW-MODULE-ENTRY>
            <BSW-MODULE-ENTRY UUID="83c6dd95-a87b-4b9c-8e9e-770025ca9555">
              <SHORT-NAME>Pwm_Init</SHORT-NAME>
              <SERVICE-ID>0</SERVICE-ID>
              <IS-REENTRANT>false</IS-REENTRANT>
              <IS-SYNCHRONOUS>true</IS-SYNCHRONOUS>
              <CALL-TYPE>REGULAR</CALL-TYPE>
              <EXECUTION-CONTEXT>UNSPECIFIED</EXECUTION-CONTEXT>
              <SW-SERVICE-IMPL-POLICY>STANDARD</SW-SERVICE-IMPL-POLICY>
              <BSW-ENTRY-KIND>CONCRETE</BSW-ENTRY-KIND>
            </BSW-MODULE-ENTRY>
            <BSW-MODULE-ENTRY UUID="936f28f8-e85a-42ca-be00-3adbfe837227">
              <SHORT-NAME>Pwm_RegisterReadback</SHORT-NAME>
              <SERVICE-ID>7</SERVICE-ID>
              <IS-REENTRANT>true</IS-REENTRANT>
              <IS-SYNCHRONOUS>false</IS-SYNCHRONOUS>
              <CALL-TYPE>REGULAR</CALL-TYPE>
              <EXECUTION-CONTEXT>UNSPECIFIED</EXECUTION-CONTEXT>
              <SW-SERVICE-IMPL-POLICY>STANDARD</SW-SERVICE-IMPL-POLICY>
              <BSW-ENTRY-KIND>CONCRETE</BSW-ENTRY-KIND>
            </BSW-MODULE-ENTRY>
            <BSW-MODULE-ENTRY UUID="564cac9f-ab85-4437-bd80-68d00fac1961">
              <SHORT-NAME>Pwm_SetDutyCycle</SHORT-NAME>
              <SERVICE-ID>2</SERVICE-ID>
              <IS-REENTRANT>true</IS-REENTRANT>
              <IS-SYNCHRONOUS>true</IS-SYNCHRONOUS>
              <CALL-TYPE>REGULAR</CALL-TYPE>
              <EXECUTION-CONTEXT>UNSPECIFIED</EXECUTION-CONTEXT>
              <SW-SERVICE-IMPL-POLICY>STANDARD</SW-SERVICE-IMPL-POLICY>
              <BSW-ENTRY-KIND>CONCRETE</BSW-ENTRY-KIND>
            </BSW-MODULE-ENTRY>
            <BSW-MODULE-ENTRY UUID="9bf996e8-2e3e-4d7d-afc9-c622eeafa1cc">
              <SHORT-NAME>Pwm_SetOutputToIdle</SHORT-NAME>
              <SERVICE-ID>4</SERVICE-ID>
              <IS-REENTRANT>true</IS-REENTRANT>
              <IS-SYNCHRONOUS>true</IS-SYNCHRONOUS>
              <CALL-TYPE>REGULAR</CALL-TYPE>
              <EXECUTION-CONTEXT>UNSPECIFIED</EXECUTION-CONTEXT>
              <SW-SERVICE-IMPL-POLICY>STANDARD</SW-SERVICE-IMPL-POLICY>
              <BSW-ENTRY-KIND>CONCRETE</BSW-ENTRY-KIND>
            </BSW-MODULE-ENTRY>
            <BSW-MODULE-ENTRY UUID="662b666c-b533-40ec-b416-c829d6e7958c">
              <SHORT-NAME>Pwm_SetPeriodAndDuty</SHORT-NAME>
              <SERVICE-ID>3</SERVICE-ID>
              <IS-REENTRANT>true</IS-REENTRANT>
              <IS-SYNCHRONOUS>true</IS-SYNCHRONOUS>
              <CALL-TYPE>REGULAR</CALL-TYPE>
              <EXECUTION-CONTEXT>UNSPECIFIED</EXECUTION-CONTEXT>
              <SW-SERVICE-IMPL-POLICY>STANDARD</SW-SERVICE-IMPL-POLICY>
              <BSW-ENTRY-KIND>CONCRETE</BSW-ENTRY-KIND>
            </BSW-MODULE-ENTRY>
          </ELEMENTS>
        </AR-PACKAGE>
      </AR-PACKAGES>
    </AR-PACKAGE>
  </AR-PACKAGES>
</AUTOSAR>
