[part 1 of 2]
<?xml version="1.0" encoding="UTF-8"?>
[!AUTOSPACING!][!//
<AUTOSAR xmlns="http://autosar.org/schema/r4.0" xmlns:xsi="http://www.w3.org/2001/XMLSchema-instance" xsi:schemaLocation="http://autosar.org/schema/r4.0 AUTOSAR_00044.xsd">
  <AR-PACKAGES>
    <AR-PACKAGE UUID="7433391b-1e6c-4b89-b26c-f55aa54fa2ac">
      <SHORT-NAME>Pwm_TI_AM263Px</SHORT-NAME>
      <ELEMENTS>
        <BSW-MODULE-DESCRIPTION UUID="14f83e36-7628-433d-ac1a-ee586d6d4cf7">
          <SHORT-NAME>Pwm</SHORT-NAME>
          <CATEGORY>BSW_MODULE</CATEGORY>
          <IMPLEMENTED-ENTRYS>
            [!LOOP "as:modconf('Pwm')[1]/PwmChannelConfigSet/PwmChannel/*"!][!//
            [!IF "PwmChannelId = '0'"!][!//
            <BSW-MODULE-ENTRY-REF-CONDITIONAL>
              <BSW-MODULE-ENTRY-REF DEST="BSW-MODULE-ENTRY">/Pwm_TI_AM263Px/Pwm_ModuleEntry/Pwm_Ch0Isr</BSW-MODULE-ENTRY-REF>
            </BSW-MODULE-ENTRY-REF-CONDITIONAL>
            [!ENDIF!][!//
            [!IF "PwmChannelId = '100'"!][!//
            <BSW-MODULE-ENTRY-REF-CONDITIONAL>
              <BSW-MODULE-ENTRY-REF DEST="BSW-MODULE-ENTRY">/Pwm_TI_AM263Px/Pwm_ModuleEntry/Pwm_Ch100Isr</BSW-MODULE-ENTRY-REF>
            </BSW-MODULE-ENTRY-REF-CONDITIONAL>
            [!ENDIF!][!//
            [!IF "PwmChannelId = '101'"!][!//
            <BSW-MODULE-ENTRY-REF-CONDITIONAL>
              <BSW-MODULE-ENTRY-REF DEST="BSW-MODULE-ENTRY">/Pwm_TI_AM263Px/Pwm_ModuleEntry/Pwm_Ch101Isr</BSW-MODULE-ENTRY-REF>
            </BSW-MODULE-ENTRY-REF-CONDITIONAL>
            [!ENDIF!][!//
            [!IF "PwmChannelId = '102'"!][!//
            <BSW-MODULE-ENTRY-REF-CONDITIONAL>
              <BSW-MODULE-ENTRY-REF DEST="BSW-MODULE-ENTRY">/Pwm_TI_AM263Px/Pwm_ModuleEntry/Pwm_Ch102Isr</BSW-MODULE-ENTRY-REF>
            </BSW-MODULE-ENTRY-REF-CONDITIONAL>
            [!ENDIF!][!//
            [!IF "PwmChannelId = '103'"!][!//
            <BSW-MODULE-ENTRY-REF-CONDITIONAL>
              <BSW-MODULE-ENTRY-REF DEST="BSW-MODULE-ENTRY">/Pwm_TI_AM263Px/Pwm_ModuleEntry/Pwm_Ch103Isr</BSW-MODULE-ENTRY-REF>
            </BSW-MODULE-ENTRY-REF-CONDITIONAL>
            [!ENDIF!][!//
            [!IF "PwmChannelId = '104'"!][!//
            <BSW-MODULE-ENTRY-REF-CONDITIONAL>
              <BSW-MODULE-ENTRY-REF DEST="BSW-MODULE-ENTRY">/Pwm_TI_AM263Px/Pwm_ModuleEntry/Pwm_Ch104Isr</BSW-MODULE-ENTRY-REF>
            </BSW-MODULE-ENTRY-REF-CONDITIONAL>
            [!ENDIF!][!//
            [!IF "PwmChannelId = '105'"!][!//
            <BSW-MODULE-ENTRY-REF-CONDITIONAL>
              <BSW-MODULE-ENTRY-REF DEST="BSW-MODULE-ENTRY">/Pwm_TI_AM263Px/Pwm_ModuleEntry/Pwm_Ch105Isr</BSW-MODULE-ENTRY-REF>
            </BSW-MODULE-ENTRY-REF-CONDITIONAL>
            [!ENDIF!][!//
            [!IF "PwmChannelId = '106'"!][!//
            <BSW-MODULE-ENTRY-REF-CONDITIONAL>
              <BSW-MODULE-ENTRY-REF DEST="BSW-MODULE-ENTRY">/Pwm_TI_AM263Px/Pwm_ModuleEntry/Pwm_Ch106Isr</BSW-MODULE-ENTRY-REF>
            </BSW-MODULE-ENTRY-REF-CONDITIONAL>
            [!ENDIF!][!//
            [!IF "PwmChannelId = '107'"!][!//
            <BSW-MODULE-ENTRY-REF-CONDITIONAL>
              <BSW-MODULE-ENTRY-REF DEST="BSW-MODULE-ENTRY">/Pwm_TI_AM263Px/Pwm_ModuleEntry/Pwm_Ch107Isr</BSW-MODULE-ENTRY-REF>
            </BSW-MODULE-ENTRY-REF-CONDITIONAL>
            [!ENDIF!][!//
            [!IF "PwmChannelId = '108'"!][!//
            <BSW-MODULE-ENTRY-REF-CONDITIONAL>
              <BSW-MODULE-ENTRY-REF DEST="BSW-MODULE-ENTRY">/Pwm_TI_AM263Px/Pwm_ModuleEntry/Pwm_Ch108Isr</BSW-MODULE-ENTRY-REF>
            </BSW-MODULE-ENTRY-REF-CONDITIONAL>
            [!ENDIF!][!//
            [!IF "PwmChannelId = '109'"!][!//
            <BSW-MODULE-ENTRY-REF-CONDITIONAL>
              <BSW-MODULE-ENTRY-REF DEST="BSW-MODULE-ENTRY">/Pwm_TI_AM263Px/Pwm_ModuleEntry/Pwm_Ch109Isr</BSW-MODULE-ENTRY-REF>
            </BSW-MODULE-ENTRY-REF-CONDITIONAL>
            [!ENDIF!][!//
            [!IF "PwmChannelId = '10'"!][!//
            <BSW-MODULE-ENTRY-REF-CONDITIONAL>
              <BSW-MODULE-ENTRY-REF DEST="BSW-MODULE-ENTRY">/Pwm_TI_AM263Px/Pwm_ModuleEntry/Pwm_Ch10Isr</BSW-MODULE-ENTRY-REF>
            </BSW-MODULE-ENTRY-REF-CONDITIONAL>
            [!ENDIF!][!//
            [!IF "PwmChannelId = '110'"!][!//
            <BSW-MODULE-ENTRY-REF-CONDITIONAL>
              <BSW-MODULE-ENTRY-REF DEST="BSW-MODULE-ENTRY">/Pwm_TI_AM263Px/Pwm_ModuleEntry/Pwm_Ch110Isr</BSW-MODULE-ENTRY-REF>
            </BSW-MODULE-ENTRY-REF-CONDITIONAL>
            [!ENDIF!][!//
            [!IF "PwmChannelId = '111'"!][!//
            <BSW-MODULE-ENTRY-REF-CONDITIONAL>
              <BSW-MODULE-ENTRY-REF DEST="BSW-MODULE-ENTRY">/Pwm_TI_AM263Px/Pwm_ModuleEntry/Pwm_Ch111Isr</BSW-MODULE-ENTRY-REF>
            </BSW-MODULE-ENTRY-REF-CONDITIONAL>
            [!ENDIF!][!//
            [!IF "PwmChannelId = '112'"!][!//
            <BSW-MODULE-ENTRY-REF-CONDITIONAL>
              <BSW-MODULE-ENTRY-REF DEST="BSW-MODULE-ENTRY">/Pwm_TI_AM263Px/Pwm_ModuleEntry/Pwm_Ch112Isr</BSW-MODULE-ENTRY-REF>
            </BSW-MODULE-ENTRY-REF-CONDITIONAL>
            [!ENDIF!][!//
            [!IF "PwmChannelId = '113'"!][!//
            <BSW-MODULE-ENTRY-REF-CONDITIONAL>
              <BSW-MODULE-ENTRY-REF DEST="BSW-MODULE-ENTRY">/Pwm_TI_AM263Px/Pwm_ModuleEntry/Pwm_Ch113Isr</BSW-MODULE-ENTRY-REF>
            </BSW-MODULE-ENTRY-REF-CONDITIONAL>
            [!ENDIF!][!//
            [!IF "PwmChannelId = '114'"!][!//
            <BSW-MODULE-ENTRY-REF-CONDITIONAL>
              <BSW-MODULE-ENTRY-REF DEST="BSW-MODULE-ENTRY">/Pwm_TI_AM263Px/Pwm_ModuleEntry/Pwm_Ch114Isr</BSW-MODULE-ENTRY-REF>
            </BSW-MODULE-ENTRY-REF-CONDITIONAL>
            [!ENDIF!][!//
            [!IF "PwmChannelId = '115'"!][!//
            <BSW-MODULE-ENTRY-REF-CONDITIONAL>
              <BSW-MODULE-ENTRY-REF DEST="BSW-MODULE-ENTRY">/Pwm_TI_AM263Px/Pwm_ModuleEntry/Pwm_Ch115Isr</BSW-MODULE-ENTRY-REF>
            </BSW-MODULE-ENTRY-REF-CONDITIONAL>
            [!ENDIF!][!//
            [!IF "PwmChannelId = '116'"!][!//
            <BSW-MODULE-ENTRY-REF-CONDITIONAL>
              <BSW-MODULE-ENTRY-REF DEST="BSW-MODULE-ENTRY">/Pwm_TI_AM263Px/Pwm_ModuleEntry/Pwm_Ch116Isr</BSW-MODULE-ENTRY-REF>
            </BSW-MODULE-ENTRY-REF-CONDITIONAL>
            [!ENDIF!][!//
            [!IF "PwmChannelId = '117'"!][!//
            <BSW-MODULE-ENTRY-REF-CONDITIONAL>
              <BSW-MODULE-ENTRY-REF DEST="BSW-MODULE-ENTRY">/Pwm_TI_AM263Px/Pwm_ModuleEntry/Pwm_Ch117Isr</BSW-MODULE-ENTRY-REF>
            </BSW-MODULE-ENTRY-REF-CONDITIONAL>
            [!ENDIF!][!//
            [!IF "PwmChannelId = '118'"!][!//
            <BSW-MODULE-ENTRY-REF-CONDITIONAL>
              <BSW-MODULE-ENTRY-REF DEST="BSW-MODULE-ENTRY">/Pwm_TI_AM263Px/Pwm_ModuleEntry/Pwm_Ch118Isr</BSW-MODULE-ENTRY-REF>
            </BSW-MODULE-ENTRY-REF-CONDITIONAL>
            [!ENDIF!][!//
            [!IF "PwmChannelId = '119'"!][!//
            <BSW-MODULE-ENTRY-REF-CONDITIONAL>
              <BSW-MODULE-ENTRY-REF DEST="BSW-MODULE-ENTRY">/Pwm_TI_AM263Px/Pwm_ModuleEntry/Pwm_Ch119Isr</BSW-MODULE-ENTRY-REF>
            </BSW-MODULE-ENTRY-REF-CONDITIONAL>
            [!ENDIF!][!//
            [!IF "PwmChannelId = '11'"!][!//
            <BSW-MODULE-ENTRY-REF-CONDITIONAL>
              <BSW-MODULE-ENTRY-REF DEST="BSW-MODULE-ENTRY">/Pwm_TI_AM263Px/Pwm_ModuleEntry/Pwm_Ch11Isr</BSW-MODULE-ENTRY-REF>
            </BSW-MODULE-ENTRY-REF-CONDITIONAL>
            [!ENDIF!][!//
            [!IF "PwmChannelId = '120'"!][!//
            <BSW-MODULE-ENTRY-REF-CONDITIONAL>
              <BSW-MODULE-ENTRY-REF DEST="BSW-MODULE-ENTRY">/Pwm_TI_AM263Px/Pwm_ModuleEntry/Pwm_Ch120Isr</BSW-MODULE-ENTRY-REF>
            </BSW-MODULE-ENTRY-REF-CONDITIONAL>
            [!ENDIF!][!//
            [!IF "PwmChannelId = '121'"!][!//
            <BSW-MODULE-ENTRY-REF-CONDITIONAL>
              <BSW-MODULE-ENTRY-REF DEST="BSW-MODULE-ENTRY">/Pwm_TI_AM263Px/Pwm_ModuleEntry/Pwm_Ch121Isr</BSW-MODULE-ENTRY-REF>
            </BSW-MODULE-ENTRY-REF-CONDITIONAL>
            [!ENDIF!][!//
            [!IF "PwmChannelId = '122'"!][!//
            <BSW-MODULE-ENTRY-REF-CONDITIONAL>
              <BSW-MODULE-ENTRY-REF DEST="BSW-MODULE-ENTRY">/Pwm_TI_AM263Px/Pwm_ModuleEntry/Pwm_Ch122Isr</BSW-MODULE-ENTRY-REF>
            </BSW-MODULE-ENTRY-REF-CONDITIONAL>
            [!ENDIF!][!//
            [!IF "PwmChannelId = '123'"!][!//
            <BSW-MODULE-ENTRY-REF-CONDITIONAL>
              <BSW-MODULE-ENTRY-REF DEST="BSW-MODULE-ENTRY">/Pwm_TI_AM263Px/Pwm_ModuleEntry/Pwm_Ch123Isr</BSW-MODULE-ENTRY-REF>
            </BSW-MODULE-ENTRY-REF-CONDITIONAL>
            [!ENDIF!][!//
            [!IF "PwmChannelId = '124'"!][!//
            <BSW-MODULE-ENTRY-REF-CONDITIONAL>
              <BSW-MODULE-ENTRY-REF DEST="BSW-MODULE-ENTRY">/Pwm_TI_AM263Px/Pwm_ModuleEntry/Pwm_Ch124Isr</BSW-MODULE-ENTRY-REF>
            </BSW-MODULE-ENTRY-REF-CONDITIONAL>
            [!ENDIF!][!//
            [!IF "PwmChannelId = '125'"!][!//
            <BSW-MODULE-ENTRY-REF-CONDITIONAL>
              <BSW-MODULE-ENTRY-REF DEST="BSW-MODULE-ENTRY">/Pwm_TI_AM263Px/Pwm_ModuleEntry/Pwm_Ch125Isr</BSW-MODULE-ENTRY-REF>
            </BSW-MODULE-ENTRY-REF-CONDITIONAL>
            [!ENDIF!][!//
            [!IF "PwmChannelId = '126'"!][!//
            <BSW-MODULE-ENTRY-REF-CONDITIONAL>
              <BSW-MODULE-ENTRY-REF DEST="BSW-MODULE-ENTRY">/Pwm_TI_AM263Px/Pwm_ModuleEntry/Pwm_Ch126Isr</BSW-MODULE-ENTRY-REF>
            </BSW-MODULE-ENTRY-REF-CONDITIONAL>
            [!ENDIF!][!//
            [!IF "PwmChannelId = '127'"!][!//
            <BSW-MODULE-ENTRY-REF-CONDITIONAL>
              <BSW-MODULE-ENTRY-REF DEST="BSW-MODULE-ENTRY">/Pwm_TI_AM263Px/Pwm_ModuleEntry/Pwm_Ch127Isr</BSW-MODULE-ENTRY-REF>
            </BSW-MODULE-ENTRY-REF-CONDITIONAL>
            [!ENDIF!][!//
            [!IF "PwmChannelId = '12'"!][!//
            <BSW-MODULE-ENTRY-REF-CONDITIONAL>
              <BSW-MODULE-ENTRY-REF DEST="BSW-MODULE-ENTRY">/Pwm_TI_AM263Px/Pwm_ModuleEntry/Pwm_Ch12Isr</BSW-MODULE-ENTRY-REF>
            </BSW-MODULE-ENTRY-REF-CONDITIONAL>
            [!ENDIF!][!//
            [!IF "PwmChannelId = '13'"!][!//
            <BSW-MODULE-ENTRY-REF-CONDITIONAL>
              <BSW-MODULE-ENTRY-REF DEST="BSW-MODULE-ENTRY">/Pwm_TI_AM263Px/Pwm_ModuleEntry/Pwm_Ch13Isr</BSW-MODULE-ENTRY-REF>
            </BSW-MODULE-ENTRY-REF-CONDITIONAL>
            [!ENDIF!][!//
            [!IF "PwmChannelId = '14'"!][!//
            <BSW-MODULE-ENTRY-REF-CONDITIONAL>
              <BSW-MODULE-ENTRY-REF DEST="BSW-MODULE-ENTRY">/Pwm_TI_AM263Px/Pwm_ModuleEntry/Pwm_Ch14Isr</BSW-MODULE-ENTRY-REF>
            </BSW-MODULE-ENTRY-REF-CONDITIONAL>
            [!ENDIF!][!//
            [!IF "PwmChannelId = '15'"!][!//
            <BSW-MODULE-ENTRY-REF-CONDITIONAL>
              <BSW-MODULE-ENTRY-REF DEST="BSW-MODULE-ENTRY">/Pwm_TI_AM263Px/Pwm_ModuleEntry/Pwm_Ch15Isr</BSW-MODULE-ENTRY-REF>
            </BSW-MODULE-ENTRY-REF-CONDITIONAL>
            [!ENDIF!][!//
            [!IF "PwmChannelId = '16'"!][!//
            <BSW-MODULE-ENTRY-REF-CONDITIONAL>
              <BSW-MODULE-ENTRY-REF DEST="BSW-MODULE-ENTRY">/Pwm_TI_AM263Px/Pwm_ModuleEntry/Pwm_Ch16Isr</BSW-MODULE-ENTRY-REF>
            </BSW-MODULE-ENTRY-REF-CONDITIONAL>
            [!ENDIF!][!//
            [!IF "PwmChannelId = '17'"!][!//
            <BSW-MODULE-ENTRY-REF-CONDITIONAL>
              <BSW-MODULE-ENTRY-REF DEST="BSW-MODULE-ENTRY">/Pwm_TI_AM263Px/Pwm_ModuleEntry/Pwm_Ch17Isr</BSW-MODULE-ENTRY-REF>
            </BSW-MODULE-ENTRY-REF-CONDITIONAL>
            [!ENDIF!][!//
            [!IF "PwmChannelId = '18'"!][!//
            <BSW-MODULE-ENTRY-REF-CONDITIONAL>
              <BSW-MODULE-ENTRY-REF DEST="BSW-MODULE-ENTRY">/Pwm_TI_AM263Px/Pwm_ModuleEntry/Pwm_Ch18Isr</BSW-MODULE-ENTRY-REF>
            </BSW-MODULE-ENTRY-REF-CONDITIONAL>
            [!ENDIF!][!//
            [!IF "PwmChannelId = '19'"!][!//
            <BSW-MODULE-ENTRY-REF-CONDITIONAL>
              <BSW-MODULE-ENTRY-REF DEST="BSW-MODULE-ENTRY">/Pwm_TI_AM263Px/Pwm_ModuleEntry/Pwm_Ch19Isr</BSW-MODULE-ENTRY-REF>
            </BSW-MODULE-ENTRY-REF-CONDITIONAL>
            [!ENDIF!][!//
            [!IF "PwmChannelId = '1'"!][!//
            <BSW-MODULE-ENTRY-REF-CONDITIONAL>
              <BSW-MODULE-ENTRY-REF DEST="BSW-MODULE-ENTRY">/Pwm_TI_AM263Px/Pwm_ModuleEntry/Pwm_Ch1Isr</BSW-MODULE-ENTRY-REF>
            </BSW-MODULE-ENTRY-REF-CONDITIONAL>
            [!ENDIF!][!//
            [!IF "PwmChannelId = '20'"!][!//
            <BSW-MODULE-ENTRY-REF-CONDITIONAL>
              <BSW-MODULE-ENTRY-REF DEST="BSW-MODULE-ENTRY">/Pwm_TI_AM263Px/Pwm_ModuleEntry/Pwm_Ch20Isr</BSW-MODULE-ENTRY-REF>
            </BSW-MODULE-ENTRY-REF-CONDITIONAL>
            [!ENDIF!][!//
            [!IF "PwmChannelId = '21'"!][!//
            <BSW-MODULE-ENTRY-REF-CONDITIONAL>
              <BSW-MODULE-ENTRY-REF DEST="BSW-MODULE-ENTRY">/Pwm_TI_AM263Px/Pwm_ModuleEntry/Pwm_Ch21Isr</BSW-MODULE-ENTRY-REF>
            </BSW-MODULE-ENTRY-REF-CONDITIONAL>
            [!ENDIF!][!//
            [!IF "PwmChannelId = '22'"!][!//
            <BSW-MODULE-ENTRY-REF-CONDITIONAL>
              <BSW-MODULE-ENTRY-REF DEST="BSW-MODULE-ENTRY">/Pwm_TI_AM263Px/Pwm_ModuleEntry/Pwm_Ch22Isr</BSW-MODULE-ENTRY-REF>
            </BSW-MODULE-ENTRY-REF-CONDITIONAL>
            [!ENDIF!][!//
            [!IF "PwmChannelId = '23'"!][!//
            <BSW-MODULE-ENTRY-REF-CONDITIONAL>
              <BSW-MODULE-ENTRY-REF DEST="BSW-MODULE-ENTRY">/Pwm_TI_AM263Px/Pwm_ModuleEntry/Pwm_Ch23Isr</BSW-MODULE-ENTRY-REF>
            </BSW-MODULE-ENTRY-REF-CONDITIONAL>
            [!ENDIF!][!//
            [!IF "PwmChannelId = '24'"!][!//
            <BSW-MODULE-ENTRY-REF-CONDITIONAL>
              <BSW-MODULE-ENTRY-REF DEST="BSW-MODULE-ENTRY">/Pwm_TI_AM263Px/Pwm_ModuleEntry/Pwm_Ch24Isr</BSW-MODULE-ENTRY-REF>
            </BSW-MODULE-ENTRY-REF-CONDITIONAL>
            [!ENDIF!][!//
            [!IF "PwmChannelId = '25'"!][!//
            <BSW-MODULE-ENTRY-REF-CONDITIONAL>
              <BSW-MODULE-ENTRY-REF DEST="BSW-MODULE-ENTRY">/Pwm_TI_AM263Px/Pwm_ModuleEntry/Pwm_Ch25Isr</BSW-MODULE-ENTRY-REF>
            </BSW-MODULE-ENTRY-REF-CONDITIONAL>
            [!ENDIF!][!//
            [!IF "PwmChannelId = '26'"!][!//
            <BSW-MODULE-ENTRY-REF-CONDITIONAL>
              <BSW-MODULE-ENTRY-REF DEST="BSW-MODULE-ENTRY">/Pwm_TI_AM263Px/Pwm_ModuleEntry/Pwm_Ch26Isr</BSW-MODULE-ENTRY-REF>
            </BSW-MODULE-ENTRY-REF-CONDITIONAL>
            [!ENDIF!][!//
            [!IF "PwmChannelId = '27'"!][!//
            <BSW-MODULE-ENTRY-REF-CONDITIONAL>
              <BSW-MODULE-ENTRY-REF DEST="BSW-MODULE-ENTRY">/Pwm_TI_AM263Px/Pwm_ModuleEntry/Pwm_Ch27Isr</BSW-MODULE-ENTRY-REF>
            </BSW-MODULE-ENTRY-REF-CONDITIONAL>
            [!ENDIF!][!//
            [!IF "PwmChannelId = '28'"!][!//
            <BSW-MODULE-ENTRY-REF-CONDITIONAL>
              <BSW-MODULE-ENTRY-REF DEST="BSW-MODULE-ENTRY">/Pwm_TI_AM263Px/Pwm_ModuleEntry/Pwm_Ch28Isr</BSW-MODULE-ENTRY-REF>
            </BSW-MODULE-ENTRY-REF-CONDITIONAL>
            [!ENDIF!][!//
            [!IF "PwmChannelId = '29'"!][!//
            <BSW-MODULE-ENTRY-REF-CONDITIONAL>
              <BSW-MODULE-ENTRY-REF DEST="BSW-MODULE-ENTRY">/Pwm_TI_AM263Px/Pwm_ModuleEntry/Pwm_Ch29Isr</BSW-MODULE-ENTRY-REF>
            </BSW-MODULE-ENTRY-REF-CONDITIONAL>
            [!ENDIF!][!//
            [!IF "PwmChannelId = '2'"!][!//
            <BSW-MODULE-ENTRY-REF-CONDITIONAL>
              <BSW-MODULE-ENTRY-REF DEST="BSW-MODULE-ENTRY">/Pwm_TI_AM263Px/Pwm_ModuleEntry/Pwm_Ch2Isr</BSW-MODULE-ENTRY-REF>
            </BSW-MODULE-ENTRY-REF-CONDITIONAL>
            [!ENDIF!][!//
            [!IF "PwmChannelId = '30'"!][!//
            <BSW-MODULE-ENTRY-REF-CONDITIONAL>
              <BSW-MODULE-ENTRY-REF DEST="BSW-MODULE-ENTRY">/Pwm_TI_AM263Px/Pwm_ModuleEntry/Pwm_Ch30Isr</BSW-MODULE-ENTRY-REF>
            </BSW-MODULE-ENTRY-REF-CONDITIONAL>
            [!ENDIF!][!//
            [!IF "PwmChannelId = '31'"!][!//
            <BSW-MODULE-ENTRY-REF-CONDITIONAL>
              <BSW-MODULE-ENTRY-REF DEST="BSW-MODULE-ENTRY">/Pwm_TI_AM263Px/Pwm_ModuleEntry/Pwm_Ch31Isr</BSW-MODULE-ENTRY-REF>
            </BSW-MODULE-ENTRY-REF-CONDITIONAL>
            [!ENDIF!][!//
            [!IF "PwmChannelId = '32'"!][!//
            <BSW-MODULE-ENTRY-REF-CONDITIONAL>
              <BSW-MODULE-ENTRY-REF DEST="BSW-MODULE-ENTRY">/Pwm_TI_AM263Px/Pwm_ModuleEntry/Pwm_Ch32Isr</BSW-MODULE-ENTRY-REF>
            </BSW-MODULE-ENTRY-REF-CONDITIONAL>
            [!ENDIF!][!//
            [!IF "PwmChannelId = '33'"!][!//
            <BSW-MODULE-ENTRY-REF-CONDITIONAL>
              <BSW-MODULE-ENTRY-REF DEST="BSW-MODULE-ENTRY">/Pwm_TI_AM263Px/Pwm_ModuleEntry/Pwm_Ch33Isr</BSW-MODULE-ENTRY-REF>
            </BSW-MODULE-ENTRY-REF-CONDITIONAL>
            [!ENDIF!][!//
            [!IF "PwmChannelId = '34'"!][!//
            <BSW-MODULE-ENTRY-REF-CONDITIONAL>
              <BSW-MODULE-ENTRY-REF DEST="BSW-MODULE-ENTRY">/Pwm_TI_AM263Px/Pwm_ModuleEntry/Pwm_Ch34Isr</BSW-MODULE-ENTRY-REF>
            </BSW-MODULE-ENTRY-REF-CONDITIONAL>
            [!ENDIF!][!//
            [!IF "PwmChannelId = '35'"!][!//
            <BSW-MODULE-ENTRY-REF-CONDITIONAL>
              <BSW-MODULE-ENTRY-REF DEST="BSW-MODULE-ENTRY">/Pwm_TI_AM263Px/Pwm_ModuleEntry/Pwm_Ch35Isr</BSW-MODULE-ENTRY-REF>
            </BSW-MODULE-ENTRY-REF-CONDITIONAL>
            [!ENDIF!][!//
            [!IF "PwmChannelId = '36'"!][!//
            <BSW-MODULE-ENTRY-REF-CONDITIONAL>
              <BSW-MODULE-ENTRY-REF DEST="BSW-MODULE-ENTRY">/Pwm_TI_AM263Px/Pwm_ModuleEntry/Pwm_Ch36Isr</BSW-MODULE-ENTRY-REF>
            </BSW-MODULE-ENTRY-REF-CONDITIONAL>
            [!ENDIF!][!//
            [!IF "PwmChannelId = '37'"!][!//
            <BSW-MODULE-ENTRY-REF-CONDITIONAL>
              <BSW-MODULE-ENTRY-REF DEST="BSW-MODULE-ENTRY">/Pwm_TI_AM263Px/Pwm_ModuleEntry/Pwm_Ch37Isr</BSW-MODULE-ENTRY-REF>
            </BSW-MODULE-ENTRY-REF-CONDITIONAL>
            [!ENDIF!][!//
            [!IF "PwmChannelId = '38'"!][!//
            <BSW-MODULE-ENTRY-REF-CONDITIONAL>
              <BSW-MODULE-ENTRY-REF DEST="BSW-MODULE-ENTRY">/Pwm_TI_AM263Px/Pwm_ModuleEntry/Pwm_Ch38Isr</BSW-MODULE-ENTRY-REF>
            </BSW-MODULE-ENTRY-REF-CONDITIONAL>
            [!ENDIF!][!//
            [!IF "PwmChannelId = '39'"!][!//
            <BSW-MODULE-ENTRY-REF-CONDITIONAL>
              <BSW-MODULE-ENTRY-REF DEST="BSW-MODULE-ENTRY">/Pwm_TI_AM263Px/Pwm_ModuleEntry/Pwm_Ch39Isr</BSW-MODULE-ENTRY-REF>
            </BSW-MODULE-ENTRY-REF-CONDITIONAL>
            [!ENDIF!][!//
            [!IF "PwmChannelId = '3'"!][!//
            <BSW-MODULE-ENTRY-REF-CONDITIONAL>
              <BSW-MODULE-ENTRY-REF DEST="BSW-MODULE-ENTRY">/Pwm_TI_AM263Px/Pwm_ModuleEntry/Pwm_Ch3Isr</BSW-MODULE-ENTRY-REF>
            </BSW-MODULE-ENTRY-REF-CONDITIONAL>
            [!ENDIF!][!//
            [!IF "PwmChannelId = '40'"!][!//
            <BSW-MODULE-ENTRY-REF-CONDITIONAL>
              <BSW-MODULE-ENTRY-REF DEST="BSW-MODULE-ENTRY">/Pwm_TI_AM263Px/Pwm_ModuleEntry/Pwm_Ch40Isr</BSW-MODULE-ENTRY-REF>
            </BSW-MODULE-ENTRY-REF-CONDITIONAL>
            [!ENDIF!][!//
            [!IF "PwmChannelId = '41'"!][!//
            <BSW-MODULE-ENTRY-REF-CONDITIONAL>
              <BSW-MODULE-ENTRY-REF DEST="BSW-MODULE-ENTRY">/Pwm_TI_AM263Px/Pwm_ModuleEntry/Pwm_Ch41Isr</BSW-MODULE-ENTRY-REF>
            </BSW-MODULE-ENTRY-REF-CONDITIONAL>
            [!ENDIF!][!//
            [!IF "PwmChannelId = '42'"!][!//
            <BSW-MODULE-ENTRY-REF-CONDITIONAL>
              <BSW-MODULE-ENTRY-REF DEST="BSW-MODULE-ENTRY">/Pwm_TI_AM263Px/Pwm_ModuleEntry/Pwm_Ch42Isr</BSW-MODULE-ENTRY-REF>
            </BSW-MODULE-ENTRY-REF-CONDITIONAL>
            [!ENDIF!][!//
            [!IF "PwmChannelId = '43'"!][!//
            <BSW-MODULE-ENTRY-REF-CONDITIONAL>
              <BSW-MODULE-ENTRY-REF DEST="BSW-MODULE-ENTRY">/Pwm_TI_AM263Px/Pwm_ModuleEntry/Pwm_Ch43Isr</BSW-MODULE-ENTRY-REF>
            </BSW-MODULE-ENTRY-REF-CONDITIONAL>
            [!ENDIF!][!//
            [!IF "PwmChannelId = '44'"!][!//
            <BSW-MODULE-ENTRY-REF-CONDITIONAL>
              <BSW-MODULE-ENTRY-REF DEST="BSW-MODULE-ENTRY">/Pwm_TI_AM263Px/Pwm_ModuleEntry/Pwm_Ch44Isr</BSW-MODULE-ENTRY-REF>
            </BSW-MODULE-ENTRY-REF-CONDITIONAL>
            [!ENDIF!][!//
            [!IF "PwmChannelId = '45'"!][!//
            <BSW-MODULE-ENTRY-REF-CONDITIONAL>
              <BSW-MODULE-ENTRY-REF DEST="BSW-MODULE-ENTRY">/Pwm_TI_AM263Px/Pwm_ModuleEntry/Pwm_Ch45Isr</BSW-MODULE-ENTRY-REF>
            </BSW-MODULE-ENTRY-REF-CONDITIONAL>
            [!ENDIF!][!//
            [!IF "PwmChannelId = '46'"!][!//
            <BSW-MODULE-ENTRY-REF-CONDITIONAL>
              <BSW-MODULE-ENTRY-REF DEST="BSW-MODULE-ENTRY">/Pwm_TI_AM263Px/Pwm_ModuleEntry/Pwm_Ch46Isr</BSW-MODULE-ENTRY-REF>
            </BSW-MODULE-ENTRY-REF-CONDITIONAL>
            [!ENDIF!][!//
            [!IF "PwmChannelId = '47'"!][!//
            <BSW-MODULE-ENTRY-REF-CONDITIONAL>
              <BSW-MODULE-ENTRY-REF DEST="BSW-MODULE-ENTRY">/Pwm_TI_AM263Px/Pwm_ModuleEntry/Pwm_Ch47Isr</BSW-MODULE-ENTRY-REF>
            </BSW-MODULE-ENTRY-REF-CONDITIONAL>
            [!ENDIF!][!//
            [!IF "PwmChannelId = '48'"!][!//
            <BSW-MODULE-ENTRY-REF-CONDITIONAL>
              <BSW-MODULE-ENTRY-REF DEST="BSW-MODULE-ENTRY">/Pwm_TI_AM263Px/Pwm_ModuleEntry/Pwm_Ch48Isr</BSW-MODULE-ENTRY-REF>
            </BSW-MODULE-ENTRY-REF-CONDITIONAL>
            [!ENDIF!][!//
            [!IF "PwmChannelId = '49'"!][!//
            <BSW-MODULE-ENTRY-REF-CONDITIONAL>
              <BSW-MODULE-ENTRY-REF DEST="BSW-MODULE-ENTRY">/Pwm_TI_AM263Px/Pwm_ModuleEntry/Pwm_Ch49Isr</BSW-MODULE-ENTRY-REF>
            </BSW-MODULE-ENTRY-REF-CONDITIONAL>
            [!ENDIF!][!//
            [!IF "PwmChannelId = '4'"!][!//
            <BSW-MODULE-ENTRY-REF-CONDITIONAL>
              <BSW-MODULE-ENTRY-REF DEST="BSW-MODULE-ENTRY">/Pwm_TI_AM263Px/Pwm_ModuleEntry/Pwm_Ch4Isr</BSW-MODULE-ENTRY-REF>
            </BSW-MODULE-ENTRY-REF-CONDITIONAL>
            [!ENDIF!][!//
            [!IF "PwmChannelId = '50'"!][!//
            <BSW-MODULE-ENTRY-REF-CONDITIONAL>
              <BSW-MODULE-ENTRY-REF DEST="BSW-MODULE-ENTRY">/Pwm_TI_AM263Px/Pwm_ModuleEntry/Pwm_Ch50Isr</BSW-MODULE-ENTRY-REF>
            </BSW-MODULE-ENTRY-REF-CONDITIONAL>
            [!ENDIF!][!//
            [!IF "PwmChannelId = '51'"!][!//
            <BSW-MODULE-ENTRY-REF-CONDITIONAL>
              <BSW-MODULE-ENTRY-REF DEST="BSW-MODULE-ENTRY">/Pwm_TI_AM263Px/Pwm_ModuleEntry/Pwm_Ch51Isr</BSW-MODULE-ENTRY-REF>
            </BSW-MODULE-ENTRY-REF-CONDITIONAL>
            [!ENDIF!][!//
            [!IF "PwmChannelId = '52'"!][!//
            <BSW-MODULE-ENTRY-REF-CONDITIONAL>
              <BSW-MODULE-ENTRY-REF DEST="BSW-MODULE-ENTRY">/Pwm_TI_AM263Px/Pwm_ModuleEntry/Pwm_Ch52Isr</BSW-MODULE-ENTRY-REF>
            </BSW-MODULE-ENTRY-REF-CONDITIONAL>
            [!ENDIF!][!//
            [!IF "PwmChannelId = '53'"!][!//
            <BSW-MODULE-ENTRY-REF-CONDITIONAL>
              <BSW-MODULE-ENTRY-REF DEST="BSW-MODULE-ENTRY">/Pwm_TI_AM263Px/Pwm_ModuleEntry/Pwm_Ch53Isr</BSW-MODULE-ENTRY-REF>
            </BSW-MODULE-ENTRY-REF-CONDITIONAL>
            [!ENDIF!][!//
            [!IF "PwmChannelId = '54'"!][!//
            <BSW-MODULE-ENTRY-REF-CONDITIONAL>
              <BSW-MODULE-ENTRY-REF DEST="BSW-MODULE-ENTRY">/Pwm_TI_AM263Px/Pwm_ModuleEntry/Pwm_Ch54Isr</BSW-MODULE-ENTRY-REF>
            </BSW-MODULE-ENTRY-REF-CONDITIONAL>
            [!ENDIF!][!//
            [!IF "PwmChannelId = '55'"!][!//
            <BSW-MODULE-ENTRY-REF-CONDITIONAL>
              <BSW-MODULE-ENTRY-REF DEST="BSW-MODULE-ENTRY">/Pwm_TI_AM263Px/Pwm_ModuleEntry/Pwm_Ch55Isr</BSW-MODULE-ENTRY-REF>
            </BSW-MODULE-ENTRY-REF-CONDITIONAL>
            [!ENDIF!][!//
            [!IF "PwmChannelId = '56'"!][!//
            <BSW-MODULE-ENTRY-REF-CONDITIONAL>
              <BSW-MODULE-ENTRY-REF DEST="BSW-MODULE-ENTRY">/Pwm_TI_AM263Px/Pwm_ModuleEntry/Pwm_Ch56Isr</BSW-MODULE-ENTRY-REF>
            </BSW-MODULE-ENTRY-REF-CONDITIONAL>
            [!ENDIF!][!//
            [!IF "PwmChannelId = '57'"!][!//
            <BSW-MODULE-ENTRY-REF-CONDITIONAL>
              <BSW-MODULE-ENTRY-REF DEST="BSW-MODULE-ENTRY">/Pwm_TI_AM263Px/Pwm_ModuleEntry/Pwm_Ch57Isr</BSW-MODULE-ENTRY-REF>
            </BSW-MODULE-ENTRY-REF-CONDITIONAL>
            [!ENDIF!][!//
            [!IF "PwmChannelId = '58'"!][!//
            <BSW-MODULE-ENTRY-REF-CONDITIONAL>
              <BSW-MODULE-ENTRY-REF DEST="BSW-MODULE-ENTRY">/Pwm_TI_AM263Px/Pwm_ModuleEntry/Pwm_Ch58Isr</BSW-MODULE-ENTRY-REF>
            </BSW-MODULE-ENTRY-REF-CONDITIONAL>
            [!ENDIF!][!//
            [!IF "PwmChannelId = '59'"!][!//
            <BSW-MODULE-ENTRY-REF-CONDITIONAL>
              <BSW-MODULE-ENTRY-REF DEST="BSW-MODULE-ENTRY">/Pwm_TI_AM263Px/Pwm_ModuleEntry/Pwm_Ch59Isr</BSW-MODULE-ENTRY-REF>
            </BSW-MODULE-ENTRY-REF-CONDITIONAL>
            [!ENDIF!][!//
            [!IF "PwmChannelId = '5'"!][!//
            <BSW-MODULE-ENTRY-REF-CONDITIONAL>
              <BSW-MODULE-ENTRY-REF DEST="BSW-MODULE-ENTRY">/Pwm_TI_AM263Px/Pwm_ModuleEntry/Pwm_Ch5Isr</BSW-MODULE-ENTRY-REF>
            </BSW-MODULE-ENTRY-REF-CONDITIONAL>
            [!ENDIF!][!//
            [!IF "PwmChannelId = '60'"!][!//
            <BSW-MODULE-ENTRY-REF-CONDITIONAL>
              <BSW-MODULE-ENTRY-REF DEST="BSW-MODULE-ENTRY">/Pwm_TI_AM263Px/Pwm_ModuleEntry/Pwm_Ch60Isr</BSW-MODULE-ENTRY-REF>
            </BSW-MODULE-ENTRY-REF-CONDITIONAL>
            [!ENDIF!][!//
            [!IF "PwmChannelId = '61'"!][!//
            <BSW-MODULE-ENTRY-REF-CONDITIONAL>
              <BSW-MODULE-ENTRY-REF DEST="BSW-MODULE-ENTRY">/Pwm_TI_AM263Px/Pwm_ModuleEntry/Pwm_Ch61Isr</BSW-MODULE-ENTRY-REF>
            </BSW-MODULE-ENTRY-REF-CONDITIONAL>
            [!ENDIF!][!//
            [!IF "PwmChannelId = '62'"!][!//
            <BSW-MODULE-ENTRY-REF-CONDITIONAL>
              <BSW-MODULE-ENTRY-REF DEST="BSW-MODULE-ENTRY">/Pwm_TI_AM263Px/Pwm_ModuleEntry/Pwm_Ch62Isr</BSW-MODULE-ENTRY-REF>
            </BSW-MODULE-ENTRY-REF-CONDITIONAL>
            [!ENDIF!][!//
            [!IF "PwmChannelId = '63'"!][!//
            <BSW-MODULE-ENTRY-REF-CONDITIONAL>
              <BSW-MODULE-ENTRY-REF DEST="BSW-MODULE-ENTRY">/Pwm_TI_AM263Px/Pwm_ModuleEntry/Pwm_Ch63Isr</BSW-MODULE-ENTRY-REF>
            </BSW-MODULE-ENTRY-REF-CONDITIONAL>
            [!ENDIF!][!//
            [!IF "PwmChannelId = '64'"!][!//
            <BSW-MODULE-ENTRY-REF-CONDITIONAL>
              <BSW-MODULE-ENTRY-REF DEST="BSW-MODULE-ENTRY">/Pwm_TI_AM263Px/Pwm_ModuleEntry/Pwm_Ch64Isr</BSW-MODULE-ENTRY-REF>
            </BSW-MODULE-ENTRY-REF-CONDITIONAL>
            [!ENDIF!][!//
            [!IF "PwmChannelId = '65'"!][!//
            <BSW-MODULE-ENTRY-REF-CONDITIONAL>
              <BSW-MODULE-ENTRY-REF DEST="BSW-MODULE-ENTRY">/Pwm_TI_AM263Px/Pwm_ModuleEntry/Pwm_Ch65Isr</BSW-MODULE-ENTRY-REF>
            </BSW-MODULE-ENTRY-REF-CONDITIONAL>
            [!ENDIF!][!//
            [!IF "PwmChannelId = '66'"!][!//
            <BSW-MODULE-ENTRY-REF-CONDITIONAL>
              <BSW-MODULE-ENTRY-REF DEST="BSW-MODULE-ENTRY">/Pwm_TI_AM263Px/Pwm_ModuleEntry/Pwm_Ch66Isr</BSW-MODULE-ENTRY-REF>
            </BSW-MODULE-ENTRY-REF-CONDITIONAL>
            [!ENDIF!][!//
            [!IF "PwmChannelId = '67'"!][!//
            <BSW-MODULE-ENTRY-REF-CONDITIONAL>
              <BSW-MODULE-ENTRY-REF DEST="BSW-MODULE-ENTRY">/Pwm_TI_AM263Px/Pwm_ModuleEntry/Pwm_Ch67Isr</BSW-MODULE-ENTRY-REF>
            </BSW-MODULE-ENTRY-REF-CONDITIONAL>
            [!ENDIF!][!//
            [!IF "PwmChannelId = '68'"!][!//
            <BSW-MODULE-ENTRY-REF-CONDITIONAL>
              <BSW-MODULE-ENTRY-REF DEST="BSW-MODULE-ENTRY">/Pwm_TI_AM263Px/Pwm_ModuleEntry/Pwm_Ch68Isr</BSW-MODULE-ENTRY-REF>
            </BSW-MODULE-ENTRY-REF-CONDITIONAL>
            [!ENDIF!][!//
            [!IF "PwmChannelId = '69'"!][!//
            <BSW-MODULE-ENTRY-REF-CONDITIONAL>
              <BSW-MODULE-ENTRY-REF DEST="BSW-MODULE-ENTRY">/Pwm_TI_AM263Px/Pwm_ModuleEntry/Pwm_Ch69Isr</BSW-MODULE-ENTRY-REF>
            </BSW-MODULE-ENTRY-REF-CONDITIONAL>
            [!ENDIF!][!//
            [!IF "PwmChannelId = '6'"!][!//
            <BSW-MODULE-ENTRY-REF-CONDITIONAL>
              <BSW-MODULE-ENTRY-REF DEST="BSW-MODULE-ENTRY">/Pwm_TI_AM263Px/Pwm_ModuleEntry/Pwm_Ch6Isr</BSW-MODULE-ENTRY-REF>
            </BSW-MODULE-ENTRY-REF-CONDITIONAL>
            [!ENDIF!][!//
            [!IF "PwmChannelId = '70'"!][!//
            <BSW-MODULE-ENTRY-REF-CONDITIONAL>
              <BSW-MODULE-ENTRY-REF DEST="BSW-MODULE-ENTRY">/Pwm_TI_AM263Px/Pwm_ModuleEntry/Pwm_Ch70Isr</BSW-MODULE-ENTRY-REF>
            </BSW-MODULE-ENTRY-REF-CONDITIONAL>
            [!ENDIF!][!//
            [!IF "PwmChannelId = '71'"!][!//
            <BSW-MODULE-ENTRY-REF-CONDITIONAL>
              <BSW-MODULE-ENTRY-REF DEST="BSW-MODULE-ENTRY">/Pwm_TI_AM263Px/Pwm_ModuleEntry/Pwm_Ch71Isr</BSW-MODULE-ENTRY-REF>
            </BSW-MODULE-ENTRY-REF-CONDITIONAL>
            [!ENDIF!][!//
            [!IF "PwmChannelId = '72'"!][!//
            <BSW-MODULE-ENTRY-REF-CONDITIONAL>
              <BSW-MODULE-ENTRY-REF DEST="BSW-MODULE-ENTRY">/Pwm_TI_AM263Px/Pwm_ModuleEntry/Pwm_Ch72Isr</BSW-MODULE-ENTRY-REF>
            </BSW-MODULE-ENTRY-REF-CONDITIONAL>
            [!ENDIF!][!//
            [!IF "PwmChannelId = '73'"!][!//
            <BSW-MODULE-ENTRY-REF-CONDITIONAL>
              <BSW-MODULE-ENTRY-REF DEST="BSW-MODULE-ENTRY">/Pwm_TI_AM263Px/Pwm_ModuleEntry/Pwm_Ch73Isr</BSW-MODULE-ENTRY-REF>
            </BSW-MODULE-ENTRY-REF-CONDITIONAL>
            [!ENDIF!][!//
            [!IF "PwmChannelId = '74'"!][!//
            <BSW-MODULE-ENTRY-REF-CONDITIONAL>
              <BSW-MODULE-ENTRY-REF DEST="BSW-MODULE-ENTRY">/Pwm_TI_AM263Px/Pwm_ModuleEntry/Pwm_Ch74Isr</BSW-MODULE-ENTRY-REF>
            </BSW-MODULE-ENTRY-REF-CONDITIONAL>
            [!ENDIF!][!//
            [!IF "PwmChannelId = '75'"!][!//
            <BSW-MODULE-ENTRY-REF-CONDITIONAL>
              <BSW-MODULE-ENTRY-REF DEST="BSW-MODULE-ENTRY">/Pwm_TI_AM263Px/Pwm_ModuleEntry/Pwm_Ch75Isr</BSW-MODULE-ENTRY-REF>
            </BSW-MODULE-ENTRY-REF-CONDITIONAL>
            [!ENDIF!][!//
            [!IF "PwmChannelId = '76'"!][!//
            <BSW-MODULE-ENTRY-REF-CONDITIONAL>
              <BSW-MODULE-ENTRY-REF DEST="BSW-MODULE-ENTRY">/Pwm_TI_AM263Px/Pwm_ModuleEntry/Pwm_Ch76Isr</BSW-MODULE-ENTRY-REF>
            </BSW-MODULE-ENTRY-REF-CONDITIONAL>
            [!ENDIF!][!//
            [!IF "PwmChannelId = '77'"!][!//
            <BSW-MODULE-ENTRY-REF-CONDITIONAL>
              <BSW-MODULE-ENTRY-REF DEST="BSW-MODULE-ENTRY">/Pwm_TI_AM263Px/Pwm_ModuleEntry/Pwm_Ch77Isr</BSW-MODULE-ENTRY-REF>
            </BSW-MODULE-ENTRY-REF-CONDITIONAL>
            [!ENDIF!][!//
            [!IF "PwmChannelId = '78'"!][!//
            <BSW-MODULE-ENTRY-REF-CONDITIONAL>
              <BSW-MODULE-ENTRY-REF DEST="BSW-MODULE-ENTRY">/Pwm_TI_AM263Px/Pwm_ModuleEntry/Pwm_Ch78Isr</BSW-MODULE-ENTRY-REF>
            </BSW-MODULE-ENTRY-REF-CONDITIONAL>
            [!ENDIF!][!//
            [!IF "PwmChannelId = '79'"!][!//
            <BSW-MODULE-ENTRY-REF-CONDITIONAL>
              <BSW-MODULE-ENTRY-REF DEST="BSW-MODULE-ENTRY">/Pwm_TI_AM263Px/Pwm_ModuleEntry/Pwm_Ch79Isr</BSW-MODULE-ENTRY-REF>
            </BSW-MODULE-ENTRY-REF-CONDITIONAL>
            [!ENDIF!][!//
            [!IF "PwmChannelId = '7'"!][!//
            <BSW-MODULE-ENTRY-REF-CONDITIONAL>
              <BSW-MODULE-ENTRY-REF DEST="BSW-MODULE-ENTRY">/Pwm_TI_AM263Px/Pwm_ModuleEntry/Pwm_Ch7Isr</BSW-MODULE-ENTRY-REF>
            </BSW-MODULE-ENTRY-REF-CONDITIONAL>
            [!ENDIF!][!//
            [!IF "PwmChannelId = '80'"!][!//
            <BSW-MODULE-ENTRY-REF-CONDITIONAL>
              <BSW-MODULE-ENTRY-REF DEST="BSW-MODULE-ENTRY">/Pwm_TI_AM263Px/Pwm_ModuleEntry/Pwm_Ch80Isr</BSW-MODULE-ENTRY-REF>
            </BSW-MODULE-ENTRY-REF-CONDITIONAL>
            [!ENDIF!][!//
            [!IF "PwmChannelId = '81'"!][!//
            <BSW-MODULE-ENTRY-REF-CONDITIONAL>
              <BSW-MODULE-ENTRY-REF DEST="BSW-MODULE-ENTRY">/Pwm_TI_AM263Px/Pwm_ModuleEntry/Pwm_Ch81Isr</BSW-MODULE-ENTRY-REF>
            </BSW-MODULE-ENTRY-REF-CONDITIONAL>
            [!ENDIF!][!//
            [!IF "PwmChannelId = '82'"!][!//
            <BSW-MODULE-ENTRY-REF-CONDITIONAL>
              <BSW-MODULE-ENTRY-REF DEST="BSW-MODULE-ENTRY">/Pwm_TI_AM263Px/Pwm_ModuleEntry/Pwm_Ch82Isr</BSW-MODULE-ENTRY-REF>
            </BSW-MODULE-ENTRY-REF-CONDITIONAL>
            [!ENDIF!][!//
            [!IF "PwmChannelId = '83'"!][!//
            <BSW-MODULE-ENTRY-REF-CONDITIONAL>
              <BSW-MODULE-ENTRY-REF DEST="BSW-MODULE-ENTRY">/Pwm_TI_AM263Px/Pwm_ModuleEntry/Pwm_Ch83Isr</BSW-MODULE-ENTRY-REF>
            </BSW-MODULE-ENTRY-REF-CONDITIONAL>
            [!ENDIF!][!//
            [!IF "PwmChannelId = '84'"!][!//
            <BSW-MODULE-ENTRY-REF-CONDITIONAL>
              <BSW-MODULE-ENTRY-REF DEST="BSW-MODULE-ENTRY">/Pwm_TI_AM263Px/Pwm_ModuleEntry/Pwm_Ch84Isr</BSW-MODULE-ENTRY-REF>
            </BSW-MODULE-ENTRY-REF-CONDITIONAL>
            [!ENDIF!][!//
            [!IF "PwmChannelId = '85'"!][!//
            <BSW-MODULE-ENTRY-REF-CONDITIONAL>
              <BSW-MODULE-ENTRY-REF DEST="BSW-MODULE-ENTRY">/Pwm_TI_AM263Px/Pwm_ModuleEntry/Pwm_Ch85Isr</BSW-MODULE-ENTRY-REF>
            </BSW-MODULE-ENTRY-REF-CONDITIONAL>
            [!ENDIF!][!//
            [!IF "PwmChannelId = '86'"!][!//
            <BSW-MODULE-ENTRY-REF-CONDITIONAL>
              <BSW-MODULE-ENTRY-REF DEST="BSW-MODULE-ENTRY">/Pwm_TI_AM263Px/Pwm_ModuleEntry/Pwm_Ch86Isr</BSW-MODULE-ENTRY-REF>
            </BSW-MODULE-ENTRY-REF-CONDITIONAL>
            [!ENDIF!][!//
            [!IF "PwmChannelId = '87'"!][!//
            <BSW-MODULE-ENTRY-REF-CONDITIONAL>
              <BSW-MODULE-ENTRY-REF DEST="BSW-MODULE-ENTRY">/Pwm_TI_AM263Px/Pwm_ModuleEntry/Pwm_Ch87Isr</BSW-MODULE-ENTRY-REF>
            </BSW-MODULE-ENTRY-REF-CONDITIONAL>
            [!ENDIF!][!//
            [!IF "PwmChannelId = '88'"!][!//
            <BSW-MODULE-ENTRY-REF-CONDITIONAL>
              <BSW-MODULE-ENTRY-REF DEST="BSW-MODULE-ENTRY">/Pwm_TI_AM263Px/Pwm_ModuleEntry/Pwm_Ch88Isr</BSW-MODULE-ENTRY-REF>
            </BSW-MODULE-ENTRY-REF-CONDITIONAL>
            [!ENDIF!][!//
            [!IF "PwmChannelId = '89'"!][!//
            <BSW-MODULE-ENTRY-REF-CONDITIONAL>
              <BSW-MODULE-ENTRY-REF DEST="BSW-MODULE-ENTRY">/Pwm_TI_AM263Px/Pwm_ModuleEntry/Pwm_Ch89Isr</BSW-MODULE-ENTRY-REF>
            </BSW-MODULE-ENTRY-REF-CONDITIONAL>
            [!ENDIF!][!//
            [!IF "PwmChannelId = '8'"!][!//
            <BSW-MODULE-ENTRY-REF-CONDITIONAL>
              <BSW-MODULE-ENTRY-REF DEST="BSW-MODULE-ENTRY">/Pwm_TI_AM263Px/Pwm_ModuleEntry/Pwm_Ch8Isr</BSW-MODULE-ENTRY-REF>
            </BSW-MODULE-ENTRY-REF-CONDITIONAL>
            [!ENDIF!][!//
            [!IF "PwmChannelId = '90'"!][!//
            <BSW-MODULE-ENTRY-REF-CONDITIONAL>
              <BSW-MODULE-ENTRY-REF DEST="BSW-MODULE-ENTRY">/Pwm_TI_AM263Px/Pwm_ModuleEntry/Pwm_Ch90Isr</BSW-MODULE-ENTRY-REF>
            </BSW-MODULE-ENTRY-REF-CONDITIONAL>
            [!ENDIF!][!//
            [!IF "PwmChannelId = '91'"!][!//
            <BSW-MODULE-ENTRY-REF-CONDITIONAL>
              <BSW-MODULE-ENTRY-REF DEST="BSW-MODULE-ENTRY">/Pwm_TI_AM263Px/Pwm_ModuleEntry/Pwm_Ch91Isr</BSW-MODULE-ENTRY-REF>
            </BSW-MODULE-ENTRY-REF-CONDITIONAL>
            [!ENDIF!][!//
            [!IF "PwmChannelId = '92'"!][!//
            <BSW-MODULE-ENTRY-REF-CONDITIONAL>
              <BSW-MODULE-ENTRY-REF DEST="BSW-MODULE-ENTRY">/Pwm_TI_AM263Px/Pwm_ModuleEntry/Pwm_Ch92Isr</BSW-MODULE-ENTRY-REF>
            </BSW-MODULE-ENTRY-REF-CONDITIONAL>
            [!ENDIF!][!//
            [!IF "PwmChannelId = '93'"!][!//
            <BSW-MODULE-ENTRY-REF-CONDITIONAL>
              <BSW-MODULE-ENTRY-REF DEST="BSW-MODULE-ENTRY">/Pwm_TI_AM263Px/Pwm_ModuleEntry/Pwm_Ch93Isr</BSW-MODULE-ENTRY-REF>
            </BSW-MODULE-ENTRY-REF-CONDITIONAL>
            [!ENDIF!][!//
            [!IF "PwmChannelId = '94'"!][!//
            <BSW-MODULE-ENTRY-REF-CONDITIONAL>
              <BSW-MODULE-ENTRY-REF DEST="BSW-MODULE-ENTRY">/Pwm_TI_AM263Px/Pwm_ModuleEntry/Pwm_Ch94Isr</BSW-MODULE-ENTRY-REF>
            </BSW-MODULE-ENTRY-REF-CONDITIONAL>
            [!ENDIF!][!//
            [!IF "PwmChannelId = '95'"!][!//
            <BSW-MODULE-ENTRY-REF-CONDITIONAL>
              <BSW-MODULE-ENTRY-REF DEST="BSW-MODULE-ENTRY">/Pwm_TI_AM263Px/Pwm_ModuleEntry/Pwm_Ch95Isr</BSW-MODULE-ENTRY-REF>
            </BSW-MODULE-ENTRY-REF-CONDITIONAL>
            [!ENDIF!][!//
            [!IF "PwmChannelId = '96'"!][!//
            <BSW-MODULE-ENTRY-REF-CONDITIONAL>
              <BSW-MODULE-ENTRY-REF DEST="BSW-MODULE-ENTRY">/Pwm_TI_AM263Px/Pwm_ModuleEntry/Pwm_Ch96Isr</BSW-MODULE-ENTRY-REF>
            </BSW-MODULE-ENTRY-REF-CONDITIONAL>
            [!ENDIF!][!//
            [!IF "PwmChannelId = '97'"!][!//
            <BSW-MODULE-ENTRY-REF-CONDITIONAL>
              <BSW-MODULE-ENTRY-REF DEST="BSW-MODULE-ENTRY">/Pwm_TI_AM263Px/Pwm_ModuleEntry/Pwm_Ch97Isr</BSW-MODULE-ENTRY-REF>
            </BSW-MODULE-ENTRY-REF-CONDITIONAL>
            [!ENDIF!][!//
            [!IF "PwmChannelId = '98'"!][!//
            <BSW-MODULE-ENTRY-REF-CONDITIONAL>
              <BSW-MODULE-ENTRY-REF DEST="BSW-MODULE-ENTRY">/Pwm_TI_AM263Px/Pwm_ModuleEntry/Pwm_Ch98Isr</BSW-MODULE-ENTRY-REF>
            </BSW-MODULE-ENTRY-REF-CONDITIONAL>
            [!ENDIF!][!//
            [!IF "PwmChannelId = '99'"!][!//
            <BSW-MODULE-ENTRY-REF-CONDITIONAL>
              <BSW-MODULE-ENTRY-REF DEST="BSW-MODULE-ENTRY">/Pwm_TI_AM263Px/Pwm_ModuleEntry/Pwm_Ch99Isr</BSW-MODULE-ENTRY-REF>
            </BSW-MODULE-ENTRY-REF-CONDITIONAL>
            [!ENDIF!][!//
            [!IF "PwmChannelId = '9'"!][!//
            <BSW-MODULE-ENTRY-REF-CONDITIONAL>
              <BSW-MODULE-ENTRY-REF DEST="BSW-MODULE-ENTRY">/Pwm_TI_AM263Px/Pwm_ModuleEntry/Pwm_Ch9Isr</BSW-MODULE-ENTRY-REF>
            </BSW-MODULE-ENTRY-REF-CONDITIONAL>
            [!ENDIF!][!//
            [!ENDLOOP!][!//
            [!IF "as:modconf('Pwm')[1]/PwmConfigurationOfOptApiServices/PwmDeInitApi = 'true'"!][!//
            <BSW-MODULE-ENTRY-REF-CONDITIONAL>
              <BSW-MODULE-ENTRY-REF DEST="BSW-MODULE-ENTRY">/Pwm_TI_AM263Px/Pwm_ModuleEntry/Pwm_DeInit</BSW-MODULE-ENTRY-REF>
            </BSW-MODULE-ENTRY-REF-CONDITIONAL>
            [!ENDIF!][!//
            [!IF "as:modconf('Pwm')[1]/PwmGeneral/PwmNotificationSupported = 'true'"!][!//
            <BSW-MODULE-ENTRY-REF-CONDITIONAL>
              <BSW-MODULE-ENTRY-REF DEST="BSW-MODULE-ENTRY">/Pwm_TI_AM263Px/Pwm_ModuleEntry/Pwm_DisableNotification</BSW-MODULE-ENTRY-REF>
            </BSW-MODULE-ENTRY-REF-CONDITIONAL>
            [!ENDIF!][!//
            [!IF "as:modconf('Pwm')[1]/PwmGeneral/PwmNotificationSupported = 'true'"!][!//
            <BSW-MODULE-ENTRY-REF-CONDITIONAL>
              <BSW-MODULE-ENTRY-REF DEST="BSW-MODULE-ENTRY">/Pwm_TI_AM263Px/Pwm_ModuleEntry/Pwm_EnableNotification</BSW-MODULE-ENTRY-REF>
            </BSW-MODULE-ENTRY-REF-CONDITIONAL>
            [!ENDIF!][!//
            [!IF "as:modconf('Pwm')[1]/PwmConfigurationOfOptApiServices/PwmGetOutputState = 'true'"!][!//
            <BSW-MODULE-ENTRY-REF-CONDITIONAL>
              <BSW-MODULE-ENTRY-REF DEST="BSW-MODULE-ENTRY">/Pwm_TI_AM263Px/Pwm_ModuleEntry/Pwm_GetOutputState</BSW-MODULE-ENTRY-REF>
            </BSW-MODULE-ENTRY-REF-CONDITIONAL>
            [!ENDIF!][!//
            [!IF "as:modconf('Pwm')[1]/PwmConfigurationOfOptApiServices/PwmVersionInfoApi = 'true'"!][!//
            <BSW-MODULE-ENTRY-REF-CONDITIONAL>
              <BSW-MODULE-ENTRY-REF DEST="BSW-MODULE-ENTRY">/Pwm_TI_AM263Px/Pwm_ModuleEntry/Pwm_GetVersionInfo</BSW-MODULE-ENTRY-REF>
            </BSW-MODULE-ENTRY-REF-CONDITIONAL>
            [!ENDIF!][!//
            <BSW-MODULE-ENTRY-REF-CONDITIONAL>
              <BSW-MODULE-ENTRY-REF DEST="BSW-MODULE-ENTRY">/Pwm_TI_AM263Px/Pwm_ModuleEntry/Pwm_Init</BSW-MODULE-ENTRY-REF>
            </BSW-MODULE-ENTRY-REF-CONDITIONAL>
            [!IF "as:modconf('Pwm')[1]/PwmConfigurationOfOptApiServices/PwmEnableRegisterReadbackApi = 'true'"!][!//
            <BSW-MODULE-ENTRY-REF-CONDITIONAL>
              <BSW-MODULE-ENTRY-REF DEST="BSW-MODULE-ENTRY">/Pwm_TI_AM263Px/Pwm_ModuleEntry/Pwm_RegisterReadback</BSW-MODULE-ENTRY-REF>
            </BSW-MODULE-ENTRY-REF-CONDITIONAL>
            [!ENDIF!][!//
            [!IF "as:modconf('Pwm')[1]/PwmConfigurationOfOptApiServices/PwmSetDutyCycle = 'true'"!][!//
            <BSW-MODULE-ENTRY-REF-CONDITIONAL>
              <BSW-MODULE-ENTRY-REF DEST="BSW-MODULE-ENTRY">/Pwm_TI_AM263Px/Pwm_ModuleEntry/Pwm_SetDutyCycle</BSW-MODULE-ENTRY-REF>
            </BSW-MODULE-ENTRY-REF-CONDITIONAL>
            [!ENDIF!][!//
            [!IF "as:modconf('Pwm')[1]/PwmConfigurationOfOptApiServices/PwmSetOutputToIdle = 'true'"!][!//
            <BSW-MODULE-ENTRY-REF-CONDITIONAL>
              <BSW-MODULE-ENTRY-REF DEST="BSW-MODULE-ENTRY">/Pwm_TI_AM263Px/Pwm_ModuleEntry/Pwm_SetOutputToIdle</BSW-MODULE-ENTRY-REF>
            </BSW-MODULE-ENTRY-REF-CONDITIONAL>
            [!ENDIF!][!//
            [!IF "as:modconf('Pwm')[1]/PwmConfigurationOfOptApiServices/PwmSetPeriodAndDuty = 'true'"!][!//
            <BSW-MODULE-ENTRY-REF-CONDITIONAL>
              <BSW-MODULE-ENTRY-REF DEST="BSW-MODULE-ENTRY">/Pwm_TI_AM263Px/Pwm_ModuleEntry/Pwm_SetPeriodAndDuty</BSW-MODULE-ENTRY-REF>
            </BSW-MODULE-ENTRY-REF-CONDITIONAL>
            [!ENDIF!][!//
          </IMPLEMENTED-ENTRYS>
          <MODULE-ID>121</MODULE-ID>
          <BSW-MODULE-DEPENDENCYS>
            [!IF "as:modconf('Pwm')[1]/PwmGeneral/PwmDevErrorDetect = 'true'"!][!//
            <BSW-MODULE-DEPENDENCY UUID="fb9fb20b-41dd-44be-85ba-f696bc291799">
              <SHORT-NAME>Det</SHORT-NAME>
              <TARGET-MODULE-ID>15</TARGET-MODULE-ID>
              <TARGET-MODULE-REFS>
                <BSW-MODULE-DESCRIPTION-REF-CONDITIONAL>
                  <BSW-MODULE-DESCRIPTION-REF DEST="BSW-MODULE-DESCRIPTION">/AUTOSAR_Det/Det</BSW-MODULE-DESCRIPTION-REF>
                </BSW-MODULE-DESCRIPTION-REF-CONDITIONAL>
              </TARGET-MODULE-REFS>
            </BSW-MODULE-DEPENDENCY>
            [!ENDIF!][!//
          </BSW-MODULE-DEPENDENCYS>
          <INTERNAL-BEHAVIORS>
            <BSW-INTERNAL-BEHAVIOR UUID="545cba72-7e9d-4b82-a776-f965a81d3077">
              <SHORT-NAME>Pwm_Behavior</SHORT-NAME>
              <EXCLUSIVE-AREAS>
                <EXCLUSIVE-AREA UUID="44ce0598-db74-4c06-b2ec-ce7472afbcb3">
                  <SHORT-NAME>PWM_EXCLUSIVE_AREA_0</SHORT-NAME>
                </EXCLUSIVE-AREA>
              </EXCLUSIVE-AREAS>
              <ENTITYS>
                [!LOOP "as:modconf('Pwm')[1]/PwmChannelConfigSet/PwmChannel/*"!][!//
                [!IF "PwmChannelId = '0'"!][!//
                <BSW-INTERRUPT-ENTITY UUID="8bb521da-fed2-44e4-beaa-041ec071da91">
                  <SHORT-NAME>Pwm_Ch0Isr</SHORT-NAME>
                  <MINIMUM-START-INTERVAL>0.0</MINIMUM-START-INTERVAL>
                  <REENTRANCY-LEVEL>NON-REENTRANT</REENTRANCY-LEVEL>
                  <IMPLEMENTED-ENTRY-REF DEST="BSW-MODULE-ENTRY">/Pwm_TI_AM263Px/Pwm_ModuleEntry/Pwm_Ch0Isr</IMPLEMENTED-ENTRY-REF>
                  [!IF "as:modconf('Pwm')[1]/PwmGeneral/PwmTypeofInterruptFunction = 'PWM_ISR_CAT2'"!][!//
                  <INTERRUPT-CATEGORY>CAT-2</INTERRUPT-CATEGORY>
                  [!ELSE!][!//
                  <INTERRUPT-CATEGORY>CAT-1</INTERRUPT-CATEGORY>
                  [!ENDIF!][!//
                  <INTERRUPT-SOURCE>Hardware</INTERRUPT-SOURCE>
                </BSW-INTERRUPT-ENTITY>
                [!ENDIF!][!//
                [!IF "PwmChannelId = '100'"!][!//
                <BSW-INTERRUPT-ENTITY UUID="3fadd299-a6f8-4d51-a993-f15ed32a9463">
                  <SHORT-NAME>Pwm_Ch100Isr</SHORT-NAME>
                  <MINIMUM-START-INTERVAL>0.0</MINIMUM-START-INTERVAL>
                  <REENTRANCY-LEVEL>NON-REENTRANT</REENTRANCY-LEVEL>
                  <IMPLEMENTED-ENTRY-REF DEST="BSW-MODULE-ENTRY">/Pwm_TI_AM263Px/Pwm_ModuleEntry/Pwm_Ch100Isr</IMPLEMENTED-ENTRY-REF>
                  [!IF "as:modconf('Pwm')[1]/PwmGeneral/PwmTypeofInterruptFunction = 'PWM_ISR_CAT2'"!][!//
                  <INTERRUPT-CATEGORY>CAT-2</INTERRUPT-CATEGORY>
                  [!ELSE!][!//
                  <INTERRUPT-CATEGORY>CAT-1</INTERRUPT-CATEGORY>
                  [!ENDIF!][!//
                  <INTERRUPT-SOURCE>Hardware</INTERRUPT-SOURCE>
                </BSW-INTERRUPT-ENTITY>
                [!ENDIF!][!//
                [!IF "PwmChannelId = '101'"!][!//
                <BSW-INTERRUPT-ENTITY UUID="467696b1-ec03-4119-af9d-8eda656616b0">
                  <SHORT-NAME>Pwm_Ch101Isr</SHORT-NAME>
                  <MINIMUM-START-INTERVAL>0.0</MINIMUM-START-INTERVAL>
                  <REENTRANCY-LEVEL>NON-REENTRANT</REENTRANCY-LEVEL>
                  <IMPLEMENTED-ENTRY-REF DEST="BSW-MODULE-ENTRY">/Pwm_TI_AM263Px/Pwm_ModuleEntry/Pwm_Ch101Isr</IMPLEMENTED-ENTRY-REF>
                  [!IF "as:modconf('Pwm')[1]/PwmGeneral/PwmTypeofInterruptFunction = 'PWM_ISR_CAT2'"!][!//
                  <INTERRUPT-CATEGORY>CAT-2</INTERRUPT-CATEGORY>
                  [!ELSE!][!//
                  <INTERRUPT-CATEGORY>CAT-1</INTERRUPT-CATEGORY>
                  [!ENDIF!][!//
                  <INTERRUPT-SOURCE>Hardware</INTERRUPT-SOURCE>
                </BSW-INTERRUPT-ENTITY>
                [!ENDIF!][!//
                [!IF "PwmChannelId = '102'"!][!//
                <BSW-INTERRUPT-ENTITY UUID="4c6efcee-7214-4ec9-a5cf-3d2f538570fc">
                  <SHORT-NAME>Pwm_Ch102Isr</SHORT-NAME>
                  <MINIMUM-START-INTERVAL>0.0</MINIMUM-START-INTERVAL>
                  <REENTRANCY-LEVEL>NON-REENTRANT</REENTRANCY-LEVEL>
                  <IMPLEMENTED-ENTRY-REF DEST="BSW-MODULE-ENTRY">/Pwm_TI_AM263Px/Pwm_ModuleEntry/Pwm_Ch102Isr</IMPLEMENTED-ENTRY-REF>
                  [!IF "as:modconf('Pwm')[1]/PwmGeneral/PwmTypeofInterruptFunction = 'PWM_ISR_CAT2'"!][!//
                  <INTERRUPT-CATEGORY>CAT-2</INTERRUPT-CATEGORY>
                  [!ELSE!][!//
                  <INTERRUPT-CATEGORY>CAT-1</INTERRUPT-CATEGORY>
                  [!ENDIF!][!//
                  <INTERRUPT-SOURCE>Hardware</INTERRUPT-SOURCE>
                </BSW-INTERRUPT-ENTITY>
                [!ENDIF!][!//
                [!IF "PwmChannelId = '103'"!][!//
                <BSW-INTERRUPT-ENTITY UUID="f60e5cb2-a612-43a6-977e-11e062aa1919">
                  <SHORT-NAME>Pwm_Ch103Isr</SHORT-NAME>
                  <MINIMUM-START-INTERVAL>0.0</MINIMUM-START-INTERVAL>
                  <REENTRANCY-LEVEL>NON-REENTRANT</REENTRANCY-LEVEL>
                  <IMPLEMENTED-ENTRY-REF DEST="BSW-MODULE-ENTRY">/Pwm_TI_AM263Px/Pwm_ModuleEntry/Pwm_Ch103Isr</IMPLEMENTED-ENTRY-REF>
                  [!IF "as:modconf('Pwm')[1]/PwmGeneral/PwmTypeofInterruptFunction = 'PWM_ISR_CAT2'"!][!//
                  <INTERRUPT-CATEGORY>CAT-2</INTERRUPT-CATEGORY>
                  [!ELSE!][!//
                  <INTERRUPT-CATEGORY>CAT-1</INTERRUPT-CATEGORY>
                  [!ENDIF!][!//
                  <INTERRUPT-SOURCE>Hardware</INTERRUPT-SOURCE>
                </BSW-INTERRUPT-ENTITY>
                [!ENDIF!][!//
                [!IF "PwmChannelId = '104'"!][!//
                <BSW-INTERRUPT-ENTITY UUID="6329ed78-26b1-4725-bc94-3bc54d7e2c95">
                  <SHORT-NAME>Pwm_Ch104Isr</SHORT-NAME>
                  <MINIMUM-START-INTERVAL>0.0</MINIMUM-START-INTERVAL>
                  <REENTRANCY-LEVEL>NON-REENTRANT</REENTRANCY-LEVEL>
                  <IMPLEMENTED-ENTRY-REF DEST="BSW-MODULE-ENTRY">/Pwm_TI_AM263Px/Pwm_ModuleEntry/Pwm_Ch104Isr</IMPLEMENTED-ENTRY-REF>
                  [!IF "as:modconf('Pwm')[1]/PwmGeneral/PwmTypeofInterruptFunction = 'PWM_ISR_CAT2'"!][!//
                  <INTERRUPT-CATEGORY>CAT-2</INTERRUPT-CATEGORY>
                  [!ELSE!][!//
                  <INTERRUPT-CATEGORY>CAT-1</INTERRUPT-CATEGORY>
                  [!ENDIF!][!//
                  <INTERRUPT-SOURCE>Hardware</INTERRUPT-SOURCE>
                </BSW-INTERRUPT-ENTITY>
                [!ENDIF!][!//
                [!IF "PwmChannelId = '105'"!][!//
                <BSW-INTERRUPT-ENTITY UUID="f79e69ad-54b6-4cc4-a434-19bbe43d1320">
                  <SHORT-NAME>Pwm_Ch105Isr</SHORT-NAME>
                  <MINIMUM-START-INTERVAL>0.0</MINIMUM-START-INTERVAL>
                  <REENTRANCY-LEVEL>NON-REENTRANT</REENTRANCY-LEVEL>
                  <IMPLEMENTED-ENTRY-REF DEST="BSW-MODULE-ENTRY">/Pwm_TI_AM263Px/Pwm_ModuleEntry/Pwm_Ch105Isr</IMPLEMENTED-ENTRY-REF>
                  [!IF "as:modconf('Pwm')[1]/PwmGeneral/PwmTypeofInterruptFunction = 'PWM_ISR_CAT2'"!][!//
                  <INTERRUPT-CATEGORY>CAT-2</INTERRUPT-CATEGORY>
                  [!ELSE!][!//
                  <INTERRUPT-CATEGORY>CAT-1</INTERRUPT-CATEGORY>
                  [!ENDIF!][!//
                  <INTERRUPT-SOURCE>Hardware</INTERRUPT-SOURCE>
                </BSW-INTERRUPT-ENTITY>
                [!ENDIF!][!//
                [!IF "PwmChannelId = '106'"!][!//
                <BSW-INTERRUPT-ENTITY UUID="90eb9458-fbf0-4b8b-8d3b-0e93508e7cd2">
                  <SHORT-NAME>Pwm_Ch106Isr</SHORT-NAME>
                  <MINIMUM-START-INTERVAL>0.0</MINIMUM-START-INTERVAL>
                  <REENTRANCY-LEVEL>NON-REENTRANT</REENTRANCY-LEVEL>
                  <IMPLEMENTED-ENTRY-REF DEST="BSW-MODULE-ENTRY">/Pwm_TI_AM263Px/Pwm_ModuleEntry/Pwm_Ch106Isr</IMPLEMENTED-ENTRY-REF>
                  [!IF "as:modconf('Pwm')[1]/PwmGeneral/PwmTypeofInterruptFunction = 'PWM_ISR_CAT2'"!][!//
                  <INTERRUPT-CATEGORY>CAT-2</INTERRUPT-CATEGORY>
                  [!ELSE!][!//
                  <INTERRUPT-CATEGORY>CAT-1</INTERRUPT-CATEGORY>
                  [!ENDIF!][!//
                  <INTERRUPT-SOURCE>Hardware</INTERRUPT-SOURCE>
                </BSW-INTERRUPT-ENTITY>
                [!ENDIF!][!//
                [!IF "PwmChannelId = '107'"!][!//
                <BSW-INTERRUPT-ENTITY UUID="589cfd19-7632-4c21-a7b1-387c8892f52c">
                  <SHORT-NAME>Pwm_Ch107Isr</SHORT-NAME>
                  <MINIMUM-START-INTERVAL>0.0</MINIMUM-START-INTERVAL>
                  <REENTRANCY-LEVEL>NON-REENTRANT</REENTRANCY-LEVEL>
                  <IMPLEMENTED-ENTRY-REF DEST="BSW-MODULE-ENTRY">/Pwm_TI_AM263Px/Pwm_ModuleEntry/Pwm_Ch107Isr</IMPLEMENTED-ENTRY-REF>
                  [!IF "as:modconf('Pwm')[1]/PwmGeneral/PwmTypeofInterruptFunction = 'PWM_ISR_CAT2'"!][!//
                  <INTERRUPT-CATEGORY>CAT-2</INTERRUPT-CATEGORY>
                  [!ELSE!][!//
                  <INTERRUPT-CATEGORY>CAT-1</INTERRUPT-CATEGORY>
                  [!ENDIF!][!//
                  <INTERRUPT-SOURCE>Hardware</INTERRUPT-SOURCE>
                </BSW-INTERRUPT-ENTITY>
                [!ENDIF!][!//
                [!IF "PwmChannelId = '108'"!][!//
                <BSW-INTERRUPT-ENTITY UUID="b63cb987-81fa-4982-8cf5-1a62e2c22254">
                  <SHORT-NAME>Pwm_Ch108Isr</SHORT-NAME>
                  <MINIMUM-START-INTERVAL>0.0</MINIMUM-START-INTERVAL>
                  <REENTRANCY-LEVEL>NON-REENTRANT</REENTRANCY-LEVEL>
                  <IMPLEMENTED-ENTRY-REF DEST="BSW-MODULE-ENTRY">/Pwm_TI_AM263Px/Pwm_ModuleEntry/Pwm_Ch108Isr</IMPLEMENTED-ENTRY-REF>
                  [!IF "as:modconf('Pwm')[1]/PwmGeneral/PwmTypeofInterruptFunction = 'PWM_ISR_CAT2'"!][!//
                  <INTERRUPT-CATEGORY>CAT-2</INTERRUPT-CATEGORY>
                  [!ELSE!][!//
                  <INTERRUPT-CATEGORY>CAT-1</INTERRUPT-CATEGORY>
                  [!ENDIF!][!//
                  <INTERRUPT-SOURCE>Hardware</INTERRUPT-SOURCE>
                </BSW-INTERRUPT-ENTITY>
                [!ENDIF!][!//
                [!IF "PwmChannelId = '109'"!][!//
                <BSW-INTERRUPT-ENTITY UUID="70b1f131-7779-4179-8639-fe83ddcb8938">
                  <SHORT-NAME>Pwm_Ch109Isr</SHORT-NAME>
                  <MINIMUM-START-INTERVAL>0.0</MINIMUM-START-INTERVAL>
                  <REENTRANCY-LEVEL>NON-REENTRANT</REENTRANCY-LEVEL>
                  <IMPLEMENTED-ENTRY-REF DEST="BSW-MODULE-ENTRY">/Pwm_TI_AM263Px/Pwm_ModuleEntry/Pwm_Ch109Isr</IMPLEMENTED-ENTRY-REF>
                  [!IF "as:modconf('Pwm')[1]/PwmGeneral/PwmTypeofInterruptFunction = 'PWM_ISR_CAT2'"!][!//
                  <INTERRUPT-CATEGORY>CAT-2</INTERRUPT-CATEGORY>
                  [!ELSE!][!//
                  <INTERRUPT-CATEGORY>CAT-1</INTERRUPT-CATEGORY>
                  [!ENDIF!][!//
                  <INTERRUPT-SOURCE>Hardware</INTERRUPT-SOURCE>
                </BSW-INTERRUPT-ENTITY>
                [!ENDIF!][!//
                [!IF "PwmChannelId = '10'"!][!//
                <BSW-INTERRUPT-ENTITY UUID="0365f434-8fd1-45a8-a2fc-45e9ad6129d8">
                  <SHORT-NAME>Pwm_Ch10Isr</SHORT-NAME>
                  <MINIMUM-START-INTERVAL>0.0</MINIMUM-START-INTERVAL>
                  <REENTRANCY-LEVEL>NON-REENTRANT</REENTRANCY-LEVEL>
                  <IMPLEMENTED-ENTRY-REF DEST="BSW-MODULE-ENTRY">/Pwm_TI_AM263Px/Pwm_ModuleEntry/Pwm_Ch10Isr</IMPLEMENTED-ENTRY-REF>
                  [!IF "as:modconf('Pwm')[1]/PwmGeneral/PwmTypeofInterruptFunction = 'PWM_ISR_CAT2'"!][!//
                  <INTERRUPT-CATEGORY>CAT-2</INTERRUPT-CATEGORY>
                  [!ELSE!][!//
                  <INTERRUPT-CATEGORY>CAT-1</INTERRUPT-CATEGORY>
                  [!ENDIF!][!//
                  <INTERRUPT-SOURCE>Hardware</INTERRUPT-SOURCE>
                </BSW-INTERRUPT-ENTITY>
                [!ENDIF!][!//
                [!IF "PwmChannelId = '110'"!][!//
                <BSW-INTERRUPT-ENTITY UUID="1157936c-c788-40fc-a007-1d4aff36bc05">
                  <SHORT-NAME>Pwm_Ch110Isr</SHORT-NAME>
                  <MINIMUM-START-INTERVAL>0.0</MINIMUM-START-INTERVAL>
                  <REENTRANCY-LEVEL>NON-REENTRANT</REENTRANCY-LEVEL>
                  <IMPLEMENTED-ENTRY-REF DEST="BSW-MODULE-ENTRY">/Pwm_TI_AM263Px/Pwm_ModuleEntry/Pwm_Ch110Isr</IMPLEMENTED-ENTRY-REF>
                  [!IF "as:modconf('Pwm')[1]/PwmGeneral/PwmTypeofInterruptFunction = 'PWM_ISR_CAT2'"!][!//
                  <INTERRUPT-CATEGORY>CAT-2</INTERRUPT-CATEGORY>
                  [!ELSE!][!//
                  <INTERRUPT-CATEGORY>CAT-1</INTERRUPT-CATEGORY>
                  [!ENDIF!][!//
                  <INTERRUPT-SOURCE>Hardware</INTERRUPT-SOURCE>
                </BSW-INTERRUPT-ENTITY>
                [!ENDIF!][!//
                [!IF "PwmChannelId = '111'"!][!//
                <BSW-INTERRUPT-ENTITY UUID="c96e72f9-9a39-41e2-913b-f09e9098d33b">
                  <SHORT-NAME>Pwm_Ch111Isr</SHORT-NAME>
                  <MINIMUM-START-INTERVAL>0.0</MINIMUM-START-INTERVAL>
                  <REENTRANCY-LEVEL>NON-REENTRANT</REENTRANCY-LEVEL>
                  <IMPLEMENTED-ENTRY-REF DEST="BSW-MODULE-ENTRY">/Pwm_TI_AM263Px/Pwm_ModuleEntry/Pwm_Ch111Isr</IMPLEMENTED-ENTRY-REF>
                  [!IF "as:modconf('Pwm')[1]/PwmGeneral/PwmTypeofInterruptFunction = 'PWM_ISR_CAT2'"!][!//
                  <INTERRUPT-CATEGORY>CAT-2</INTERRUPT-CATEGORY>
                  [!ELSE!][!//
                  <INTERRUPT-CATEGORY>CAT-1</INTERRUPT-CATEGORY>
                  [!ENDIF!][!//
                  <INTERRUPT-SOURCE>Hardware</INTERRUPT-SOURCE>
                </BSW-INTERRUPT-ENTITY>
                [!ENDIF!][!//
                [!IF "PwmChannelId = '112'"!][!//
                <BSW-INTERRUPT-ENTITY UUID="9ff1b2a8-8fd9-44cc-b1db-29db27bb6d74">
                  <SHORT-NAME>Pwm_Ch112Isr</SHORT-NAME>
                  <MINIMUM-START-INTERVAL>0.0</MINIMUM-START-INTERVAL>
                  <REENTRANCY-LEVEL>NON-REENTRANT</REENTRANCY-LEVEL>
                  <IMPLEMENTED-ENTRY-REF DEST="BSW-MODULE-ENTRY">/Pwm_TI_AM263Px/Pwm_ModuleEntry/Pwm_Ch112Isr</IMPLEMENTED-ENTRY-REF>
                  [!IF "as:modconf('Pwm')[1]/PwmGeneral/PwmTypeofInterruptFunction = 'PWM_ISR_CAT2'"!][!//
                  <INTERRUPT-CATEGORY>CAT-2</INTERRUPT-CATEGORY>
                  [!ELSE!][!//
                  <INTERRUPT-CATEGORY>CAT-1</INTERRUPT-CATEGORY>
                  [!ENDIF!][!//
                  <INTERRUPT-SOURCE>Hardware</INTERRUPT-SOURCE>
                </BSW-INTERRUPT-ENTITY>
                [!ENDIF!][!//
                [!IF "PwmChannelId = '113'"!][!//
                <BSW-INTERRUPT-ENTITY UUID="4ed3c519-8773-4c1d-81c7-8c603abc2cc6">
                  <SHORT-NAME>Pwm_Ch113Isr</SHORT-NAME>
                  <MINIMUM-START-INTERVAL>0.0</MINIMUM-START-INTERVAL>
                  <REENTRANCY-LEVEL>NON-REENTRANT</REENTRANCY-LEVEL>
                  <IMPLEMENTED-ENTRY-REF DEST="BSW-MODULE-ENTRY">/Pwm_TI_AM263Px/Pwm_ModuleEntry/Pwm_Ch113Isr</IMPLEMENTED-ENTRY-REF>
                  [!IF "as:modconf('Pwm')[1]/PwmGeneral/PwmTypeofInterruptFunction = 'PWM_ISR_CAT2'"!][!//
                  <INTERRUPT-CATEGORY>CAT-2</INTERRUPT-CATEGORY>
                  [!ELSE!][!//
                  <INTERRUPT-CATEGORY>CAT-1</INTERRUPT-CATEGORY>
                  [!ENDIF!][!//
                  <INTERRUPT-SOURCE>Hardware</INTERRUPT-SOURCE>
                </BSW-INTERRUPT-ENTITY>
                [!ENDIF!][!//
                [!IF "PwmChannelId = '114'"!][!//
                <BSW-INTERRUPT-ENTITY UUID="e9aeb87a-741f-4aa1-abd2-fcc3df36f9d7">
                  <SHORT-NAME>Pwm_Ch114Isr</SHORT-NAME>
                  <MINIMUM-START-INTERVAL>0.0</MINIMUM-START-INTERVAL>
                  <REENTRANCY-LEVEL>NON-REENTRANT</REENTRANCY-LEVEL>
                  <IMPLEMENTED-ENTRY-REF DEST="BSW-MODULE-ENTRY">/Pwm_TI_AM263Px/Pwm_ModuleEntry/Pwm_Ch114Isr</IMPLEMENTED-ENTRY-REF>
                  [!IF "as:modconf('Pwm')[1]/PwmGeneral/PwmTypeofInterruptFunction = 'PWM_ISR_CAT2'"!][!//
                  <INTERRUPT-CATEGORY>CAT-2</INTERRUPT-CATEGORY>
                  [!ELSE!][!//
                  <INTERRUPT-CATEGORY>CAT-1</INTERRUPT-CATEGORY>
                  [!ENDIF!][!//
                  <INTERRUPT-SOURCE>Hardware</INTERRUPT-SOURCE>
                </BSW-INTERRUPT-ENTITY>
                [!ENDIF!][!//
                [!IF "PwmChannelId = '115'"!][!//
                <BSW-INTERRUPT-ENTITY UUID="987130cd-b797-43b6-ac11-37365559d6ba">
                  <SHORT-NAME>Pwm_Ch115Isr</SHORT-NAME>
                  <MINIMUM-START-INTERVAL>0.0</MINIMUM-START-INTERVAL>
                  <REENTRANCY-LEVEL>NON-REENTRANT</REENTRANCY-LEVEL>
                  <IMPLEMENTED-ENTRY-REF DEST="BSW-MODULE-ENTRY">/Pwm_TI_AM263Px/Pwm_ModuleEntry/Pwm_Ch115Isr</IMPLEMENTED-ENTRY-REF>
                  [!IF "as:modconf('Pwm')[1]/PwmGeneral/PwmTypeofInterruptFunction = 'PWM_ISR_CAT2'"!][!//
                  <INTERRUPT-CATEGORY>CAT-2</INTERRUPT-CATEGORY>
                  [!ELSE!][!//
                  <INTERRUPT-CATEGORY>CAT-1</INTERRUPT-CATEGORY>
                  [!ENDIF!][!//
                  <INTERRUPT-SOURCE>Hardware</INTERRUPT-SOURCE>
                </BSW-INTERRUPT-ENTITY>
                [!ENDIF!][!//
                [!IF "PwmChannelId = '116'"!][!//
                <BSW-INTERRUPT-ENTITY UUID="e4a93a89-62c4-4a0f-969e-e19636b88ae0">
                  <SHORT-NAME>Pwm_Ch116Isr</SHORT-NAME>
                  <MINIMUM-START-INTERVAL>0.0</MINIMUM-START-INTERVAL>
                  <REENTRANCY-LEVEL>NON-REENTRANT</REENTRANCY-LEVEL>
                  <IMPLEMENTED-ENTRY-REF DEST="BSW-MODULE-ENTRY">/Pwm_TI_AM263Px/Pwm_ModuleEntry/Pwm_Ch116Isr</IMPLEMENTED-ENTRY-REF>
                  [!IF "as:modconf('Pwm')[1]/PwmGeneral/PwmTypeofInterruptFunction = 'PWM_ISR_CAT2'"!][!//
                  <INTERRUPT-CATEGORY>CAT-2</INTERRUPT-CATEGORY>
                  [!ELSE!][!//
                  <INTERRUPT-CATEGORY>CAT-1</INTERRUPT-CATEGORY>
                  [!ENDIF!][!//
                  <INTERRUPT-SOURCE>Hardware</INTERRUPT-SOURCE>
                </BSW-INTERRUPT-ENTITY>
                [!ENDIF!][!//
                [!IF "PwmChannelId = '117'"!][!//
                <BSW-INTERRUPT-ENTITY UUID="96cfa722-6cfa-4a4b-990c-1e0a9560c406">
                  <SHORT-NAME>Pwm_Ch117Isr</SHORT-NAME>
                  <MINIMUM-START-INTERVAL>0.0</MINIMUM-START-INTERVAL>
                  <REENTRANCY-LEVEL>NON-REENTRANT</REENTRANCY-LEVEL>
                  <IMPLEMENTED-ENTRY-REF DEST="BSW-MODULE-ENTRY">/Pwm_TI_AM263Px/Pwm_ModuleEntry/Pwm_Ch117Isr</IMPLEMENTED-ENTRY-REF>
                  [!IF "as:modconf('Pwm')[1]/PwmGeneral/PwmTypeofInterruptFunction = 'PWM_ISR_CAT2'"!][!//
                  <INTERRUPT-CATEGORY>CAT-2</INTERRUPT-CATEGORY>
                  [!ELSE!][!//
                  <INTERRUPT-CATEGORY>CAT-1</INTERRUPT-CATEGORY>
                  [!ENDIF!][!//
                  <INTERRUPT-SOURCE>Hardware</INTERRUPT-SOURCE>
                </BSW-INTERRUPT-ENTITY>
                [!ENDIF!][!//
                [!IF "PwmChannelId = '118'"!][!//
                <BSW-INTERRUPT-ENTITY UUID="aa6c37b7-4eec-4029-8e6c-f8ee6eb4f397">
                  <SHORT-NAME>Pwm_Ch118Isr</SHORT-NAME>
                  <MINIMUM-START-INTERVAL>0.0</MINIMUM-START-INTERVAL>
                  <REENTRANCY-LEVEL>NON-REENTRANT</REENTRANCY-LEVEL>
                  <IMPLEMENTED-ENTRY-REF DEST="BSW-MODULE-ENTRY">/Pwm_TI_AM263Px/Pwm_ModuleEntry/Pwm_Ch118Isr</IMPLEMENTED-ENTRY-REF>
                  [!IF "as:modconf('Pwm')[1]/PwmGeneral/PwmTypeofInterruptFunction = 'PWM_ISR_CAT2'"!][!//
                  <INTERRUPT-CATEGORY>CAT-2</INTERRUPT-CATEGORY>
                  [!ELSE!][!//
                  <INTERRUPT-CATEGORY>CAT-1</INTERRUPT-CATEGORY>
                  [!ENDIF!][!//
                  <INTERRUPT-SOURCE>Hardware</INTERRUPT-SOURCE>
                </BSW-INTERRUPT-ENTITY>
                [!ENDIF!][!//
                [!IF "PwmChannelId = '119'"!][!//
                <BSW-INTERRUPT-ENTITY UUID="62b8ea6d-1ff1-4ab8-88f8-df3c69c0f718">
                  <SHORT-NAME>Pwm_Ch119Isr</SHORT-NAME>
                  <MINIMUM-START-INTERVAL>0.0</MINIMUM-START-INTERVAL>
                  <REENTRANCY-LEVEL>NON-REENTRANT</REENTRANCY-LEVEL>
                  <IMPLEMENTED-ENTRY-REF DEST="BSW-MODULE-ENTRY">/Pwm_TI_AM263Px/Pwm_ModuleEntry/Pwm_Ch119Isr</IMPLEMENTED-ENTRY-REF>
                  [!IF "as:modconf('Pwm')[1]/PwmGeneral/PwmTypeofInterruptFunction = 'PWM_ISR_CAT2'"!][!//
                  <INTERRUPT-CATEGORY>CAT-2</INTERRUPT-CATEGORY>
                  [!ELSE!][!//
                  <INTERRUPT-CATEGORY>CAT-1</INTERRUPT-CATEGORY>
                  [!ENDIF!][!//
                  <INTERRUPT-SOURCE>Hardware</INTERRUPT-SOURCE>
                </BSW-INTERRUPT-ENTITY>
                [!ENDIF!][!//
                [!IF "PwmChannelId = '11'"!][!//
                <BSW-INTERRUPT-ENTITY UUID="32c25eee-5e87-4f9e-a087-f16e0c44a651">
                  <SHORT-NAME>Pwm_Ch11Isr</SHORT-NAME>
                  <MINIMUM-START-INTERVAL>0.0</MINIMUM-START-INTERVAL>
                  <REENTRANCY-LEVEL>NON-REENTRANT</REENTRANCY-LEVEL>
                  <IMPLEMENTED-ENTRY-REF DEST="BSW-MODULE-ENTRY">/Pwm_TI_AM263Px/Pwm_ModuleEntry/Pwm_Ch11Isr</IMPLEMENTED-ENTRY-REF>
                  [!IF "as:modconf('Pwm')[1]/PwmGeneral/PwmTypeofInterruptFunction = 'PWM_ISR_CAT2'"!][!//
                  <INTERRUPT-CATEGORY>CAT-2</INTERRUPT-CATEGORY>
                  [!ELSE!][!//
                  <INTERRUPT-CATEGORY>CAT-1</INTERRUPT-CATEGORY>
                  [!ENDIF!][!//
                  <INTERRUPT-SOURCE>Hardware</INTERRUPT-SOURCE>
                </BSW-INTERRUPT-ENTITY>
                [!ENDIF!][!//
                [!IF "PwmChannelId = '120'"!][!//
                <BSW-INTERRUPT-ENTITY UUID="0072e810-8041-4119-8c31-c9ecac45d073">
                  <SHORT-NAME>Pwm_Ch120Isr</SHORT-NAME>
                  <MINIMUM-START-INTERVAL>0.0</MINIMUM-START-INTERVAL>
                  <REENTRANCY-LEVEL>NON-REENTRANT</REENTRANCY-LEVEL>
                  <IMPLEMENTED-ENTRY-REF DEST="BSW-MODULE-ENTRY">/Pwm_TI_AM263Px/Pwm_ModuleEntry/Pwm_Ch120Isr</IMPLEMENTED-ENTRY-REF>
                  [!IF "as:modconf('Pwm')[1]/PwmGeneral/PwmTypeofInterruptFunction = 'PWM_ISR_CAT2'"!][!//
                  <INTERRUPT-CATEGORY>CAT-2</INTERRUPT-CATEGORY>
                  [!ELSE!][!//
                  <INTERRUPT-CATEGORY>CAT-1</INTERRUPT-CATEGORY>
                  [!ENDIF!][!//
                  <INTERRUPT-SOURCE>Hardware</INTERRUPT-SOURCE>
                </BSW-INTERRUPT-ENTITY>
                [!ENDIF!][!//
                [!IF "PwmChannelId = '121'"!][!//
                <BSW-INTERRUPT-ENTITY UUID="b2817e03-a545-4995-aef8-d9290f0ba52d">
                  <SHORT-NAME>Pwm_Ch121Isr</SHORT-NAME>
                  <MINIMUM-START-INTERVAL>0.0</MINIMUM-START-INTERVAL>
                  <REENTRANCY-LEVEL>NON-REENTRANT</REENTRANCY-LEVEL>
                  <IMPLEMENTED-ENTRY-REF DEST="BSW-MODULE-ENTRY">/Pwm_TI_AM263Px/Pwm_ModuleEntry/Pwm_Ch121Isr</IMPLEMENTED-ENTRY-REF>
                  [!IF "as:modconf('Pwm')[1]/PwmGeneral/PwmTypeofInterruptFunction = 'PWM_ISR_CAT2'"!][!//
                  <INTERRUPT-CATEGORY>CAT-2</INTERRUPT-CATEGORY>
                  [!ELSE!][!//
                  <INTERRUPT-CATEGORY>CAT-1</INTERRUPT-CATEGORY>
                  [!ENDIF!][!//
                  <INTERRUPT-SOURCE>Hardware</INTERRUPT-SOURCE>
                </BSW-INTERRUPT-ENTITY>
                [!ENDIF!][!//
                [!IF "PwmChannelId = '122'"!][!//
                <BSW-INTERRUPT-ENTITY UUID="b741bf4d-ecee-42a3-8d35-5a2779b71cc7">
                  <SHORT-NAME>Pwm_Ch122Isr</SHORT-NAME>
                  <MINIMUM-START-INTERVAL>0.0</MINIMUM-START-INTERVAL>
                  <REENTRANCY-LEVEL>NON-REENTRANT</REENTRANCY-LEVEL>
                  <IMPLEMENTED-ENTRY-REF DEST="BSW-MODULE-ENTRY">/Pwm_TI_AM263Px/Pwm_ModuleEntry/Pwm_Ch122Isr</IMPLEMENTED-ENTRY-REF>
                  [!IF "as:modconf('Pwm')[1]/PwmGeneral/PwmTypeofInterruptFunction = 'PWM_ISR_CAT2'"!][!//
                  <INTERRUPT-CATEGORY>CAT-2</INTERRUPT-CATEGORY>
                  [!ELSE!][!//
                  <INTERRUPT-CATEGORY>CAT-1</INTERRUPT-CATEGORY>
                  [!ENDIF!][!//
                  <INTERRUPT-SOURCE>Hardware</INTERRUPT-SOURCE>
                </BSW-INTERRUPT-ENTITY>
                [!ENDIF!][!//
                [!IF "PwmChannelId = '123'"!][!//
                <BSW-INTERRUPT-ENTITY UUID="6ce6bed7-0a45-4078-bd34-4b7b3e198f84">
                  <SHORT-NAME>Pwm_Ch123Isr</SHORT-NAME>
                  <MINIMUM-START-INTERVAL>0.0</MINIMUM-START-INTERVAL>
                  <REENTRANCY-LEVEL>NON-REENTRANT</REENTRANCY-LEVEL>
                  <IMPLEMENTED-ENTRY-REF DEST="BSW-MODULE-ENTRY">/Pwm_TI_AM263Px/Pwm_ModuleEntry/Pwm_Ch123Isr</IMPLEMENTED-ENTRY-REF>
                  [!IF "as:modconf('Pwm')[1]/PwmGeneral/PwmTypeofInterruptFunction = 'PWM_ISR_CAT2'"!][!//
                  <INTERRUPT-CATEGORY>CAT-2</INTERRUPT-CATEGORY>
                  [!ELSE!][!//
                  <INTERRUPT-CATEGORY>CAT-1</INTERRUPT-CATEGORY>
                  [!ENDIF!][!//
                  <INTERRUPT-SOURCE>Hardware</INTERRUPT-SOURCE>
                </BSW-INTERRUPT-ENTITY>
                [!ENDIF!][!//
                [!IF "PwmChannelId = '124'"!][!//
                <BSW-INTERRUPT-ENTITY UUID="069d7ed1-1cf9-4c63-80b3-ec0c1b572fed">
                  <SHORT-NAME>Pwm_Ch124Isr</SHORT-NAME>
                  <MINIMUM-START-INTERVAL>0.0</MINIMUM-START-INTERVAL>
                  <REENTRANCY-LEVEL>NON-REENTRANT</REENTRANCY-LEVEL>
                  <IMPLEMENTED-ENTRY-REF DEST="BSW-MODULE-ENTRY">/Pwm_TI_AM263Px/Pwm_ModuleEntry/Pwm_Ch124Isr</IMPLEMENTED-ENTRY-REF>
                  [!IF "as:modconf('Pwm')[1]/PwmGeneral/PwmTypeofInterruptFunction = 'PWM_ISR_CAT2'"!][!//
                  <INTERRUPT-CATEGORY>CAT-2</INTERRUPT-CATEGORY>
                  [!ELSE!][!//
                  <INTERRUPT-CATEGORY>CAT-1</INTERRUPT-CATEGORY>
                  [!ENDIF!][!//
                  <INTERRUPT-SOURCE>Hardware</INTERRUPT-SOURCE>
                </BSW-INTERRUPT-ENTITY>
                [!ENDIF!][!//
                [!IF "PwmChannelId = '125'"!][!//
                <BSW-INTERRUPT-ENTITY UUID="c7898cae-1168-47f4-82a6-4843d93186d0">
                  <SHORT-NAME>Pwm_Ch125Isr</SHORT-NAME>
                  <MINIMUM-START-INTERVAL>0.0</MINIMUM-START-INTERVAL>
                  <REENTRANCY-LEVEL>NON-REENTRANT</REENTRANCY-LEVEL>
                  <IMPLEMENTED-ENTRY-REF DEST="BSW-MODULE-ENTRY">/Pwm_TI_AM263Px/Pwm_ModuleEntry/Pwm_Ch125Isr</IMPLEMENTED-ENTRY-REF>
                  [!IF "as:modconf('Pwm')[1]/PwmGeneral/PwmTypeofInterruptFunction = 'PWM_ISR_CAT2'"!][!//
                  <INTERRUPT-CATEGORY>CAT-2</INTERRUPT-CATEGORY>
                  [!ELSE!][!//
                  <INTERRUPT-CATEGORY>CAT-1</INTERRUPT-CATEGORY>
                  [!ENDIF!][!//
                  <INTERRUPT-SOURCE>Hardware</INTERRUPT-SOURCE>
                </BSW-INTERRUPT-ENTITY>
                [!ENDIF!][!//
                [!IF "PwmChannelId = '126'"!][!//
                <BSW-INTERRUPT-ENTITY UUID="45fd27b9-7ed6-4ae7-aa74-65c89f951491">
                  <SHORT-NAME>Pwm_Ch126Isr</SHORT-NAME>
                  <MINIMUM-START-INTERVAL>0.0</MINIMUM-START-INTERVAL>
                  <REENTRANCY-LEVEL>NON-REENTRANT</REENTRANCY-LEVEL>
                  <IMPLEMENTED-ENTRY-REF DEST="BSW-MODULE-ENTRY">/Pwm_TI_AM263Px/Pwm_ModuleEntry/Pwm_Ch126Isr</IMPLEMENTED-ENTRY-REF>
                  [!IF "as:modconf('Pwm')[1]/PwmGeneral/PwmTypeofInterruptFunction = 'PWM_ISR_CAT2'"!][!//
                  <INTERRUPT-CATEGORY>CAT-2</INTERRUPT-CATEGORY>
                  [!ELSE!][!//
                  <INTERRUPT-CATEGORY>CAT-1</INTERRUPT-CATEGORY>
                  [!ENDIF!][!//
                  <INTERRUPT-SOURCE>Hardware</INTERRUPT-SOURCE>
                </BSW-INTERRUPT-ENTITY>
                [!ENDIF!][!//
                [!IF "PwmChannelId = '127'"!][!//
                <BSW-INTERRUPT-ENTITY UUID="0b480b8f-4292-4f16-9283-9b612f631a9c">
                  <SHORT-NAME>Pwm_Ch127Isr</SHORT-NAME>
                  <MINIMUM-START-INTERVAL>0.0</MINIMUM-START-INTERVAL>
                  <REENTRANCY-LEVEL>NON-REENTRANT</REENTRANCY-LEVEL>
                  <IMPLEMENTED-ENTRY-REF DEST="BSW-MODULE-ENTRY">/Pwm_TI_AM263Px/Pwm_ModuleEntry/Pwm_Ch127Isr</IMPLEMENTED-ENTRY-REF>
                  [!IF "as:modconf('Pwm')[1]/PwmGeneral/PwmTypeofInterruptFunction = 'PWM_ISR_CAT2'"!][!//
                  <INTERRUPT-CATEGORY>CAT-2</INTERRUPT-CATEGORY>
                  [!ELSE!][!//
                  <INTERRUPT-CATEGORY>CAT-1</INTERRUPT-CATEGORY>
                  [!ENDIF!][!//
                  <INTERRUPT-SOURCE>Hardware</INTERRUPT-SOURCE>
                </BSW-INTERRUPT-ENTITY>
                [!ENDIF!][!//
                [!IF "PwmChannelId = '12'"!][!//
                <BSW-INTERRUPT-ENTITY UUID="89a68e96-67df-4c5b-af8c-a7aa30463755">
                  <SHORT-NAME>Pwm_Ch12Isr</SHORT-NAME>
                  <MINIMUM-START-INTERVAL>0.0</MINIMUM-START-INTERVAL>
                  <REENTRANCY-LEVEL>NON-REENTRANT</REENTRANCY-LEVEL>
                  <IMPLEMENTED-ENTRY-REF DEST="BSW-MODULE-ENTRY">/Pwm_TI_AM263Px/Pwm_ModuleEntry/Pwm_Ch12Isr</IMPLEMENTED-ENTRY-REF>
                  [!IF "as:modconf('Pwm')[1]/PwmGeneral/PwmTypeofInterruptFunction = 'PWM_ISR_CAT2'"!][!//
                  <INTERRUPT-CATEGORY>CAT-2</INTERRUPT-CATEGORY>
                  [!ELSE!][!//
                  <INTERRUPT-CATEGORY>CAT-1</INTERRUPT-CATEGORY>
                  [!ENDIF!][!//
                  <INTERRUPT-SOURCE>Hardware</INTERRUPT-SOURCE>
                </BSW-INTERRUPT-ENTITY>
                [!ENDIF!][!//
                [!IF "PwmChannelId = '13'"!][!//
                <BSW-INTERRUPT-ENTITY UUID="5eaecaf1-f346-4f48-a3fe-42c19144e359">
                  <SHORT-NAME>Pwm_Ch13Isr</SHORT-NAME>
                  <MINIMUM-START-INTERVAL>0.0</MINIMUM-START-INTERVAL>
                  <REENTRANCY-LEVEL>NON-REENTRANT</REENTRANCY-LEVEL>
                  <IMPLEMENTED-ENTRY-REF DEST="BSW-MODULE-ENTRY">/Pwm_TI_AM263Px/Pwm_ModuleEntry/Pwm_Ch13Isr</IMPLEMENTED-ENTRY-REF>
                  [!IF "as:modconf('Pwm')[1]/PwmGeneral/PwmTypeofInterruptFunction = 'PWM_ISR_CAT2'"!][!//
                  <INTERRUPT-CATEGORY>CAT-2</INTERRUPT-CATEGORY>
                  [!ELSE!][!//
                  <INTERRUPT-CATEGORY>CAT-1</INTERRUPT-CATEGORY>
                  [!ENDIF!][!//
                  <INTERRUPT-SOURCE>Hardware</INTERRUPT-SOURCE>
                </BSW-INTERRUPT-ENTITY>
                [!ENDIF!][!//
                [!IF "PwmChannelId = '14'"!][!//
                <BSW-INTERRUPT-ENTITY UUID="f03bf9d1-d98c-400c-aa60-9d3b0d061e20">
                  <SHORT-NAME>Pwm_Ch14Isr</SHORT-NAME>
                  <MINIMUM-START-INTERVAL>0.0</MINIMUM-START-INTERVAL>
                  <REENTRANCY-LEVEL>NON-REENTRANT</REENTRANCY-LEVEL>
                  <IMPLEMENTED-ENTRY-REF DEST="BSW-MODULE-ENTRY">/Pwm_TI_AM263Px/Pwm_ModuleEntry/Pwm_Ch14Isr</IMPLEMENTED-ENTRY-REF>
                  [!IF "as:modconf('Pwm')[1]/PwmGeneral/PwmTypeofInterruptFunction = 'PWM_ISR_CAT2'"!][!//
                  <INTERRUPT-CATEGORY>CAT-2</INTERRUPT-CATEGORY>
                  [!ELSE!][!//
                  <INTERRUPT-CATEGORY>CAT-1</INTERRUPT-CATEGORY>
                  [!ENDIF!][!//
                  <INTERRUPT-SOURCE>Hardware</INTERRUPT-SOURCE>
                </BSW-INTERRUPT-ENTITY>
                [!ENDIF!][!//
                [!IF "PwmChannelId = '15'"!][!//
                <BSW-INTERRUPT-ENTITY UUID="21cc732d-8f65-4db9-a8c9-07a82e2779e2">
                  <SHORT-NAME>Pwm_Ch15Isr</SHORT-NAME>
                  <MINIMUM-START-INTERVAL>0.0</MINIMUM-START-INTERVAL>
                  <REENTRANCY-LEVEL>NON-REENTRANT</REENTRANCY-LEVEL>
                  <IMPLEMENTED-ENTRY-REF DEST="BSW-MODULE-ENTRY">/Pwm_TI_AM263Px/Pwm_ModuleEntry/Pwm_Ch15Isr</IMPLEMENTED-ENTRY-REF>
                  [!IF "as:modconf('Pwm')[1]/PwmGeneral/PwmTypeofInterruptFunction = 'PWM_ISR_CAT2'"!][!//
                  <INTERRUPT-CATEGORY>CAT-2</INTERRUPT-CATEGORY>
                  [!ELSE!][!//
                  <INTERRUPT-CATEGORY>CAT-1</INTERRUPT-CATEGORY>
                  [!ENDIF!][!//
                  <INTERRUPT-SOURCE>Hardware</INTERRUPT-SOURCE>
                </BSW-INTERRUPT-ENTITY>
                [!ENDIF!][!//
                [!IF "PwmChannelId = '16'"!][!//
                <BSW-INTERRUPT-ENTITY UUID="ec9452c5-8c2a-4c8c-9cad-eff5b4700469">
                  <SHORT-NAME>Pwm_Ch16Isr</SHORT-NAME>
                  <MINIMUM-START-INTERVAL>0.0</MINIMUM-START-INTERVAL>
                  <REENTRANCY-LEVEL>NON-REENTRANT</REENTRANCY-LEVEL>
                  <IMPLEMENTED-ENTRY-REF DEST="BSW-MODULE-ENTRY">/Pwm_TI_AM263Px/Pwm_ModuleEntry/Pwm_Ch16Isr</IMPLEMENTED-ENTRY-REF>
                  [!IF "as:modconf('Pwm')[1]/PwmGeneral/PwmTypeofInterruptFunction = 'PWM_ISR_CAT2'"!][!//
                  <INTERRUPT-CATEGORY>CAT-2</INTERRUPT-CATEGORY>
                  [!ELSE!][!//
                  <INTERRUPT-CATEGORY>CAT-1</INTERRUPT-CATEGORY>
                  [!ENDIF!][!//
                  <INTERRUPT-SOURCE>Hardware</INTERRUPT-SOURCE>
                </BSW-INTERRUPT-ENTITY>
                [!ENDIF!][!//
                [!IF "PwmChannelId = '17'"!][!//
                <BSW-INTERRUPT-ENTITY UUID="c808331f-4631-43ac-9da1-ffe9bddcb70b">
                  <SHORT-NAME>Pwm_Ch17Isr</SHORT-NAME>
                  <MINIMUM-START-INTERVAL>0.0</MINIMUM-START-INTERVAL>
                  <REENTRANCY-LEVEL>NON-REENTRANT</REENTRANCY-LEVEL>
                  <IMPLEMENTED-ENTRY-REF DEST="BSW-MODULE-ENTRY">/Pwm_TI_AM263Px/Pwm_ModuleEntry/Pwm_Ch17Isr</IMPLEMENTED-ENTRY-REF>
                  [!IF "as:modconf('Pwm')[1]/PwmGeneral/PwmTypeofInterruptFunction = 'PWM_ISR_CAT2'"!][!//
                  <INTERRUPT-CATEGORY>CAT-2</INTERRUPT-CATEGORY>
                  [!ELSE!][!//
                  <INTERRUPT-CATEGORY>CAT-1</INTERRUPT-CATEGORY>
                  [!ENDIF!][!//
                  <INTERRUPT-SOURCE>Hardware</INTERRUPT-SOURCE>
                </BSW-INTERRUPT-ENTITY>
                [!ENDIF!][!//
                [!IF "PwmChannelId = '18'"!][!//
                <BSW-INTERRUPT-ENTITY UUID="52ef6296-bafd-48e5-a868-d76670d31b5f">
                  <SHORT-NAME>Pwm_Ch18Isr</SHORT-NAME>
                  <MINIMUM-START-INTERVAL>0.0</MINIMUM-START-INTERVAL>
                  <REENTRANCY-LEVEL>NON-REENTRANT</REENTRANCY-LEVEL>
                  <IMPLEMENTED-ENTRY-REF DEST="BSW-MODULE-ENTRY">/Pwm_TI_AM263Px/Pwm_ModuleEntry/Pwm_Ch18Isr</IMPLEMENTED-ENTRY-REF>
                  [!IF "as:modconf('Pwm')[1]/PwmGeneral/PwmTypeofInterruptFunction = 'PWM_ISR_CAT2'"!][!//
                  <INTERRUPT-CATEGORY>CAT-2</INTERRUPT-CATEGORY>
                  [!ELSE!][!//
                  <INTERRUPT-CATEGORY>CAT-1</INTERRUPT-CATEGORY>
                  [!ENDIF!][!//
                  <INTERRUPT-SOURCE>Hardware</INTERRUPT-SOURCE>
                </BSW-INTERRUPT-ENTITY>
                [!ENDIF!][!//
                [!IF "PwmChannelId = '19'"!][!//
                <BSW-INTERRUPT-ENTITY UUID="2bd3d547-f554-4346-b92f-1e93c792e35b">
                  <SHORT-NAME>Pwm_Ch19Isr</SHORT-NAME>
                  <MINIMUM-START-INTERVAL>0.0</MINIMUM-START-INTERVAL>
                  <REENTRANCY-LEVEL>NON-REENTRANT</REENTRANCY-LEVEL>
                  <IMPLEMENTED-ENTRY-REF DEST="BSW-MODULE-ENTRY">/Pwm_TI_AM263Px/Pwm_ModuleEntry/Pwm_Ch19Isr</IMPLEMENTED-ENTRY-REF>
                  [!IF "as:modconf('Pwm')[1]/PwmGeneral/PwmTypeofInterruptFunction = 'PWM_ISR_CAT2'"!][!//
                  <INTERRUPT-CATEGORY>CAT-2</INTERRUPT-CATEGORY>
                  [!ELSE!][!//
                  <INTERRUPT-CATEGORY>CAT-1</INTERRUPT-CATEGORY>
                  [!ENDIF!][!//
                  <INTERRUPT-SOURCE>Hardware</INTERRUPT-SOURCE>
                </BSW-INTERRUPT-ENTITY>
                [!ENDIF!][!//
                [!IF "PwmChannelId = '1'"!][!//
                <BSW-INTERRUPT-ENTITY UUID="e9502660-ef46-41a8-a7a0-0bc8ef0b9119">
                  <SHORT-NAME>Pwm_Ch1Isr</SHORT-NAME>
                  <MINIMUM-START-INTERVAL>0.0</MINIMUM-START-INTERVAL>
                  <REENTRANCY-LEVEL>NON-REENTRANT</REENTRANCY-LEVEL>
                  <IMPLEMENTED-ENTRY-REF DEST="BSW-MODULE-ENTRY">/Pwm_TI_AM263Px/Pwm_ModuleEntry/Pwm_Ch1Isr</IMPLEMENTED-ENTRY-REF>
                  [!IF "as:modconf('Pwm')[1]/PwmGeneral/PwmTypeofInterruptFunction = 'PWM_ISR_CAT2'"!][!//
                  <INTERRUPT-CATEGORY>CAT-2</INTERRUPT-CATEGORY>
                  [!ELSE!][!//
                  <INTERRUPT-CATEGORY>CAT-1</INTERRUPT-CATEGORY>
                  [!ENDIF!][!//
                  <INTERRUPT-SOURCE>Hardware</INTERRUPT-SOURCE>
                </BSW-INTERRUPT-ENTITY>
                [!ENDIF!][!//
                [!IF "PwmChannelId = '20'"!][!//
                <BSW-INTERRUPT-ENTITY UUID="9055051f-9c64-4789-9e9f-5f45942bfe02">
                  <SHORT-NAME>Pwm_Ch20Isr</SHORT-NAME>
                  <MINIMUM-START-INTERVAL>0.0</MINIMUM-START-INTERVAL>
                  <REENTRANCY-LEVEL>NON-REENTRANT</REENTRANCY-LEVEL>
                  <IMPLEMENTED-ENTRY-REF DEST="BSW-MODULE-ENTRY">/Pwm_TI_AM263Px/Pwm_ModuleEntry/Pwm_Ch20Isr</IMPLEMENTED-ENTRY-REF>
                  [!IF "as:modconf('Pwm')[1]/PwmGeneral/PwmTypeofInterruptFunction = 'PWM_ISR_CAT2'"!][!//
                  <INTERRUPT-CATEGORY>CAT-2</INTERRUPT-CATEGORY>
                  [!ELSE!][!//
                  <INTERRUPT-CATEGORY>CAT-1</INTERRUPT-CATEGORY>
                  [!ENDIF!][!//
                  <INTERRUPT-SOURCE>Hardware</INTERRUPT-SOURCE>
                </BSW-INTERRUPT-ENTITY>
                [!ENDIF!][!//
                [!IF "PwmChannelId = '21'"!][!//
                <BSW-INTERRUPT-ENTITY UUID="167e9801-256a-4564-8db3-d38e0ab950aa">
                  <SHORT-NAME>Pwm_Ch21Isr</SHORT-NAME>
                  <MINIMUM-START-INTERVAL>0.0</MINIMUM-START-INTERVAL>
                  <REENTRANCY-LEVEL>NON-REENTRANT</REENTRANCY-LEVEL>
                  <IMPLEMENTED-ENTRY-REF DEST="BSW-MODULE-ENTRY">/Pwm_TI_AM263Px/Pwm_ModuleEntry/Pwm_Ch21Isr</IMPLEMENTED-ENTRY-REF>
                  [!IF "as:modconf('Pwm')[1]/PwmGeneral/PwmTypeofInterruptFunction = 'PWM_ISR_CAT2'"!][!//
                  <INTERRUPT-CATEGORY>CAT-2</INTERRUPT-CATEGORY>
                  [!ELSE!][!//
                  <INTERRUPT-CATEGORY>CAT-1</INTERRUPT-CATEGORY>
                  [!ENDIF!][!//
                  <INTERRUPT-SOURCE>Hardware</INTERRUPT-SOURCE>
                </BSW-INTERRUPT-ENTITY>
                [!ENDIF!][!//
                [!IF "PwmChannelId = '22'"!][!//
                <BSW-INTERRUPT-ENTITY UUID="0bbad3a5-a60d-4d4d-a0f8-e6e692743ad8">
                  <SHORT-NAME>Pwm_Ch22Isr</SHORT-NAME>
                  <MINIMUM-START-INTERVAL>0.0</MINIMUM-START-INTERVAL>
                  <REENTRANCY-LEVEL>NON-REENTRANT</REENTRANCY-LEVEL>
                  <IMPLEMENTED-ENTRY-REF DEST="BSW-MODULE-ENTRY">/Pwm_TI_AM263Px/Pwm_ModuleEntry/Pwm_Ch22Isr</IMPLEMENTED-ENTRY-REF>
                  [!IF "as:modconf('Pwm')[1]/PwmGeneral/PwmTypeofInterruptFunction = 'PWM_ISR_CAT2'"!][!//
                  <INTERRUPT-CATEGORY>CAT-2</INTERRUPT-CATEGORY>
                  [!ELSE!][!//
                  <INTERRUPT-CATEGORY>CAT-1</INTERRUPT-CATEGORY>
                  [!ENDIF!][!//
                  <INTERRUPT-SOURCE>Hardware</INTERRUPT-SOURCE>
                </BSW-INTERRUPT-ENTITY>
                [!ENDIF!][!//
                [!IF "PwmChannelId = '23'"!][!//
                <BSW-INTERRUPT-ENTITY UUID="9d7d0ca9-d45e-4f95-bf61-2f9862e7325c">
                  <SHORT-NAME>Pwm_Ch23Isr</SHORT-NAME>
                  <MINIMUM-START-INTERVAL>0.0</MINIMUM-START-INTERVAL>
                  <REENTRANCY-LEVEL>NON-REENTRANT</REENTRANCY-LEVEL>
                  <IMPLEMENTED-ENTRY-REF DEST="BSW-MODULE-ENTRY">/Pwm_TI_AM263Px/Pwm_ModuleEntry/Pwm_Ch23Isr</IMPLEMENTED-ENTRY-REF>
                  [!IF "as:modconf('Pwm')[1]/PwmGeneral/PwmTypeofInterruptFunction = 'PWM_ISR_CAT2'"!][!//
                  <INTERRUPT-CATEGORY>CAT-2</INTERRUPT-CATEGORY>
                  [!ELSE!][!//
                  <INTERRUPT-CATEGORY>CAT-1</INTERRUPT-CATEGORY>
                  [!ENDIF!][!//
                  <INTERRUPT-SOURCE>Hardware</INTERRUPT-SOURCE>
                </BSW-INTERRUPT-ENTITY>
                [!ENDIF!][!//
                [!IF "PwmChannelId = '24'"!][!//
                <BSW-INTERRUPT-ENTITY UUID="0ebe5c43-9e5f-4485-98ac-01448cc41dc4">
                  <SHORT-NAME>Pwm_Ch24Isr</SHORT-NAME>
                  <MINIMUM-START-INTERVAL>0.0</MINIMUM-START-INTERVAL>
                  <REENTRANCY-LEVEL>NON-REENTRANT</REENTRANCY-LEVEL>
                  <IMPLEMENTED-ENTRY-REF DEST="BSW-MODULE-ENTRY">/Pwm_TI_AM263Px/Pwm_ModuleEntry/Pwm_Ch24Isr</IMPLEMENTED-ENTRY-REF>
                  [!IF "as:modconf('Pwm')[1]/PwmGeneral/PwmTypeofInterruptFunction = 'PWM_ISR_CAT2'"!][!//
                  <INTERRUPT-CATEGORY>CAT-2</INTERRUPT-CATEGORY>
                  [!ELSE!][!//
                  <INTERRUPT-CATEGORY>CAT-1</INTERRUPT-CATEGORY>
                  [!ENDIF!][!//
                  <INTERRUPT-SOURCE>Hardware</INTERRUPT-SOURCE>
                </BSW-INTERRUPT-ENTITY>
                [!ENDIF!][!//
                [!IF "PwmChannelId = '25'"!][!//
                <BSW-INTERRUPT-ENTITY UUID="ca2b67b6-f977-4c8d-97fe-29bce21e5b93">
                  <SHORT-NAME>Pwm_Ch25Isr</SHORT-NAME>
                  <MINIMUM-START-INTERVAL>0.0</MINIMUM-START-INTERVAL>
                  <REENTRANCY-LEVEL>NON-REENTRANT</REENTRANCY-LEVEL>
                  <IMPLEMENTED-ENTRY-REF DEST="BSW-MODULE-ENTRY">/Pwm_TI_AM263Px/Pwm_ModuleEntry/Pwm_Ch25Isr</IMPLEMENTED-ENTRY-REF>
                  [!IF "as:modconf('Pwm')[1]/PwmGeneral/PwmTypeofInterruptFunction = 'PWM_ISR_CAT2'"!][!//
                  <INTERRUPT-CATEGORY>CAT-2</INTERRUPT-CATEGORY>
                  [!ELSE!][!//
                  <INTERRUPT-CATEGORY>CAT-1</INTERRUPT-CATEGORY>
                  [!ENDIF!][!//
                  <INTERRUPT-SOURCE>Hardware</INTERRUPT-SOURCE>
                </BSW-INTERRUPT-ENTITY>
                [!ENDIF!][!//
                [!IF "PwmChannelId = '26'"!][!//
                <BSW-INTERRUPT-ENTITY UUID="6c6bad49-6fa6-4e3a-926b-c42984eccc7f">
                  <SHORT-NAME>Pwm_Ch26Isr</SHORT-NAME>
                  <MINIMUM-START-INTERVAL>0.0</MINIMUM-START-INTERVAL>
                  <REENTRANCY-LEVEL>NON-REENTRANT</REENTRANCY-LEVEL>
                  <IMPLEMENTED-ENTRY-REF DEST="BSW-MODULE-ENTRY">/Pwm_TI_AM263Px/Pwm_ModuleEntry/Pwm_Ch26Isr</IMPLEMENTED-ENTRY-REF>
                  [!IF "as:modconf('Pwm')[1]/PwmGeneral/PwmTypeofInterruptFunction = 'PWM_ISR_CAT2'"!][!//
                  <INTERRUPT-CATEGORY>CAT-2</INTERRUPT-CATEGORY>
                  [!ELSE!][!//
                  <INTERRUPT-CATEGORY>CAT-1</INTERRUPT-CATEGORY>
                  [!ENDIF!][!//
                  <INTERRUPT-SOURCE>Hardware</INTERRUPT-SOURCE>
                </BSW-INTERRUPT-ENTITY>
                [!ENDIF!][!//
                [!IF "PwmChannelId = '27'"!][!//
                <BSW-INTERRUPT-ENTITY UUID="02adbaa1-3614-4fc7-bdd3-30dbcfbb02d5">
                  <SHORT-NAME>Pwm_Ch27Isr</SHORT-NAME>
                  <MINIMUM-START-INTERVAL>0.0</MINIMUM-START-INTERVAL>
                  <REENTRANCY-LEVEL>NON-REENTRANT</REENTRANCY-LEVEL>
                  <IMPLEMENTED-ENTRY-REF DEST="BSW-MODULE-ENTRY">/Pwm_TI_AM263Px/Pwm_ModuleEntry/Pwm_Ch27Isr</IMPLEMENTED-ENTRY-REF>
                  [!IF "as:modconf('Pwm')[1]/PwmGeneral/PwmTypeofInterruptFunction = 'PWM_ISR_CAT2'"!][!//
                  <INTERRUPT-CATEGORY>CAT-2</INTERRUPT-CATEGORY>
                  [!ELSE!][!//
                  <INTERRUPT-CATEGORY>CAT-1</INTERRUPT-CATEGORY>
                  [!ENDIF!][!//
                  <INTERRUPT-SOURCE>Hardware</INTERRUPT-SOURCE>
                </BSW-INTERRUPT-ENTITY>
                [!ENDIF!][!//
                [!IF "PwmChannelId = '28'"!][!//
                <BSW-INTERRUPT-ENTITY UUID="8ec804be-be03-411d-9672-715ceff0b73b">
                  <SHORT-NAME>Pwm_Ch28Isr</SHORT-NAME>
                  <MINIMUM-START-INTERVAL>0.0</MINIMUM-START-INTERVAL>
                  <REENTRANCY-LEVEL>NON-REENTRANT</REENTRANCY-LEVEL>
                  <IMPLEMENTED-ENTRY-REF DEST="BSW-MODULE-ENTRY">/Pwm_TI_AM263Px/Pwm_ModuleEntry/Pwm_Ch28Isr</IMPLEMENTED-ENTRY-REF>
                  [!IF "as:modconf('Pwm')[1]/PwmGeneral/PwmTypeofInterruptFunction = 'PWM_ISR_CAT2'"!][!//
                  <INTERRUPT-CATEGORY>CAT-2</INTERRUPT-CATEGORY>
                  [!ELSE!][!//
                  <INTERRUPT-CATEGORY>CAT-1</INTERRUPT-CATEGORY>
                  [!ENDIF!][!//
                  <INTERRUPT-SOURCE>Hardware</INTERRUPT-SOURCE>
                </BSW-INTERRUPT-ENTITY>
                [!ENDIF!][!//
                [!IF "PwmChannelId = '29'"!][!//
                <BSW-INTERRUPT-ENTITY UUID="f41decea-4a30-4a0a-a8b5-541c6d78c641">
                  <SHORT-NAME>Pwm_Ch29Isr</SHORT-NAME>
                  <MINIMUM-START-INTERVAL>0.0</MINIMUM-START-INTERVAL>
                  <REENTRANCY-LEVEL>NON-REENTRANT</REENTRANCY-LEVEL>
                  <IMPLEMENTED-ENTRY-REF DEST="BSW-MODULE-ENTRY">/Pwm_TI_AM263Px/Pwm_ModuleEntry/Pwm_Ch29Isr</IMPLEMENTED-ENTRY-REF>
                  [!IF "as:modconf('Pwm')[1]/PwmGeneral/PwmTypeofInterruptFunction = 'PWM_ISR_CAT2'"!][!//
                  <INTERRUPT-CATEGORY>CAT-2</INTERRUPT-CATEGORY>
                  [!ELSE!][!//
                  <INTERRUPT-CATEGORY>CAT-1</INTERRUPT-CATEGORY>
                  [!ENDIF!][!//
                  <INTERRUPT-SOURCE>Hardware</INTERRUPT-SOURCE>
                </BSW-INTERRUPT-ENTITY>
                [!ENDIF!][!//
                [!IF "PwmChannelId = '2'"!][!//
                <BSW-INTERRUPT-ENTITY UUID="ee951f73-c94a-4f92-b06a-9c0d11fff6bb">
                  <SHORT-NAME>Pwm_Ch2Isr</SHORT-NAME>
                  <MINIMUM-START-INTERVAL>0.0</MINIMUM-START-INTERVAL>
                  <REENTRANCY-LEVEL>NON-REENTRANT</REENTRANCY-LEVEL>
                  <IMPLEMENTED-ENTRY-REF DEST="BSW-MODULE-ENTRY">/Pwm_TI_AM263Px/Pwm_ModuleEntry/Pwm_Ch2Isr</IMPLEMENTED-ENTRY-REF>
                  [!IF "as:modconf('Pwm')[1]/PwmGeneral/PwmTypeofInterruptFunction = 'PWM_ISR_CAT2'"!][!//
                  <INTERRUPT-CATEGORY>CAT-2</INTERRUPT-CATEGORY>
                  [!ELSE!][!//
                  <INTERRUPT-CATEGORY>CAT-1</INTERRUPT-CATEGORY>
                  [!ENDIF!][!//
                  <INTERRUPT-SOURCE>Hardware</INTERRUPT-SOURCE>
                </BSW-INTERRUPT-ENTITY>
                [!ENDIF!][!//
                [!IF "PwmChannelId = '30'"!][!//
                <BSW-INTERRUPT-ENTITY UUID="6bb5a693-4f10-4343-a859-3e02a93689e5">
                  <SHORT-NAME>Pwm_Ch30Isr</SHORT-NAME>
                  <MINIMUM-START-INTERVAL>0.0</MINIMUM-START-INTERVAL>
                  <REENTRANCY-LEVEL>NON-REENTRANT</REENTRANCY-LEVEL>
                  <IMPLEMENTED-ENTRY-REF DEST="BSW-MODULE-ENTRY">/Pwm_TI_AM263Px/Pwm_ModuleEntry/Pwm_Ch30Isr</IMPLEMENTED-ENTRY-REF>
                  [!IF "as:modconf('Pwm')[1]/PwmGeneral/PwmTypeofInterruptFunction = 'PWM_ISR_CAT2'"!][!//
                  <INTERRUPT-CATEGORY>CAT-2</INTERRUPT-CATEGORY>
                  [!ELSE!][!//
                  <INTERRUPT-CATEGORY>CAT-1</INTERRUPT-CATEGORY>
                  [!ENDIF!][!//
                  <INTERRUPT-SOURCE>Hardware</INTERRUPT-SOURCE>
                </BSW-INTERRUPT-ENTITY>
                [!ENDIF!][!//
                [!IF "PwmChannelId = '31'"!][!//
                <BSW-INTERRUPT-ENTITY UUID="9d4fe80f-5c12-414d-93fc-c3ecf643e1fe">
                  <SHORT-NAME>Pwm_Ch31Isr</SHORT-NAME>
                  <MINIMUM-START-INTERVAL>0.0</MINIMUM-START-INTERVAL>
                  <REENTRANCY-LEVEL>NON-REENTRANT</REENTRANCY-LEVEL>
                  <IMPLEMENTED-ENTRY-REF DEST="BSW-MODULE-ENTRY">/Pwm_TI_AM263Px/Pwm_ModuleEntry/Pwm_Ch31Isr</IMPLEMENTED-ENTRY-REF>
                  [!IF "as:modconf('Pwm')[1]/PwmGeneral/PwmTypeofInterruptFunction = 'PWM_ISR_CAT2'"!][!//
                  <INTERRUPT-CATEGORY>CAT-2</INTERRUPT-CATEGORY>
                  [!ELSE!][!//
                  <INTERRUPT-CATEGORY>CAT-1</INTERRUPT-CATEGORY>
                  [!ENDIF!][!//
                  <INTERRUPT-SOURCE>Hardware</INTERRUPT-SOURCE>
                </BSW-INTERRUPT-ENTITY>
                [!ENDIF!][!//
                [!IF "PwmChannelId = '32'"!][!//
                <BSW-INTERRUPT-ENTITY UUID="b8c2d940-cdca-41b2-9829-bc318362e598">
                  <SHORT-NAME>Pwm_Ch32Isr</SHORT-NAME>
                  <MINIMUM-START-INTERVAL>0.0</MINIMUM-START-INTERVAL>
                  <REENTRANCY-LEVEL>NON-REENTRANT</REENTRANCY-LEVEL>
                  <IMPLEMENTED-ENTRY-REF DEST="BSW-MODULE-ENTRY">/Pwm_TI_AM263Px/Pwm_ModuleEntry/Pwm_Ch32Isr</IMPLEMENTED-ENTRY-REF>
                  [!IF "as:modconf('Pwm')[1]/PwmGeneral/PwmTypeofInterruptFunction = 'PWM_ISR_CAT2'"!][!//
                  <INTERRUPT-CATEGORY>CAT-2</INTERRUPT-CATEGORY>
                  [!ELSE!][!//
                  <INTERRUPT-CATEGORY>CAT-1</INTERRUPT-CATEGORY>
                  [!ENDIF!][!//
                  <INTERRUPT-SOURCE>Hardware</INTERRUPT-SOURCE>
                </BSW-INTERRUPT-ENTITY>
                [!ENDIF!][!//
                [!IF "PwmChannelId = '33'"!][!//
                <BSW-INTERRUPT-ENTITY UUID="dc6f3e24-d9e2-465a-8ff4-e11556ee2a59">
                  <SHORT-NAME>Pwm_Ch33Isr</SHORT-NAME>
                  <MINIMUM-START-INTERVAL>0.0</MINIMUM-START-INTERVAL>
                  <REENTRANCY-LEVEL>NON-REENTRANT</REENTRANCY-LEVEL>
                  <IMPLEMENTED-ENTRY-REF DEST="BSW-MODULE-ENTRY">/Pwm_TI_AM263Px/Pwm_ModuleEntry/Pwm_Ch33Isr</IMPLEMENTED-ENTRY-REF>
                  [!IF "as:modconf('Pwm')[1]/PwmGeneral/PwmTypeofInterruptFunction = 'PWM_ISR_CAT2'"!][!//
                  <INTERRUPT-CATEGORY>CAT-2</INTERRUPT-CATEGORY>
                  [!ELSE!][!//
                  <INTERRUPT-CATEGORY>CAT-1</INTERRUPT-CATEGORY>
                  [!ENDIF!][!//
                  <INTERRUPT-SOURCE>Hardware</INTERRUPT-SOURCE>
                </BSW-INTERRUPT-ENTITY>
                [!ENDIF!][!//
                [!IF "PwmChannelId = '34'"!][!//
                <BSW-INTERRUPT-ENTITY UUID="6cbbbd87-4f9d-4925-b1cd-024baa20f5da">
                  <SHORT-NAME>Pwm_Ch34Isr</SHORT-NAME>
                  <MINIMUM-START-INTERVAL>0.0</MINIMUM-START-INTERVAL>
                  <REENTRANCY-LEVEL>NON-REENTRANT</REENTRANCY-LEVEL>
                  <IMPLEMENTED-ENTRY-REF DEST="BSW-MODULE-ENTRY">/Pwm_TI_AM263Px/Pwm_ModuleEntry/Pwm_Ch34Isr</IMPLEMENTED-ENTRY-REF>
                  [!IF "as:modconf('Pwm')[1]/PwmGeneral/PwmTypeofInterruptFunction = 'PWM_ISR_CAT2'"!][!//
                  <INTERRUPT-CATEGORY>CAT-2</INTERRUPT-CATEGORY>
                  [!ELSE!][!//
                  <INTERRUPT-CATEGORY>CAT-1</INTERRUPT-CATEGORY>
                  [!ENDIF!][!//
                  <INTERRUPT-SOURCE>Hardware</INTERRUPT-SOURCE>
                </BSW-INTERRUPT-ENTITY>
                [!ENDIF!][!//
                [!IF "PwmChannelId = '35'"!][!//
                <BSW-INTERRUPT-ENTITY UUID="05badd52-cf28-416c-a70c-b5af418061f1">
                  <SHORT-NAME>Pwm_Ch35Isr</SHORT-NAME>
                  <MINIMUM-START-INTERVAL>0.0</MINIMUM-START-INTERVAL>
                  <REENTRANCY-LEVEL>NON-REENTRANT</REENTRANCY-LEVEL>
                  <IMPLEMENTED-ENTRY-REF DEST="BSW-MODULE-ENTRY">/Pwm_TI_AM263Px/Pwm_ModuleEntry/Pwm_Ch35Isr</IMPLEMENTED-ENTRY-REF>
                  [!IF "as:modconf('Pwm')[1]/PwmGeneral/PwmTypeofInterruptFunction = 'PWM_ISR_CAT2'"!][!//
                  <INTERRUPT-CATEGORY>CAT-2</INTERRUPT-CATEGORY>
                  [!ELSE!][!//
                  <INTERRUPT-CATEGORY>CAT-1</INTERRUPT-CATEGORY>
                  [!ENDIF!][!//
                  <INTERRUPT-SOURCE>Hardware</INTERRUPT-SOURCE>
                </BSW-INTERRUPT-ENTITY>
                [!ENDIF!][!//
                [!IF "PwmChannelId = '36'"!][!//
                <BSW-INTERRUPT-ENTITY UUID="32ec4677-ae21-4234-afb0-e849e5433017">
                  <SHORT-NAME>Pwm_Ch36Isr</SHORT-NAME>
                  <MINIMUM-START-INTERVAL>0.0</MINIMUM-START-INTERVAL>
                  <REENTRANCY-LEVEL>NON-REENTRANT</REENTRANCY-LEVEL>
                  <IMPLEMENTED-ENTRY-REF DEST="BSW-MODULE-ENTRY">/Pwm_TI_AM263Px/Pwm_ModuleEntry/Pwm_Ch36Isr</IMPLEMENTED-ENTRY-REF>
                  [!IF "as:modconf('Pwm')[1]/PwmGeneral/PwmTypeofInterruptFunction = 'PWM_ISR_CAT2'"!][!//
                  <INTERRUPT-CATEGORY>CAT-2</INTERRUPT-CATEGORY>
                  [!ELSE!][!//
                  <INTERRUPT-CATEGORY>CAT-1</INTERRUPT-CATEGORY>
                  [!ENDIF!][!//
                  <INTERRUPT-SOURCE>Hardware</INTERRUPT-SOURCE>
                </BSW-INTERRUPT-ENTITY>
                [!ENDIF!][!//
                [!IF "PwmChannelId = '37'"!][!//
                <BSW-INTERRUPT-ENTITY UUID="c88d473c-3ca2-4360-b17b-8f970c6c2ef7">
                  <SHORT-NAME>Pwm_Ch37Isr</SHORT-NAME>
                  <MINIMUM-START-INTERVAL>0.0</MINIMUM-START-INTERVAL>
                  <REENTRANCY-LEVEL>NON-REENTRANT</REENTRANCY-LEVEL>
                  <IMPLEMENTED-ENTRY-REF DEST="BSW-MODULE-ENTRY">/Pwm_TI_AM263Px/Pwm_ModuleEntry/Pwm_Ch37Isr</IMPLEMENTED-ENTRY-REF>
                  [!IF "as:modconf('Pwm')[1]/PwmGeneral/PwmTypeofInterruptFunction = 'PWM_ISR_CAT2'"!][!//
                  <INTERRUPT-CATEGORY>CAT-2</INTERRUPT-CATEGORY>
                  [!ELSE!][!//
                  <INTERRUPT-CATEGORY>CAT-1</INTERRUPT-CATEGORY>
                  [!ENDIF!][!//
                  <INTERRUPT-SOURCE>Hardware</INTERRUPT-SOURCE>
                </BSW-INTERRUPT-ENTITY>
                [!ENDIF!][!//
                [!IF "PwmChannelId = '38'"!][!//
                <BSW-INTERRUPT-ENTITY UUID="455c4c96-ca5d-401d-9ac4-c7ee165c35cd">
                  <SHORT-NAME>Pwm_Ch38Isr</SHORT-NAME>
                  <MINIMUM-START-INTERVAL>0.0</MINIMUM-START-INTERVAL>
                  <REENTRANCY-LEVEL>NON-REENTRANT</REENTRANCY-LEVEL>
                  <IMPLEMENTED-ENTRY-REF DEST="BSW-MODULE-ENTRY">/Pwm_TI_AM263Px/Pwm_ModuleEntry/Pwm_Ch38Isr</IMPLEMENTED-ENTRY-REF>
                  [!IF "as:modconf('Pwm')[1]/PwmGeneral/PwmTypeofInterruptFunction = 'PWM_ISR_CAT2'"!][!//
                  <INTERRUPT-CATEGORY>CAT-2</INTERRUPT-CATEGORY>
                  [!ELSE!][!//
                  <INTERRUPT-CATEGORY>CAT-1</INTERRUPT-CATEGORY>
                  [!ENDIF!][!//
                  <INTERRUPT-SOURCE>Hardware</INTERRUPT-SOURCE>
                </BSW-INTERRUPT-ENTITY>
                [!ENDIF!][!//
                [!IF "PwmChannelId = '39'"!][!//
                <BSW-INTERRUPT-ENTITY UUID="e8647de8-dec0-4469-93d8-50e693e21563">
                  <SHORT-NAME>Pwm_Ch39Isr</SHORT-NAME>
                  <MINIMUM-START-INTERVAL>0.0</MINIMUM-START-INTERVAL>
                  <REENTRANCY-LEVEL>NON-REENTRANT</REENTRANCY-LEVEL>
                  <IMPLEMENTED-ENTRY-REF DEST="BSW-MODULE-ENTRY">/Pwm_TI_AM263Px/Pwm_ModuleEntry/Pwm_Ch39Isr</IMPLEMENTED-ENTRY-REF>
                  [!IF "as:modconf('Pwm')[1]/PwmGeneral/PwmTypeofInterruptFunction = 'PWM_ISR_CAT2'"!][!//
                  <INTERRUPT-CATEGORY>CAT-2</INTERRUPT-CATEGORY>
                  [!ELSE!][!//
                  <INTERRUPT-CATEGORY>CAT-1</INTERRUPT-CATEGORY>
                  [!ENDIF!][!//
                  <INTERRUPT-SOURCE>Hardware</INTERRUPT-SOURCE>
                </BSW-INTERRUPT-ENTITY>
                [!ENDIF!][!//
                [!IF "PwmChannelId = '3'"!][!//
                <BSW-INTERRUPT-ENTITY UUID="273f3b77-66f6-45d8-a908-4925fd990f68">
                  <SHORT-NAME>Pwm_Ch3Isr</SHORT-NAME>
                  <MINIMUM-START-INTERVAL>0.0</MINIMUM-START-INTERVAL>
                  <REENTRANCY-LEVEL>NON-REENTRANT</REENTRANCY-LEVEL>
                  <IMPLEMENTED-ENTRY-REF DEST="BSW-MODULE-ENTRY">/Pwm_TI_AM263Px/Pwm_ModuleEntry/Pwm_Ch3Isr</IMPLEMENTED-ENTRY-REF>
                  [!IF "as:modconf('Pwm')[1]/PwmGeneral/PwmTypeofInterruptFunction = 'PWM_ISR_CAT2'"!][!//
                  <INTERRUPT-CATEGORY>CAT-2</INTERRUPT-CATEGORY>
                  [!ELSE!][!//
                  <INTERRUPT-CATEGORY>CAT-1</INTERRUPT-CATEGORY>
                  [!ENDIF!][!//
                  <INTERRUPT-SOURCE>Hardware</INTERRUPT-SOURCE>
                </BSW-INTERRUPT-ENTITY>
                [!ENDIF!][!//
                [!IF "PwmChannelId = '40'"!][!//
                <BSW-INTERRUPT-ENTITY UUID="bdc35b75-ff9f-4258-a2b7-6ad4a6a668f9">
                  <SHORT-NAME>Pwm_Ch40Isr</SHORT-NAME>
                  <MINIMUM-START-INTERVAL>0.0</MINIMUM-START-INTERVAL>
                  <REENTRANCY-LEVEL>NON-REENTRANT</REENTRANCY-LEVEL>
                  <IMPLEMENTED-ENTRY-REF DEST="BSW-MODULE-ENTRY">/Pwm_TI_AM263Px/Pwm_ModuleEntry/Pwm_Ch40Isr</IMPLEMENTED-ENTRY-REF>
                  [!IF "as:modconf('Pwm')[1]/PwmGeneral/PwmTypeofInterruptFunction = 'PWM_ISR_CAT2'"!][!//
                  <INTERRUPT-CATEGORY>CAT-2</INTERRUPT-CATEGORY>
                  [!ELSE!][!//
                  <INTERRUPT-CATEGORY>CAT-1</INTERRUPT-CATEGORY>
                  [!ENDIF!][!//
                  <INTERRUPT-SOURCE>Hardware</INTERRUPT-SOURCE>
                </BSW-INTERRUPT-ENTITY>
                [!ENDIF!][!//
                [!IF "PwmChannelId = '41'"!][!//
                <BSW-INTERRUPT-ENTITY UUID="c7b56314-a959-444f-bcbe-ab22b05d1773">
                  <SHORT-NAME>Pwm_Ch41Isr</SHORT-NAME>
                  <MINIMUM-START-INTERVAL>0.0</MINIMUM-START-INTERVAL>
                  <REENTRANCY-LEVEL>NON-REENTRANT</REENTRANCY-LEVEL>
                  <IMPLEMENTED-ENTRY-REF DEST="BSW-MODULE-ENTRY">/Pwm_TI_AM263Px/Pwm_ModuleEntry/Pwm_Ch41Isr</IMPLEMENTED-ENTRY-REF>
                  [!IF "as:modconf('Pwm')[1]/PwmGeneral/PwmTypeofInterruptFunction = 'PWM_ISR_CAT2'"!][!//
                  <INTERRUPT-CATEGORY>CAT-2</INTERRUPT-CATEGORY>
                  [!ELSE!][!//
                  <INTERRUPT-CATEGORY>CAT-1</INTERRUPT-CATEGORY>
                  [!ENDIF!][!//
                  <INTERRUPT-SOURCE>Hardware</INTERRUPT-SOURCE>
                </BSW-INTERRUPT-ENTITY>
                [!ENDIF!][!//
                [!IF "PwmChannelId = '42'"!][!//
                <BSW-INTERRUPT-ENTITY UUID="f3c8bbc6-5fbf-4f83-9111-261413cff764">
                  <SHORT-NAME>Pwm_Ch42Isr</SHORT-NAME>
                  <MINIMUM-START-INTERVAL>0.0</MINIMUM-START-INTERVAL>
                  <REENTRANCY-LEVEL>NON-REENTRANT</REENTRANCY-LEVEL>
                  <IMPLEMENTED-ENTRY-REF DEST="BSW-MODULE-ENTRY">/Pwm_TI_AM263Px/Pwm_ModuleEntry/Pwm_Ch42Isr</IMPLEMENTED-ENTRY-REF>
                  [!IF "as:modconf('Pwm')[1]/PwmGeneral/PwmTypeofInterruptFunction = 'PWM_ISR_CAT2'"!][!//
                  <INTERRUPT-CATEGORY>CAT-2</INTERRUPT-CATEGORY>
                  [!ELSE!][!//
                  <INTERRUPT-CATEGORY>CAT-1</INTERRUPT-CATEGORY>
                  [!ENDIF!][!//
                  <INTERRUPT-SOURCE>Hardware</INTERRUPT-SOURCE>
                </BSW-INTERRUPT-ENTITY>
                [!ENDIF!][!//
                [!IF "PwmChannelId = '43'"!][!//
                <BSW-INTERRUPT-ENTITY UUID="91b98e2b-a770-4e77-888c-057264975d1d">
                  <SHORT-NAME>Pwm_Ch43Isr</SHORT-NAME>
                  <MINIMUM-START-INTERVAL>0.0</MINIMUM-START-INTERVAL>
                  <REENTRANCY-LEVEL>NON-REENTRANT</REENTRANCY-LEVEL>
                  <IMPLEMENTED-ENTRY-REF DEST="BSW-MODULE-ENTRY">/Pwm_TI_AM263Px/Pwm_ModuleEntry/Pwm_Ch43Isr</IMPLEMENTED-ENTRY-REF>
                  [!IF "as:modconf('Pwm')[1]/PwmGeneral/PwmTypeofInterruptFunction = 'PWM_ISR_CAT2'"!][!//
                  <INTERRUPT-CATEGORY>CAT-2</INTERRUPT-CATEGORY>
                  [!ELSE!][!//
                  <INTERRUPT-CATEGORY>CAT-1</INTERRUPT-CATEGORY>
                  [!ENDIF!][!//
                  <INTERRUPT-SOURCE>Hardware</INTERRUPT-SOURCE>
                </BSW-INTERRUPT-ENTITY>
                [!ENDIF!][!//
                [!IF "PwmChannelId = '44'"!][!//
                <BSW-INTERRUPT-ENTITY UUID="133f5ffc-2fcf-47f9-a0e3-5a3f97520569">
                  <SHORT-NAME>Pwm_Ch44Isr</SHORT-NAME>
                  <MINIMUM-START-INTERVAL>0.0</MINIMUM-START-INTERVAL>
                  <REENTRANCY-LEVEL>NON-REENTRANT</REENTRANCY-LEVEL>
                  <IMPLEMENTED-ENTRY-REF DEST="BSW-MODULE-ENTRY">/Pwm_TI_AM263Px/Pwm_ModuleEntry/Pwm_Ch44Isr</IMPLEMENTED-ENTRY-REF>
                  [!IF "as:modconf('Pwm')[1]/PwmGeneral/PwmTypeofInterruptFunction = 'PWM_ISR_CAT2'"!][!//
                  <INTERRUPT-CATEGORY>CAT-2</INTERRUPT-CATEGORY>
                  [!ELSE!][!//
                  <INTERRUPT-CATEGORY>CAT-1</INTERRUPT-CATEGORY>
                  [!ENDIF!][!//
                  <INTERRUPT-SOURCE>Hardware</INTERRUPT-SOURCE>
                </BSW-INTERRUPT-ENTITY>
                [!ENDIF!][!//
                [!IF "PwmChannelId = '45'"!][!//
                <BSW-INTERRUPT-ENTITY UUID="6cebcb6d-ecef-40c6-aa03-5192b8c84a76">
                  <SHORT-NAME>Pwm_Ch45Isr</SHORT-NAME>
                  <MINIMUM-START-INTERVAL>0.0</MINIMUM-START-INTERVAL>
                  <REENTRANCY-LEVEL>NON-REENTRANT</REENTRANCY-LEVEL>
                  <IMPLEMENTED-ENTRY-REF DEST="BSW-MODULE-ENTRY">/Pwm_TI_AM263Px/Pwm_ModuleEntry/Pwm_Ch45Isr</IMPLEMENTED-ENTRY-REF>
                  [!IF "as:modconf('Pwm')[1]/PwmGeneral/PwmTypeofInterruptFunction = 'PWM_ISR_CAT2'"!][!//
                  <INTERRUPT-CATEGORY>CAT-2</INTERRUPT-CATEGORY>
                  [!ELSE!][!//
                  <INTERRUPT-CATEGORY>CAT-1</INTERRUPT-CATEGORY>
                  [!ENDIF!][!//
                  <INTERRUPT-SOURCE>Hardware</INTERRUPT-SOURCE>
                </BSW-INTERRUPT-ENTITY>
                [!ENDIF!][!//
                [!IF "PwmChannelId = '46'"!][!//
                <BSW-INTERRUPT-ENTITY UUID="775151ed-f2c1-4486-abab-fb784594ad6e">
                  <SHORT-NAME>Pwm_Ch46Isr</SHORT-NAME>
                  <MINIMUM-START-INTERVAL>0.0</MINIMUM-START-INTERVAL>
                  <REENTRANCY-LEVEL>NON-REENTRANT</REENTRANCY-LEVEL>
                  <IMPLEMENTED-ENTRY-REF DEST="BSW-MODULE-ENTRY">/Pwm_TI_AM263Px/Pwm_ModuleEntry/Pwm_Ch46Isr</IMPLEMENTED-ENTRY-REF>
                  [!IF "as:modconf('Pwm')[1]/PwmGeneral/PwmTypeofInterruptFunction = 'PWM_ISR_CAT2'"!][!//
                  <INTERRUPT-CATEGORY>CAT-2</INTERRUPT-CATEGORY>
                  [!ELSE!][!//
                  <INTERRUPT-CATEGORY>CAT-1</INTERRUPT-CATEGORY>
                  [!ENDIF!][!//
                  <INTERRUPT-SOURCE>Hardware</INTERRUPT-SOURCE>
                </BSW-INTERRUPT-ENTITY>
                [!ENDIF!][!//
                [!IF "PwmChannelId = '47'"!][!//
                <BSW-INTERRUPT-ENTITY UUID="8e3d3425-fbc1-4475-a2d4-fc952f60446f">
                  <SHORT-NAME>Pwm_Ch47Isr</SHORT-NAME>
                  <MINIMUM-START-INTERVAL>0.0</MINIMUM-START-INTERVAL>
                  <REENTRANCY-LEVEL>NON-REENTRANT</REENTRANCY-LEVEL>
                  <IMPLEMENTED-ENTRY-REF DEST="BSW-MODULE-ENTRY">/Pwm_TI_AM263Px/Pwm_ModuleEntry/Pwm_Ch47Isr</IMPLEMENTED-ENTRY-REF>
                  [!IF "as:modconf('Pwm')[1]/PwmGeneral/PwmTypeofInterruptFunction = 'PWM_ISR_CAT2'"!][!//
                  <INTERRUPT-CATEGORY>CAT-2</INTERRUPT-CATEGORY>
                  [!ELSE!][!//
                  <INTERRUPT-CATEGORY>CAT-1</INTERRUPT-CATEGORY>
                  [!ENDIF!][!//
                  <INTERRUPT-SOURCE>Hardware</INTERRUPT-SOURCE>
                </BSW-INTERRUPT-ENTITY>
                [!ENDIF!][!//
                [!IF "PwmChannelId = '48'"!][!//
                <BSW-INTERRUPT-ENTITY UUID="e932edf9-2140-4258-a390-22d9fa00b2b0">
                  <SHORT-NAME>Pwm_Ch48Isr</SHORT-NAME>
                  <MINIMUM-START-INTERVAL>0.0</MINIMUM-START-INTERVAL>
                  <REENTRANCY-LEVEL>NON-REENTRANT</REENTRANCY-LEVEL>
                  <IMPLEMENTED-ENTRY-REF DEST="BSW-MODULE-ENTRY">/Pwm_TI_AM263Px/Pwm_ModuleEntry/Pwm_Ch48Isr</IMPLEMENTED-ENTRY-REF>
                  [!IF "as:modconf('Pwm')[1]/PwmGeneral/PwmTypeofInterruptFunction = 'PWM_ISR_CAT2'"!][!//
                  <INTERRUPT-CATEGORY>CAT-2</INTERRUPT-CATEGORY>
                  [!ELSE!][!//
                  <INTERRUPT-CATEGORY>CAT-1</INTERRUPT-CATEGORY>
                  [!ENDIF!][!//
                  <INTERRUPT-SOURCE>Hardware</INTERRUPT-SOURCE>
                </BSW-INTERRUPT-ENTITY>
                [!ENDIF!][!//
                [!IF "PwmChannelId = '49'"!][!//
                <BSW-INTERRUPT-ENTITY UUID="9c483286-cc62-4b47-82bc-292bedf5ff48">
                  <SHORT-NAME>Pwm_Ch49Isr</SHORT-NAME>
                  <MINIMUM-START-INTERVAL>0.0</MINIMUM-START-INTERVAL>
                  <REENTRANCY-LEVEL>NON-REENTRANT</REENTRANCY-LEVEL>
                  <IMPLEMENTED-ENTRY-REF DEST="BSW-MODULE-ENTRY">/Pwm_TI_AM263Px/Pwm_ModuleEntry/Pwm_Ch49Isr</IMPLEMENTED-ENTRY-REF>
                  [!IF "as:modconf('Pwm')[1]/PwmGeneral/PwmTypeofInterruptFunction = 'PWM_ISR_CAT2'"!][!//
                  <INTERRUPT-CATEGORY>CAT-2</INTERRUPT-CATEGORY>
                  [!ELSE!][!//
                  <INTERRUPT-CATEGORY>CAT-1</INTERRUPT-CATEGORY>
                  [!ENDIF!][!//
                  <INTERRUPT-SOURCE>Hardware</INTERRUPT-SOURCE>
                </BSW-INTERRUPT-ENTITY>
                [!ENDIF!][!//
                [!IF "PwmChannelId = '4'"!][!//
                <BSW-INTERRUPT-ENTITY UUID="4b67eb75-1956-40b3-b52d-56dc868f84dc">
                  <SHORT-NAME>Pwm_Ch4Isr</SHORT-NAME>
                  <MINIMUM-START-INTERVAL>0.0</MINIMUM-START-INTERVAL>
                  <REENTRANCY-LEVEL>NON-REENTRANT</REENTRANCY-LEVEL>
                  <IMPLEMENTED-ENTRY-REF DEST="BSW-MODULE-ENTRY">/Pwm_TI_AM263Px/Pwm_ModuleEntry/Pwm_Ch4Isr</IMPLEMENTED-ENTRY-REF>
                  [!IF "as:modconf('Pwm')[1]/PwmGeneral/PwmTypeofInterruptFunction = 'PWM_ISR_CAT2'"!][!//
                  <INTERRUPT-CATEGORY>CAT-2</INTERRUPT-CATEGORY>
                  [!ELSE!][!//
                  <INTERRUPT-CATEGORY>CAT-1</INTERRUPT-CATEGORY>
                  [!ENDIF!][!//
                  <INTERRUPT-SOURCE>Hardware</INTERRUPT-SOURCE>
                </BSW-INTERRUPT-ENTITY>
                [!ENDIF!][!//
                [!IF "PwmChannelId = '50'"!][!//
                <BSW-INTERRUPT-ENTITY UUID="b2440454-5eb3-4457-b1aa-b6656673a67a">
                  <SHORT-NAME>Pwm_Ch50Isr</SHORT-NAME>
                  <MINIMUM-START-INTERVAL>0.0</MINIMUM-START-INTERVAL>
                  <REENTRANCY-LEVEL>NON-REENTRANT</REENTRANCY-LEVEL>
                  <IMPLEMENTED-ENTRY-REF DEST="BSW-MODULE-ENTRY">/Pwm_TI_AM263Px/Pwm_ModuleEntry/Pwm_Ch50Isr</IMPLEMENTED-ENTRY-REF>
                  [!IF "as:modconf('Pwm')[1]/PwmGeneral/PwmTypeofInterruptFunction = 'PWM_ISR_CAT2'"!][!//
                  <INTERRUPT-CATEGORY>CAT-2</INTERRUPT-CATEGORY>
                  [!ELSE!][!//
                  <INTERRUPT-CATEGORY>CAT-1</INTERRUPT-CATEGORY>
                  [!ENDIF!][!//
                  <INTERRUPT-SOURCE>Hardware</INTERRUPT-SOURCE>
                </BSW-INTERRUPT-ENTITY>
                [!ENDIF!][!//
                [!IF "PwmChannelId = '51'"!][!//
                <BSW-INTERRUPT-ENTITY UUID="8d11e769-a87b-4aa4-a20b-a56ecca685a9">
                  <SHORT-NAME>Pwm_Ch51Isr</SHORT-NAME>
                  <MINIMUM-START-INTERVAL>0.0</MINIMUM-START-INTERVAL>
                  <REENTRANCY-LEVEL>NON-REENTRANT</REENTRANCY-LEVEL>
                  <IMPLEMENTED-ENTRY-REF DEST="BSW-MODULE-ENTRY">/Pwm_TI_AM263Px/Pwm_ModuleEntry/Pwm_Ch51Isr</IMPLEMENTED-ENTRY-REF>
                  [!IF "as:modconf('Pwm')[1]/PwmGeneral/PwmTypeofInterruptFunction = 'PWM_ISR_CAT2'"!][!//
                  <INTERRUPT-CATEGORY>CAT-2</INTERRUPT-CATEGORY>
                  [!ELSE!][!//
                  <INTERRUPT-CATEGORY>CAT-1</INTERRUPT-CATEGORY>
                  [!ENDIF!][!//
                  <INTERRUPT-SOURCE>Hardware</INTERRUPT-SOURCE>
                </BSW-INTERRUPT-ENTITY>
                [!ENDIF!][!//
                [!IF "PwmChannelId = '52'"!][!//
                <BSW-INTERRUPT-ENTITY UUID="6d677209-a533-4985-8b17-0842336409b8">
                  <SHORT-NAME>Pwm_Ch52Isr</SHORT-NAME>
                  <MINIMUM-START-INTERVAL>0.0</MINIMUM-START-INTERVAL>
                  <REENTRANCY-LEVEL>NON-REENTRANT</REENTRANCY-LEVEL>
                  <IMPLEMENTED-ENTRY-REF DEST="BSW-MODULE-ENTRY">/Pwm_TI_AM263Px/Pwm_ModuleEntry/Pwm_Ch52Isr</IMPLEMENTED-ENTRY-REF>
                  [!IF "as:modconf('Pwm')[1]/PwmGeneral/PwmTypeofInterruptFunction = 'PWM_ISR_CAT2'"!][!//
                  <INTERRUPT-CATEGORY>CAT-2</INTERRUPT-CATEGORY>
                  [!ELSE!][!//
                  <INTERRUPT-CATEGORY>CAT-1</INTERRUPT-CATEGORY>
                  [!ENDIF!][!//
                  <INTERRUPT-SOURCE>Hardware</INTERRUPT-SOURCE>
                </BSW-INTERRUPT-ENTITY>
                [!ENDIF!][!//
                [!IF "PwmChannelId = '53'"!][!//
                <BSW-INTERRUPT-ENTITY UUID="1c86ad54-075d-48b5-afce-9b5de5bd4e43">
                  <SHORT-NAME>Pwm_Ch53Isr</SHORT-NAME>
                  <MINIMUM-START-INTERVAL>0.0</MINIMUM-START-INTERVAL>
                  <REENTRANCY-LEVEL>NON-REENTRANT</REENTRANCY-LEVEL>
                  <IMPLEMENTED-ENTRY-REF DEST="BSW-MODULE-ENTRY">/Pwm_TI_AM263Px/Pwm_ModuleEntry/Pwm_Ch53Isr</IMPLEMENTED-ENTRY-REF>
                  [!IF "as:modconf('Pwm')[1]/PwmGeneral/PwmTypeofInterruptFunction = 'PWM_ISR_CAT2'"!][!//
                  <INTERRUPT-CATEGORY>CAT-2</INTERRUPT-CATEGORY>
                  [!ELSE!][!//
                  <INTERRUPT-CATEGORY>CAT-1</INTERRUPT-CATEGORY>
                  [!ENDIF!][!//
                  <INTERRUPT-SOURCE>Hardware</INTERRUPT-SOURCE>
                </BSW-INTERRUPT-ENTITY>
                [!ENDIF!][!//
                [!IF "PwmChannelId = '54'"!][!//
                <BSW-INTERRUPT-ENTITY UUID="5e58e871-b0fb-4146-b0eb-9789e5916567">
                  <SHORT-NAME>Pwm_Ch54Isr</SHORT-NAME>
                  <MINIMUM-START-INTERVAL>0.0</MINIMUM-START-INTERVAL>
                  <REENTRANCY-LEVEL>NON-REENTRANT</REENTRANCY-LEVEL>
                  <IMPLEMENTED-ENTRY-REF DEST="BSW-MODULE-ENTRY">/Pwm_TI_AM263Px/Pwm_ModuleEntry/Pwm_Ch54Isr</IMPLEMENTED-ENTRY-REF>
                  [!IF "as:modconf('Pwm')[1]/PwmGeneral/PwmTypeofInterruptFunction = 'PWM_ISR_CAT2'"!][!//
                  <INTERRUPT-CATEGORY>CAT-2</INTERRUPT-CATEGORY>
                  [!ELSE!][!//
                  <INTERRUPT-CATEGORY>CAT-1</INTERRUPT-CATEGORY>
                  [!ENDIF!][!//
                  <INTERRUPT-SOURCE>Hardware</INTERRUPT-SOURCE>
                </BSW-INTERRUPT-ENTITY>
                [!ENDIF!][!//
                [!IF "PwmChannelId = '55'"!][!//
                <BSW-INTERRUPT-ENTITY UUID="b9e4047c-61a8-4abd-a2b2-89897dde9003">
                  <SHORT-NAME>Pwm_Ch55Isr</SHORT-NAME>
                  <MINIMUM-START-INTERVAL>0.0</MINIMUM-START-INTERVAL>
                  <REENTRANCY-LEVEL>NON-REENTRANT</REENTRANCY-LEVEL>
                  <IMPLEMENTED-ENTRY-REF DEST="BSW-MODULE-ENTRY">/Pwm_TI_AM263Px/Pwm_ModuleEntry/Pwm_Ch55Isr</IMPLEMENTED-ENTRY-REF>
                  [!IF "as:modconf('Pwm')[1]/PwmGeneral/PwmTypeofInterruptFunction = 'PWM_ISR_CAT2'"!][!//
                  <INTERRUPT-CATEGORY>CAT-2</INTERRUPT-CATEGORY>
                  [!ELSE!][!//
                  <INTERRUPT-CATEGORY>CAT-1</INTERRUPT-CATEGORY>
                  [!ENDIF!][!//
                  <INTERRUPT-SOURCE>Hardware</INTERRUPT-SOURCE>
                </BSW-INTERRUPT-ENTITY>
                [!ENDIF!][!//
                [!IF "PwmChannelId = '56'"!][!//
                <BSW-INTERRUPT-ENTITY UUID="795a2abd-3054-4d69-8f07-4a8b6b4fa7eb">
                  <SHORT-NAME>Pwm_Ch56Isr</SHORT-NAME>
                  <MINIMUM-START-INTERVAL>0.0</MINIMUM-START-INTERVAL>
                  <REENTRANCY-LEVEL>NON-REENTRANT</REENTRANCY-LEVEL>
                  <IMPLEMENTED-ENTRY-REF DEST="BSW-MODULE-ENTRY">/Pwm_TI_AM263Px/Pwm_ModuleEntry/Pwm_Ch56Isr</IMPLEMENTED-ENTRY-REF>
                  [!IF "as:modconf('Pwm')[1]/PwmGeneral/PwmTypeofInterruptFunction = 'PWM_ISR_CAT2'"!][!//
                  <INTERRUPT-CATEGORY>CAT-2</INTERRUPT-CATEGORY>
                  [!ELSE!][!//
                  <INTERRUPT-CATEGORY>CAT-1</INTERRUPT-CATEGORY>
                  [!ENDIF!][!//
                  <INTERRUPT-SOURCE>Hardware</INTERRUPT-SOURCE>
                </BSW-INTERRUPT-ENTITY>
                [!ENDIF!][!//
                [!IF "PwmChannelId = '57'"!][!//
                <BSW-INTERRUPT-ENTITY UUID="4752ea28-d6cf-4529-b456-d06e39ff8d19">
                  <SHORT-NAME>Pwm_Ch57Isr</SHORT-NAME>
                  <MINIMUM-START-INTERVAL>0.0</MINIMUM-START-INTERVAL>
                  <REENTRANCY-LEVEL>NON-REENTRANT</REENTRANCY-LEVEL>
                  <IMPLEMENTED-ENTRY-REF DEST="BSW-MODULE-ENTRY">/Pwm_TI_AM263Px/Pwm_ModuleEntry/Pwm_Ch57Isr</IMPLEMENTED-ENTRY-REF>
                  [!IF "as:modconf('Pwm')[1]/PwmGeneral/PwmTypeofInterruptFunction = 'PWM_ISR_CAT2'"!][!//
                  <INTERRUPT-CATEGORY>CAT-2</INTERRUPT-CATEGORY>
                  [!ELSE!][!//
                  <INTERRUPT-CATEGORY>CAT-1</INTERRUPT-CATEGORY>
                  [!ENDIF!][!//
                  <INTERRUPT-SOURCE>Hardware</INTERRUPT-SOURCE>
                </BSW-INTERRUPT-ENTITY>
                [!ENDIF!][!//
                [!IF "PwmChannelId = '58'"!][!//
                <BSW-INTERRUPT-ENTITY UUID="44c57c85-8b19-4f42-82fe-6fb786b2a59d">
                  <SHORT-NAME>Pwm_Ch58Isr</SHORT-NAME>
                  <MINIMUM-START-INTERVAL>0.0</MINIMUM-START-INTERVAL>
                  <REENTRANCY-LEVEL>NON-REENTRANT</REENTRANCY-LEVEL>
                  <IMPLEMENTED-ENTRY-REF DEST="BSW-MODULE-ENTRY">/Pwm_TI_AM263Px/Pwm_ModuleEntry/Pwm_Ch58Isr</IMPLEMENTED-ENTRY-REF>
                  [!IF "as:modconf('Pwm')[1]/PwmGeneral/PwmTypeofInterruptFunction = 'PWM_ISR_CAT2'"!][!//
                  <INTERRUPT-CATEGORY>CAT-2</INTERRUPT-CATEGORY>
                  [!ELSE!][!//
                  <INTERRUPT-CATEGORY>CAT-1</INTERRUPT-CATEGORY>
                  [!ENDIF!][!//
                  <INTERRUPT-SOURCE>Hardware</INTERRUPT-SOURCE>
                </BSW-INTERRUPT-ENTITY>
                [!ENDIF!][!//
                [!IF "PwmChannelId = '59'"!][!//
                <BSW-INTERRUPT-ENTITY UUID="7ac665fd-7265-4b3c-8083-d612af76fc2d">
                  <SHORT-NAME>Pwm_Ch59Isr</SHORT-NAME>
                  <MINIMUM-START-INTERVAL>0.0</MINIMUM-START-INTERVAL>
                  <REENTRANCY-LEVEL>NON-REENTRANT</REENTRANCY-LEVEL>
                  <IMPLEMENTED-ENTRY-REF DEST="BSW-MODULE-ENTRY">/Pwm_TI_AM263Px/Pwm_ModuleEntry/Pwm_Ch59Isr</IMPLEMENTED-ENTRY-REF>
                  [!IF "as:modconf('Pwm')[1]/PwmGeneral/PwmTypeofInterruptFunction = 'PWM_ISR_CAT2'"!][!//
                  <INTERRUPT-CATEGORY>CAT-2</INTERRUPT-CATEGORY>
                  [!ELSE!][!//
                  <INTERRUPT-CATEGORY>CAT-1</INTERRUPT-CATEGORY>
                  [!ENDIF!][!//
                  <INTERRUPT-SOURCE>Hardware</INTERRUPT-SOURCE>
                </BSW-INTERRUPT-ENTITY>
                [!ENDIF!][!//
                [!IF "PwmChannelId = '5'"!][!//
                <BSW-INTERRUPT-ENTITY UUID="227bff96-ac5a-4415-87c3-e3b6ada39727">
                  <SHORT-NAME>Pwm_Ch5Isr</SHORT-NAME>
                  <MINIMUM-START-INTERVAL>0.0</MINIMUM-START-INTERVAL>
                  <REENTRANCY-LEVEL>NON-REENTRANT</REENTRANCY-LEVEL>
                  <IMPLEMENTED-ENTRY-REF DEST="BSW-MODULE-ENTRY">/Pwm_TI_AM263Px/Pwm_ModuleEntry/Pwm_Ch5Isr</IMPLEMENTED-ENTRY-REF>
                  [!IF "as:modconf('Pwm')[1]/PwmGeneral/PwmTypeofInterruptFunction = 'PWM_ISR_CAT2'"!][!//
                  <INTERRUPT-CATEGORY>CAT-2</INTERRUPT-CATEGORY>
                  [!ELSE!][!//
                  <INTERRUPT-CATEGORY>CAT-1</INTERRUPT-CATEGORY>
                  [!ENDIF!][!//
                  <INTERRUPT-SOURCE>Hardware</INTERRUPT-SOURCE>
                </BSW-INTERRUPT-ENTITY>
                [!ENDIF!][!//
                [!IF "PwmChannelId = '60'"!][!//
                <BSW-INTERRUPT-ENTITY UUID="672c7fb3-6a6d-413b-a6a2-b635bea09aa3">
                  <SHORT-NAME>Pwm_Ch60Isr</SHORT-NAME>
                  <MINIMUM-START-INTERVAL>0.0</MINIMUM-START-INTERVAL>
                  <REENTRANCY-LEVEL>NON-REENTRANT</REENTRANCY-LEVEL>
                  <IMPLEMENTED-ENTRY-REF DEST="BSW-MODULE-ENTRY">/Pwm_TI_AM263Px/Pwm_ModuleEntry/Pwm_Ch60Isr</IMPLEMENTED-ENTRY-REF>
                  [!IF "as:modconf('Pwm')[1]/PwmGeneral/PwmTypeofInterruptFunction = 'PWM_ISR_CAT2'"!][!//
                  <INTERRUPT-CATEGORY>CAT-2</INTERRUPT-CATEGORY>
                  [!ELSE!][!//
                  <INTERRUPT-CATEGORY>CAT-1</INTERRUPT-CATEGORY>
                  [!ENDIF!][!//
                  <INTERRUPT-SOURCE>Hardware</INTERRUPT-SOURCE>
                </BSW-INTERRUPT-ENTITY>
                [!ENDIF!][!//
                [!IF "PwmChannelId = '61'"!][!//
                <BSW-INTERRUPT-ENTITY UUID="535d1245-972f-43f4-8809-ea68e9fa3953">
                  <SHORT-NAME>Pwm_Ch61Isr</SHORT-NAME>
                  <MINIMUM-START-INTERVAL>0.0</MINIMUM-START-INTERVAL>
                  <REENTRANCY-LEVEL>NON-REENTRANT</REENTRANCY-LEVEL>
                  <IMPLEMENTED-ENTRY-REF DEST="BSW-MODULE-ENTRY">/Pwm_TI_AM263Px/Pwm_ModuleEntry/Pwm_Ch61Isr</IMPLEMENTED-ENTRY-REF>
                  [!IF "as:modconf('Pwm')[1]/PwmGeneral/PwmTypeofInterruptFunction = 'PWM_ISR_CAT2'"!][!//
                  <INTERRUPT-CATEGORY>CAT-2</INTERRUPT-CATEGORY>
                  [!ELSE!][!//
                  <INTERRUPT-CATEGORY>CAT-1</INTERRUPT-CATEGORY>
                  [!ENDIF!][!//
                  <INTERRUPT-SOURCE>Hardware</INTERRUPT-SOURCE>
                </BSW-INTERRUPT-ENTITY>
                [!ENDIF!][!//
                [!IF "PwmChannelId = '62'"!][!//
                <BSW-INTERRUPT-ENTITY UUID="a6889028-df7d-46bd-91b6-be8793ff4684">
                  <SHORT-NAME>Pwm_Ch62Isr</SHORT-NAME>
                  <MINIMUM-START-INTERVAL>0.0</MINIMUM-START-INTERVAL>
                  <REENTRANCY-LEVEL>NON-REENTRANT</REENTRANCY-LEVEL>
                  <IMPLEMENTED-ENTRY-REF DEST="BSW-MODULE-ENTRY">/Pwm_TI_AM263Px/Pwm_ModuleEntry/Pwm_Ch62Isr</IMPLEMENTED-ENTRY-REF>
                  [!IF "as:modconf('Pwm')[1]/PwmGeneral/PwmTypeofInterruptFunction = 'PWM_ISR_CAT2'"!][!//
                  <INTERRUPT-CATEGORY>CAT-2</INTERRUPT-CATEGORY>
                  [!ELSE!][!//
                  <INTERRUPT-CATEGORY>CAT-1</INTERRUPT-CATEGORY>
                  [!ENDIF!][!//
                  <INTERRUPT-SOURCE>Hardware</INTERRUPT-SOURCE>
                </BSW-INTERRUPT-ENTITY>
                [!ENDIF!][!//
                [!IF "PwmChannelId = '63'"!][!//
                <BSW-INTERRUPT-ENTITY UUID="3842a87e-864b-4ca6-8ac4-5578e4a2d8f8">
                  <SHORT-NAME>Pwm_Ch63Isr</SHORT-NAME>
                  <MINIMUM-START-INTERVAL>0.0</MINIMUM-START-INTERVAL>
                  <REENTRANCY-LEVEL>NON-REENTRANT</REENTRANCY-LEVEL>
                  <IMPLEMENTED-ENTRY-REF DEST="BSW-MODULE-ENTRY">/Pwm_TI_AM263Px/Pwm_ModuleEntry/Pwm_Ch63Isr</IMPLEMENTED-ENTRY-REF>
                  [!IF "as:modconf('Pwm')[1]/PwmGeneral/PwmTypeofInterruptFunction = 'PWM_ISR_CAT2'"!][!//
                  <INTERRUPT-CATEGORY>CAT-2</INTERRUPT-CATEGORY>
                  [!ELSE!][!//
                  <INTERRUPT-CATEGORY>CAT-1</INTERRUPT-CATEGORY>
                  [!ENDIF!][!//
                  <INTERRUPT-SOURCE>Hardware</INTERRUPT-SOURCE>
                </BSW-INTERRUPT-ENTITY>
                [!ENDIF!][!//
                [!IF "PwmChannelId = '64'"!][!//
                <BSW-INTERRUPT-ENTITY UUID="d476643e-f87b-4ff1-83ff-90186e802693">
                  <SHORT-NAME>Pwm_Ch64Isr</SHORT-NAME>
                  <MINIMUM-START-INTERVAL>0.0</MINIMUM-START-INTERVAL>
                  <REENTRANCY-LEVEL>NON-REENTRANT</REENTRANCY-LEVEL>
                  <IMPLEMENTED-ENTRY-REF DEST="BSW-MODULE-ENTRY">/Pwm_TI_AM263Px/Pwm_ModuleEntry/Pwm_Ch64Isr</IMPLEMENTED-ENTRY-REF>
                  [!IF "as:modconf('Pwm')[1]/PwmGeneral/PwmTypeofInterruptFunction = 'PWM_ISR_CAT2'"!][!//
                  <INTERRUPT-CATEGORY>CAT-2</INTERRUPT-CATEGORY>
                  [!ELSE!][!//
                  <INTERRUPT-CATEGORY>CAT-1</INTERRUPT-CATEGORY>
                  [!ENDIF!][!//
                  <INTERRUPT-SOURCE>Hardware</INTERRUPT-SOURCE>
                </BSW-INTERRUPT-ENTITY>
                [!ENDIF!][!//
                [!IF "PwmChannelId = '65'"!][!//
                <BSW-INTERRUPT-ENTITY UUID="64ec9957-cae5-4cca-bef6-a3d86f27bc6f">
                  <SHORT-NAME>Pwm_Ch65Isr</SHORT-NAME>
                  <MINIMUM-START-INTERVAL>0.0</MINIMUM-START-INTERVAL>
                  <REENTRANCY-LEVEL>NON-REENTRANT</REENTRANCY-LEVEL>
                  <IMPLEMENTED-ENTRY-REF DEST="BSW-MODULE-ENTRY">/Pwm_TI_AM263Px/Pwm_ModuleEntry/Pwm_Ch65Isr</IMPLEMENTED-ENTRY-REF>
                  [!IF "as:modconf('Pwm')[1]/PwmGeneral/PwmTypeofInterruptFunction = 'PWM_ISR_CAT2'"!][!//
                  <INTERRUPT-CATEGORY>CAT-2</INTERRUPT-CATEGORY>
                  [!ELSE!][!//
                  <INTERRUPT-CATEGORY>CAT-1</INTERRUPT-CATEGORY>
                  [!ENDIF!][!//
                  <INTERRUPT-SOURCE>Hardware</INTERRUPT-SOURCE>
                </BSW-INTERRUPT-ENTITY>
                [!ENDIF!][!//
                [!IF "PwmChannelId = '66'"!][!//
                <BSW-INTERRUPT-ENTITY UUID="4fdb8f27-1a68-4099-80c8-eec8800991a8">
                  <SHORT-NAME>Pwm_Ch66Isr</SHORT-NAME>
                  <MINIMUM-START-INTERVAL>0.0</MINIMUM-START-INTERVAL>
                  <REENTRANCY-LEVEL>NON-REENTRANT</REENTRANCY-LEVEL>
                  <IMPLEMENTED-ENTRY-REF DEST="BSW-MODULE-ENTRY">/Pwm_TI_AM263Px/Pwm_ModuleEntry/Pwm_Ch66Isr</IMPLEMENTED-ENTRY-REF>
                  [!IF "as:modconf('Pwm')[1]/PwmGeneral/PwmTypeofInterruptFunction = 'PWM_ISR_CAT2'"!][!//
                  <INTERRUPT-CATEGORY>CAT-2</INTERRUPT-CATEGORY>
                  [!ELSE!][!//
                  <INTERRUPT-CATEGORY>CAT-1</INTERRUPT-CATEGORY>
                  [!ENDIF!][!//
                  <INTERRUPT-SOURCE>Hardware</INTERRUPT-SOURCE>
                </BSW-INTERRUPT-ENTITY>
                [!ENDIF!][!//
                [!IF "PwmChannelId = '67'"!][!//
                <BSW-INTERRUPT-ENTITY UUID="efe208f5-8cfe-4830-a4b0-45957575c130">
                  <SHORT-NAME>Pwm_Ch67Isr</SHORT-NAME>
                  <MINIMUM-START-INTERVAL>0.0</MINIMUM-START-INTERVAL>
                  <REENTRANCY-LEVEL>NON-REENTRANT</REENTRANCY-LEVEL>
                  <IMPLEMENTED-ENTRY-REF DEST="BSW-MODULE-ENTRY">/Pwm_TI_AM263Px/Pwm_ModuleEntry/Pwm_Ch67Isr</IMPLEMENTED-ENTRY-REF>
                  [!IF "as:modconf('Pwm')[1]/PwmGeneral/PwmTypeofInterruptFunction = 'PWM_ISR_CAT2'"!][!//
                  <INTERRUPT-CATEGORY>CAT-2</INTERRUPT-CATEGORY>
                  [!ELSE!][!//
                  <INTERRUPT-CATEGORY>CAT-1</INTERRUPT-CATEGORY>
                  [!ENDIF!][!//
                  <INTERRUPT-SOURCE>Hardware</INTERRUPT-SOURCE>
                </BSW-INTERRUPT-ENTITY>
                [!ENDIF!][!//
                [!IF "PwmChannelId = '68'"!][!//
                <BSW-INTERRUPT-ENTITY UUID="a0c6ecb7-e089-4b45-83c6-80a9371be4a5">
                  <SHORT-NAME>Pwm_Ch68Isr</SHORT-NAME>
                  <MINIMUM-START-INTERVAL>0.0</MINIMUM-START-INTERVAL>
                  <REENTRANCY-LEVEL>NON-REENTRANT</REENTRANCY-LEVEL>
                  <IMPLEMENTED-ENTRY-REF DEST="BSW-MODULE-ENTRY">/Pwm_TI_AM263Px/Pwm_ModuleEntry/Pwm_Ch68Isr</IMPLEMENTED-ENTRY-REF>
                  [!IF "as:modconf('Pwm')[1]/PwmGeneral/PwmTypeofInterruptFunction = 'PWM_ISR_CAT2'"!][!//
                  <INTERRUPT-CATEGORY>CAT-2</INTERRUPT-CATEGORY>
                  [!ELSE!][!//
                  <INTERRUPT-CATEGORY>CAT-1</INTERRUPT-CATEGORY>
                  [!ENDIF!][!//
                  <INTERRUPT-SOURCE>Hardware</INTERRUPT-SOURCE>
                </BSW-INTERRUPT-ENTITY>
                [!ENDIF!][!//
                [!IF "PwmChannelId = '69'"!][!//
                <BSW-INTERRUPT-ENTITY UUID="6277ba53-17aa-446f-a713-3306fb9c99e8">
                  <SHORT-NAME>Pwm_Ch69Isr</SHORT-NAME>
                  <MINIMUM-START-INTERVAL>0.0</MINIMUM-START-INTERVAL>
                  <REENTRANCY-LEVEL>NON-REENTRANT</REENTRANCY-LEVEL>
                  <IMPLEMENTED-ENTRY-REF DEST="BSW-MODULE-ENTRY">/Pwm_TI_AM263Px/Pwm_ModuleEntry/Pwm_Ch69Isr</IMPLEMENTED-ENTRY-REF>
                  [!IF "as:modconf('Pwm')[1]/PwmGeneral/PwmTypeofInterruptFunction = 'PWM_ISR_CAT2'"!][!//
                  <INTERRUPT-CATEGORY>CAT-2</INTERRUPT-CATEGORY>
                  [!ELSE!][!//
                  <INTERRUPT-CATEGORY>CAT-1</INTERRUPT-CATEGORY>
                  [!ENDIF!][!//
                  <INTERRUPT-SOURCE>Hardware</INTERRUPT-SOURCE>
                </BSW-INTERRUPT-ENTITY>
                [!ENDIF!][!//
                [!IF "PwmChannelId = '6'"!][!//
                <BSW-INTERRUPT-ENTITY UUID="3e011397-fcf5-4f58-a8fa-9ea5fbd3ff98">
                  <SHORT-NAME>Pwm_Ch6Isr</SHORT-NAME>
                  <MINIMUM-START-INTERVAL>0.0</MINIMUM-START-INTERVAL>
                  <REENTRANCY-LEVEL>NON-REENTRANT</REENTRANCY-LEVEL>
                  <IMPLEMENTED-ENTRY-REF DEST="BSW-MODULE-ENTRY">/Pwm_TI_AM263Px/Pwm_ModuleEntry/Pwm_Ch6Isr</IMPLEMENTED-ENTRY-REF>
                  [!IF "as:modconf('Pwm')[1]/PwmGeneral/PwmTypeofInterruptFunction = 'PWM_ISR_CAT2'"!][!//
                  <INTERRUPT-CATEGORY>CAT-2</INTERRUPT-CATEGORY>
                  [!ELSE!][!//
                  <INTERRUPT-CATEGORY>CAT-1</INTERRUPT-CATEGORY>
                  [!ENDIF!][!//
                  <INTERRUPT-SOURCE>Hardware</INTERRUPT-SOURCE>
                </BSW-INTERRUPT-ENTITY>
                [!ENDIF!][!//
                [!IF "PwmChannelId = '70'"!][!//
                <BSW-INTERRUPT-ENTITY UUID="bf5bebf2-7dab-4e6f-866b-915d644913c1">
                  <SHORT-NAME>Pwm_Ch70Isr</SHORT-NAME>
                  <MINIMUM-START-INTERVAL>0.0</MINIMUM-START-INTERVAL>
                  <REENTRANCY-LEVEL>NON-REENTRANT</REENTRANCY-LEVEL>
                  <IMPLEMENTED-ENTRY-REF DEST="BSW-MODULE-ENTRY">/Pwm_TI_AM263Px/Pwm_ModuleEntry/Pwm_Ch70Isr</IMPLEMENTED-ENTRY-REF>
                  [!IF "as:modconf('Pwm')[1]/PwmGeneral/PwmTypeofInterruptFunction = 'PWM_ISR_CAT2'"!][!//
                  <INTERRUPT-CATEGORY>CAT-2</INTERRUPT-CATEGORY>
                  [!ELSE!][!//
                  <INTERRUPT-CATEGORY>CAT-1</INTERRUPT-CATEGORY>
                  [!ENDIF!][!//
                  <INTERRUPT-SOURCE>Hardware</INTERRUPT-SOURCE>
                </BSW-INTERRUPT-ENTITY>
                [!ENDIF!][!//
                [!IF "PwmChannelId = '71'"!][!//
                <BSW-INTERRUPT-ENTITY UUID="d3931160-13f0-4426-86ae-5f66b8e87b7f">
                  <SHORT-NAME>Pwm_Ch71Isr</SHORT-NAME>
                  <MINIMUM-START-INTERVAL>0.0</MINIMUM-START-INTERVAL>
                  <REENTRANCY-LEVEL>NON-REENTRANT</REENTRANCY-LEVEL>
                  <IMPLEMENTED-ENTRY-REF DEST="BSW-MODULE-ENTRY">/Pwm_TI_AM263Px/Pwm_ModuleEntry/Pwm_Ch71Isr</IMPLEMENTED-ENTRY-REF>
                  [!IF "as:modconf('Pwm')[1]/PwmGeneral/PwmTypeofInterruptFunction = 'PWM_ISR_CAT2'"!][!//
                  <INTERRUPT-CATEGORY>CAT-2</INTERRUPT-CATEGORY>
                  [!ELSE!][!//
                  <INTERRUPT-CATEGORY>CAT-1</INTERRUPT-CATEGORY>
                  [!ENDIF!][!//
                  <INTERRUPT-SOURCE>Hardware</INTERRUPT-SOURCE>
                </BSW-INTERRUPT-ENTITY>
                [!ENDIF!][!//
                [!IF "PwmChannelId = '72'"!][!//
                <BSW-INTERRUPT-ENTITY UUID="7049f184-4e7a-4531-bcde-20d02eb42da6">
                  <SHORT-NAME>Pwm_Ch72Isr</SHORT-NAME>
                  <MINIMUM-START-INTERVAL>0.0</MINIMUM-START-INTERVAL>
                  <REENTRANCY-LEVEL>NON-REENTRANT</REENTRANCY-LEVEL>
                  <IMPLEMENTED-ENTRY-REF DEST="BSW-MODULE-ENTRY">/Pwm_TI_AM263Px/Pwm_ModuleEntry/Pwm_Ch72Isr</IMPLEMENTED-ENTRY-REF>
                  [!IF "as:modconf('Pwm')[1]/PwmGeneral/PwmTypeofInterruptFunction = 'PWM_ISR_CAT2'"!][!//
                  <INTERRUPT-CATEGORY>CAT-2</INTERRUPT-CATEGORY>
                  [!ELSE!][!//
                  <INTERRUPT-CATEGORY>CAT-1</INTERRUPT-CATEGORY>
                  [!ENDIF!][!//
                  <INTERRUPT-SOURCE>Hardware</INTERRUPT-SOURCE>
                </BSW-INTERRUPT-ENTITY>
                [!ENDIF!][!//
                [!IF "PwmChannelId = '73'"!][!//
                <BSW-INTERRUPT-ENTITY UUID="b74852db-42da-4809-94d3-0c9137741266">
                  <SHORT-NAME>Pwm_Ch73Isr</SHORT-NAME>
                  <MINIMUM-START-INTERVAL>0.0</MINIMUM-START-INTERVAL>
                  <REENTRANCY-LEVEL>NON-REENTRANT</REENTRANCY-LEVEL>
                  <IMPLEMENTED-ENTRY-REF DEST="BSW-MODULE-ENTRY">/Pwm_TI_AM263Px/Pwm_ModuleEntry/Pwm_Ch73Isr</IMPLEMENTED-ENTRY-REF>
                  [!IF "as:modconf('Pwm')[1]/PwmGeneral/PwmTypeofInterruptFunction = 'PWM_ISR_CAT2'"!][!//
                  <INTERRUPT-CATEGORY>CAT-2</INTERRUPT-CATEGORY>
                  [!ELSE!][!//
                  <INTERRUPT-CATEGORY>CAT-1</INTERRUPT-CATEGORY>
                  [!ENDIF!][!//
                  <INTERRUPT-SOURCE>Hardware</INTERRUPT-SOURCE>
                </BSW-INTERRUPT-ENTITY>
                [!ENDIF!][!//
                [!IF "PwmChannelId = '74'"!][!//
                <BSW-INTERRUPT-ENTITY UUID="7f649682-1cec-4bd5-8508-bbe1b863f015">
                  <SHORT-NAME>Pwm_Ch74Isr</SHORT-NAME>
                  <MINIMUM-START-INTERVAL>0.0</MINIMUM-START-INTERVAL>
                  <REENTRANCY-LEVEL>NON-REENTRANT</REENTRANCY-LEVEL>
                  <IMPLEMENTED-ENTRY-REF DEST="BSW-MODULE-ENTRY">/Pwm_TI_AM263Px/Pwm_ModuleEntry/Pwm_Ch74Isr</IMPLEMENTED-ENTRY-REF>
                  [!IF "as:modconf('Pwm')[1]/PwmGeneral/PwmTypeofInterruptFunction = 'PWM_ISR_CAT2'"!][!//
                  <INTERRUPT-CATEGORY>CAT-2</INTERRUPT-CATEGORY>
                  [!ELSE!][!//
                  <INTERRUPT-CATEGORY>CAT-1</INTERRUPT-CATEGORY>
                  [!ENDIF!][!//
                  <INTERRUPT-SOURCE>Hardware</INTERRUPT-SOURCE>
                </BSW-INTERRUPT-ENTITY>
                [!ENDIF!][!//
                [!IF "PwmChannelId = '75'"!][!//
                <BSW-INTERRUPT-ENTITY UUID="5657babf-f20b-4200-979c-e1913d301cc0">
                  <SHORT-NAME>Pwm_Ch75Isr</SHORT-NAME>
                  <MINIMUM-START-INTERVAL>0.0</MINIMUM-START-INTERVAL>
                  <REENTRANCY-LEVEL>NON-REENTRANT</REENTRANCY-LEVEL>
                  <IMPLEMENTED-ENTRY-REF DEST="BSW-MODULE-ENTRY">/Pwm_TI_AM263Px/Pwm_ModuleEntry/Pwm_Ch75Isr</IMPLEMENTED-ENTRY-REF>
                  [!IF "as:modconf('Pwm')[1]/PwmGeneral/PwmTypeofInterruptFunction = 'PWM_ISR_CAT2'"!][!//
                  <INTERRUPT-CATEGORY>CAT-2</INTERRUPT-CATEGORY>
                  [!ELSE!][!//
                  <INTERRUPT-CATEGORY>CAT-1</INTERRUPT-CATEGORY>
                  [!ENDIF!][!//
                  <INTERRUPT-SOURCE>Hardware</INTERRUPT-SOURCE>
                </BSW-INTERRUPT-ENTITY>
                [!ENDIF!][!//
                [!IF "PwmChannelId = '76'"!][!//
                <BSW-INTERRUPT-ENTITY UUID="92081956-e820-4a39-9a7b-83fb75ef17d7">
                  <SHORT-NAME>Pwm_Ch76Isr</SHORT-NAME>
                  <MINIMUM-START-INTERVAL>0.0</MINIMUM-START-INTERVAL>
                  <REENTRANCY-LEVEL>NON-REENTRANT</REENTRANCY-LEVEL>
                  <IMPLEMENTED-ENTRY-REF DEST="BSW-MODULE-ENTRY">/Pwm_TI_AM263Px/Pwm_ModuleEntry/Pwm_Ch76Isr</IMPLEMENTED-ENTRY-REF>
                  [!IF "as:modconf('Pwm')[1]/PwmGeneral/PwmTypeofInterruptFunction = 'PWM_ISR_CAT2'"!][!//
                  <INTERRUPT-CATEGORY>CAT-2</INTERRUPT-CATEGORY>
                  [!ELSE!][!//
                  <INTERRUPT-CATEGORY>CAT-1</INTERRUPT-CATEGORY>
                  [!ENDIF!][!//
                  <INTERRUPT-SOURCE>Hardware</INTERRUPT-SOURCE>
                </BSW-INTERRUPT-ENTITY>
                [!ENDIF!][!//
                [!IF "PwmChannelId = '77'"!][!//
                <BSW-INTERRUPT-ENTITY UUID="2bd16531-f297-4d3a-a06c-6bf5ad441794">
                  <SHORT-NAME>Pwm_Ch77Isr</SHORT-NAME>
                  <MINIMUM-START-INTERVAL>0.0</MINIMUM-START-INTERVAL>
                  <REENTRANCY-LEVEL>NON-REENTRANT</REENTRANCY-LEVEL>
                  <IMPLEMENTED-ENTRY-REF DEST="BSW-MODULE-ENTRY">/Pwm_TI_AM263Px/Pwm_ModuleEntry/Pwm_Ch77Isr</IMPLEMENTED-ENTRY-REF>
                  [!IF "as:modconf('Pwm')[1]/PwmGeneral/PwmTypeofInterruptFunction = 'PWM_ISR_CAT2'"!][!//
                  <INTERRUPT-CATEGORY>CAT-2</INTERRUPT-CATEGORY>
                  [!ELSE!][!//
                  <INTERRUPT-CATEGORY>CAT-1</INTERRUPT-CATEGORY>
                  [!ENDIF!][!//
                  <INTERRUPT-SOURCE>Hardware</INTERRUPT-SOURCE>
                </BSW-INTERRUPT-ENTITY>
                [!ENDIF!][!//
                [!IF "PwmChannelId = '78'"!][!//
                <BSW-INTERRUPT-ENTITY UUID="e57bdaaf-233f-41ff-8fb4-1952e6f10673">
                  <SHORT-NAME>Pwm_Ch78Isr</SHORT-NAME>
                  <MINIMUM-START-INTERVAL>0.0</MINIMUM-START-INTERVAL>
                  <REENTRANCY-LEVEL>NON-REENTRANT</REENTRANCY-LEVEL>
                  <IMPLEMENTED-ENTRY-REF DEST="BSW-MODULE-ENTRY">/Pwm_TI_AM263Px/Pwm_ModuleEntry/Pwm_Ch78Isr</IMPLEMENTED-ENTRY-REF>
                  [!IF "as:modconf('Pwm')[1]/PwmGeneral/PwmTypeofInterruptFunction = 'PWM_ISR_CAT2'"!][!//
                  <INTERRUPT-CATEGORY>CAT-2</INTERRUPT-CATEGORY>
                  [!ELSE!][!//
                  <INTERRUPT-CATEGORY>CAT-1</INTERRUPT-CATEGORY>
                  [!ENDIF!][!//
                  <INTERRUPT-SOURCE>Hardware</INTERRUPT-SOURCE>
                </BSW-INTERRUPT-ENTITY>
                [!ENDIF!][!//
                [!IF "PwmChannelId = '79'"!][!//
                <BSW-INTERRUPT-ENTITY UUID="74b84d6c-92a3-486e-a727-dab9c65c1293">
                  <SHORT-NAME>Pwm_Ch79Isr</SHORT-NAME>
                  <MINIMUM-START-INTERVAL>0.0</MINIMUM-START-INTERVAL>
                  <REENTRANCY-LEVEL>NON-REENTRANT</REENTRANCY-LEVEL>
                  <IMPLEMENTED-ENTRY-REF DEST="BSW-MODULE-ENTRY">/Pwm_TI_AM263Px/Pwm_ModuleEntry/Pwm_Ch79Isr</IMPLEMENTED-ENTRY-REF>
                  [!IF "as:modconf('Pwm')[1]/PwmGeneral/PwmTypeofInterruptFunction = 'PWM_ISR_CAT2'"!][!//
                  <INTERRUPT-CATEGORY>CAT-2</INTERRUPT-CATEGORY>
                  [!ELSE!][!//
                  <INTERRUPT-CATEGORY>CAT-1</INTERRUPT-CATEGORY>
                  [!ENDIF!][!//
                  <INTERRUPT-SOURCE>Hardware</INTERRUPT-SOURCE>
                </BSW-INTERRUPT-ENTITY>
                [!ENDIF!][!//
                [!IF "PwmChannelId = '7'"!][!//
                <BSW-INTERRUPT-ENTITY UUID="825f5a44-f023-43fb-a52d-6d1b9b4cb011">
                  <SHORT-NAME>Pwm_Ch7Isr</SHORT-NAME>
                  <MINIMUM-START-INTERVAL>0.0</MINIMUM-START-INTERVAL>
                  <REENTRANCY-LEVEL>NON-REENTRANT</REENTRANCY-LEVEL>
                  <IMPLEMENTED-ENTRY-REF DEST="BSW-MODULE-ENTRY">/Pwm_TI_AM263Px/Pwm_ModuleEntry/Pwm_Ch7Isr</IMPLEMENTED-ENTRY-REF>
                  [!IF "as:modconf('Pwm')[1]/PwmGeneral/PwmTypeofInterruptFunction = 'PWM_ISR_CAT2'"!][!//
                  <INTERRUPT-CATEGORY>CAT-2</INTERRUPT-CATEGORY>
                  [!ELSE!][!//
                  <INTERRUPT-CATEGORY>CAT-1</INTERRUPT-CATEGORY>
                  [!ENDIF!][!//
                  <INTERRUPT-SOURCE>Hardware</INTERRUPT-SOURCE>
                </BSW-INTERRUPT-ENTITY>
                [!ENDIF!][!//
                [!IF "PwmChannelId = '80'"!][!//
                <BSW-INTERRUPT-ENTITY UUID="9b0d61e6-4397-43ff-9df5-d9a796eff515">
                  <SHORT-NAME>Pwm_Ch80Isr</SHORT-NAME>
                  <MINIMUM-START-INTERVAL>0.0</MINIMUM-START-INTERVAL>
                  <REENTRANCY-LEVEL>NON-REENTRANT</REENTRANCY-LEVEL>
                  <IMPLEMENTED-ENTRY-REF DEST="BSW-MODULE-ENTRY">/Pwm_TI_AM263Px/Pwm_ModuleEntry/Pwm_Ch80Isr</IMPLEMENTED-ENTRY-REF>
                  [!IF "as:modconf('Pwm')[1]/PwmGeneral/PwmTypeofInterruptFunction = 'PWM_ISR_CAT2'"!][!//
                  <INTERRUPT-CATEGORY>CAT-2</INTERRUPT-CATEGORY>
                  [!ELSE!][!//
                  <INTERRUPT-CATEGORY>CAT-1</INTERRUPT-CATEGORY>
                  [!ENDIF!][!//
                  <INTERRUPT-SOURCE>Hardware</INTERRUPT-SOURCE>
                </BSW-INTERRUPT-ENTITY>
                [!ENDIF!][!//
                [!IF "PwmChannelId = '81'"!][!//
                <BSW-INTERRUPT-ENTITY UUID="14f582f6-1af8-47f3-a194-103cf680ee6a">
                  <SHORT-NAME>Pwm_Ch81Isr</SHORT-NAME>
                  <MINIMUM-START-INTERVAL>0.0</MINIMUM-START-INTERVAL>
                  <REENTRANCY-LEVEL>NON-REENTRANT</REENTRANCY-LEVEL>
                  <IMPLEMENTED-ENTRY-REF DEST="BSW-MODULE-ENTRY">/Pwm_TI_AM263Px/Pwm_ModuleEntry/Pwm_Ch81Isr</IMPLEMENTED-ENTRY-REF>
                  [!IF "as:modconf('Pwm')[1]/PwmGeneral/PwmTypeofInterruptFunction = 'PWM_ISR_CAT2'"!][!//
                  <INTERRUPT-CATEGORY>CAT-2</INTERRUPT-CATEGORY>
                  [!ELSE!][!//
                  <INTERRUPT-CATEGORY>CAT-1</INTERRUPT-CATEGORY>
                  [!ENDIF!][!//
                  <INTERRUPT-SOURCE>Hardware</INTERRUPT-SOURCE>
                </BSW-INTERRUPT-ENTITY>
                [!ENDIF!][!//
                [!IF "PwmChannelId = '82'"!][!//
                <BSW-INTERRUPT-ENTITY UUID="be457847-3a1a-4a97-bcfd-bdbad90a0638">
                  <SHORT-NAME>Pwm_Ch82Isr</SHORT-NAME>
                  <MINIMUM-START-INTERVAL>0.0</MINIMUM-START-INTERVAL>
                  <REENTRANCY-LEVEL>NON-REENTRANT</REENTRANCY-LEVEL>
                  <IMPLEMENTED-ENTRY-REF DEST="BSW-MODULE-ENTRY">/Pwm_TI_AM263Px/Pwm_ModuleEntry/Pwm_Ch82Isr</IMPLEMENTED-ENTRY-REF>
                  [!IF "as:modconf('Pwm')[1]/PwmGeneral/PwmTypeofInterruptFunction = 'PWM_ISR_CAT2'"!][!//
                  <INTERRUPT-CATEGORY>CAT-2</INTERRUPT-CATEGORY>
                  [!ELSE!][!//
                  <INTERRUPT-CATEGORY>CAT-1</INTERRUPT-CATEGORY>
                  [!ENDIF!][!//
                  <INTERRUPT-SOURCE>Hardware</INTERRUPT-SOURCE>
                </BSW-INTERRUPT-ENTITY>
                [!ENDIF!][!//
                [!IF "PwmChannelId = '83'"!][!//
                <BSW-INTERRUPT-ENTITY UUID="f2692535-5369-475d-8f62-68b3a39cdba2">
                  <SHORT-NAME>Pwm_Ch83Isr</SHORT-NAME>
                  <MINIMUM-START-INTERVAL>0.0</MINIMUM-START-INTERVAL>
                  <REENTRANCY-LEVEL>NON-REENTRANT</REENTRANCY-LEVEL>
                  <IMPLEMENTED-ENTRY-REF DEST="BSW-MODULE-ENTRY">/Pwm_TI_AM263Px/Pwm_ModuleEntry/Pwm_Ch83Isr</IMPLEMENTED-ENTRY-REF>
                  [!IF "as:modconf('Pwm')[1]/PwmGeneral/PwmTypeofInterruptFunction = 'PWM_ISR_CAT2'"!][!//
                  <INTERRUPT-CATEGORY>CAT-2</INTERRUPT-CATEGORY>
                  [!ELSE!][!//
                  <INTERRUPT-CATEGORY>CAT-1</INTERRUPT-CATEGORY>
                  [!ENDIF!][!//
                  <INTERRUPT-SOURCE>Hardware</INTERRUPT-SOURCE>
                </BSW-INTERRUPT-ENTITY>
                [!ENDIF!][!//
                [!IF "PwmChannelId = '84'"!][!//
                <BSW-INTERRUPT-ENTITY UUID="9554f16e-4f35-482d-9c82-d9a42770c078">
                  <SHORT-NAME>Pwm_Ch84Isr</SHORT-NAME>
                  <MINIMUM-START-INTERVAL>0.0</MINIMUM-START-INTERVAL>
                  <REENTRANCY-LEVEL>NON-REENTRANT</REENTRANCY-LEVEL>
                  <IMPLEMENTED-ENTRY-REF DEST="BSW-MODULE-ENTRY">/Pwm_TI_AM263Px/Pwm_ModuleEntry/Pwm_Ch84Isr</IMPLEMENTED-ENTRY-REF>
                  [!IF "as:modconf('Pwm')[1]/PwmGeneral/PwmTypeofInterruptFunction = 'PWM_ISR_CAT2'"!][!//
                  <INTERRUPT-CATEGORY>CAT-2</INTERRUPT-CATEGORY>
                  [!ELSE!][!//
                  <INTERRUPT-CATEGORY>CAT-1</INTERRUPT-CATEGORY>
                  [!ENDIF!][!//
                  <INTERRUPT-SOURCE>Hardware</INTERRUPT-SOURCE>
                </BSW-INTERRUPT-ENTITY>
                [!ENDIF!][!//
                [!IF "PwmChannelId = '85'"!][!//
                <BSW-INTERRUPT-ENTITY UUID="701dd522-6004-45b9-9c1f-0c4d69363912">
                  <SHORT-NAME>Pwm_Ch85Isr</SHORT-NAME>
                  <MINIMUM-START-INTERVAL>0.0</MINIMUM-START-INTERVAL>
                  <REENTRANCY-LEVEL>NON-REENTRANT</REENTRANCY-LEVEL>
                  <IMPLEMENTED-ENTRY-REF DEST="BSW-MODULE-ENTRY">/Pwm_TI_AM263Px/Pwm_ModuleEntry/Pwm_Ch85Isr</IMPLEMENTED-ENTRY-REF>
                  [!IF "as:modconf('Pwm')[1]/PwmGeneral/PwmTypeofInterruptFunction = 'PWM_ISR_CAT2'"!][!//
                  <INTERRUPT-CATEGORY>CAT-2</INTERRUPT-CATEGORY>
                  [!ELSE!][!//
                  <INTERRUPT-CATEGORY>CAT-1</INTERRUPT-CATEGORY>
                  [!ENDIF!][!//
                  <INTERRUPT-SOURCE>Hardware</INTERRUPT-SOURCE>
                </BSW-INTERRUPT-ENTITY>
                [!ENDIF!][!//
                [!IF "PwmChannelId = '86'"!][!//
                <BSW-INTERRUPT-ENTITY UUID="c2d0d734-a4a8-4bd0-b4db-52a655f91c34">
                  <SHORT-NAME>Pwm_Ch86Isr</SHORT-NAME>
                  <MINIMUM-START-INTERVAL>0.0</MINIMUM-START-INTERVAL>
                  <REENTRANCY-LEVEL>NON-REENTRANT</REENTRANCY-LEVEL>
                  <IMPLEMENTED-ENTRY-REF DEST="BSW-MODULE-ENTRY">/Pwm_TI_AM263Px/Pwm_ModuleEntry/Pwm_Ch86Isr</IMPLEMENTED-ENTRY-REF>
                  [!IF "as:modconf('Pwm')[1]/PwmGeneral/PwmTypeofInterruptFunction = 'PWM_ISR_CAT2'"!][!//
                  <INTERRUPT-CATEGORY>CAT-2</INTERRUPT-CATEGORY>
                  [!ELSE!][!//
                  <INTERRUPT-CATEGORY>CAT-1</INTERRUPT-CATEGORY>
                  [!ENDIF!][!//
                  <INTERRUPT-SOURCE>Hardware</INTERRUPT-SOURCE>
                </BSW-INTERRUPT-ENTITY>
                [!ENDIF!][!//
                [!IF "PwmChannelId = '87'"!][!//
                <BSW-INTERRUPT-ENTITY UUID="433e5a64-5f23-4f4d-90e9-876eb4ce37e8">
                  <SHORT-NAME>Pwm_Ch87Isr</SHORT-NAME>
                  <MINIMUM-START-INTERVAL>0.0</MINIMUM-START-INTERVAL>
                  <REENTRANCY-LEVEL>NON-REENTRANT</REENTRANCY-LEVEL>
                  <IMPLEMENTED-ENTRY-REF DEST="BSW-MODULE-ENTRY">/Pwm_TI_AM263Px/Pwm_ModuleEntry/Pwm_Ch87Isr</IMPLEMENTED-ENTRY-REF>
                  [!IF "as:modconf('Pwm')[1]/PwmGeneral/PwmTypeofInterruptFunction = 'PWM_ISR_CAT2'"!][!//
                  <INTERRUPT-CATEGORY>CAT-2</INTERRUPT-CATEGORY>
                  [!ELSE!][!//
                  <INTERRUPT-CATEGORY>CAT-1</INTERRUPT-CATEGORY>
                  [!ENDIF!][!//
                  <INTERRUPT-SOURCE>Hardware</INTERRUPT-SOURCE>
                </BSW-INTERRUPT-ENTITY>
                [!ENDIF!][!//
                [!IF "PwmChannelId = '88'"!][!//
                <BSW-INTERRUPT-ENTITY UUID="5c5d7a0e-4a04-4f49-90ce-d232524c3967">
                  <SHORT-NAME>Pwm_Ch88Isr</SHORT-NAME>
                  <MINIMUM-START-INTERVAL>0.0</MINIMUM-START-INTERVAL>
                  <REENTRANCY-LEVEL>NON-REENTRANT</REENTRANCY-LEVEL>
                  <IMPLEMENTED-ENTRY-REF DEST="BSW-MODULE-ENTRY">/Pwm_TI_AM263Px/Pwm_ModuleEntry/Pwm_Ch88Isr</IMPLEMENTED-ENTRY-REF>
                  [!IF "as:modconf('Pwm')[1]/PwmGeneral/PwmTypeofInterruptFunction = 'PWM_ISR_CAT2'"!][!//
                  <INTERRUPT-CATEGORY>CAT-2</INTERRUPT-CATEGORY>
                  [!ELSE!][!//
                  <INTERRUPT-CATEGORY>CAT-1</INTERRUPT-CATEGORY>
                  [!ENDIF!][!//
                  <INTERRUPT-SOURCE>Hardware</INTERRUPT-SOURCE>
                </BSW-INTERRUPT-ENTITY>
                [!ENDIF!][!//
                [!IF "PwmChannelId = '89'"!][!//
                <BSW-INTERRUPT-ENTITY UUID="852f78d4-6c36-419c-8db0-98b1da21f419">
                  <SHORT-NAME>Pwm_Ch89Isr</SHORT-NAME>
                  <MINIMUM-START-INTERVAL>0.0</MINIMUM-START-INTERVAL>
                  <REENTRANCY-LEVEL>NON-REENTRANT</REENTRANCY-LEVEL>
                  <IMPLEMENTED-ENTRY-REF DEST="BSW-MODULE-ENTRY">/Pwm_TI_AM263Px/Pwm_ModuleEntry/Pwm_Ch89Isr</IMPLEMENTED-ENTRY-REF>
                  [!IF "as:modconf('Pwm')[1]/PwmGeneral/PwmTypeofInterruptFunction = 'PWM_ISR_CAT2'"!][!//
                  <INTERRUPT-CATEGORY>CAT-2</INTERRUPT-CATEGORY>
                  [!ELSE!][!//
                  <INTERRUPT-CATEGORY>CAT-1</INTERRUPT-CATEGORY>
                  [!ENDIF!][!//
                  <INTERRUPT-SOURCE>Hardware</INTERRUPT-SOURCE>
                </BSW-INTERRUPT-ENTITY>
                [!ENDIF!][!//
                [!IF "PwmChannelId = '8'"!][!//
                <BSW-INTERRUPT-ENTITY UUID="f6be7c68-f351-4a48-83dd-8bd30cfa6d06">
                  <SHORT-NAME>Pwm_Ch8Isr</SHORT-NAME>
                  <MINIMUM-START-INTERVAL>0.0</MINIMUM-START-INTERVAL>
                  <REENTRANCY-LEVEL>NON-REENTRANT</REENTRANCY-LEVEL>
                  <IMPLEMENTED-ENTRY-REF DEST="BSW-MODULE-ENTRY">/Pwm_TI_AM263Px/Pwm_ModuleEntry/Pwm_Ch8Isr</IMPLEMENTED-ENTRY-REF>
                  [!IF "as:modconf('Pwm')[1]/PwmGeneral/PwmTypeofInterruptFunction = 'PWM_ISR_CAT2'"!][!//
                  <INTERRUPT-CATEGORY>CAT-2</INTERRUPT-CATEGORY>
                  [!ELSE!][!//
                  <INTERRUPT-CATEGORY>CAT-1</INTERRUPT-CATEGORY>
                  [!ENDIF!][!//
                  <INTERRUPT-SOURCE>Hardware</INTERRUPT-SOURCE>
                </BSW-INTERRUPT-ENTITY>
                [!ENDIF!][!//
                [!IF "PwmChannelId = '90'"!][!//
                <BSW-INTERRUPT-ENTITY UUID="2eb90e42-aa12-4dfb-8659-30173c8cb0ec">
                  <SHORT-NAME>Pwm_Ch90Isr</SHORT-NAME>
                  <MINIMUM-START-INTERVAL>0.0</MINIMUM-START-INTERVAL>
                  <REENTRANCY-LEVEL>NON-REENTRANT</REENTRANCY-LEVEL>
                  <IMPLEMENTED-ENTRY-REF DEST="BSW-MODULE-ENTRY">/Pwm_TI_AM263Px/Pwm_ModuleEntry/Pwm_Ch90Isr</IMPLEMENTED-ENTRY-REF>
                  [!IF "as:modconf('Pwm')[1]/PwmGeneral/PwmTypeofInterruptFunction = 'PWM_ISR_CAT2'"!][!//
                  <INTERRUPT-CATEGORY>CAT-2</INTERRUPT-CATEGORY>
                  [!ELSE!][!//
                  <INTERRUPT-CATEGORY>CAT-1</INTERRUPT-CATEGORY>
                  [!ENDIF!][!//
                  <INTERRUPT-SOURCE>Hardware</INTERRUPT-SOURCE>
                </BSW-INTERRUPT-ENTITY>
                [!ENDIF!][!//
                [!IF "PwmChannelId = '91'"!][!//
                <BSW-INTERRUPT-ENTITY UUID="37169f73-2857-4d1b-b182-b129e826eedf">
                  <SHORT-NAME>Pwm_Ch91Isr</SHORT-NAME>
                  <MINIMUM-START-INTERVAL>0.0</MINIMUM-START-INTERVAL>
                  <REENTRANCY-LEVEL>NON-REENTRANT</REENTRANCY-LEVEL>
                  <IMPLEMENTED-ENTRY-REF DEST="BSW-MODULE-ENTRY">/Pwm_TI_AM263Px/Pwm_ModuleEntry/Pwm_Ch91Isr</IMPLEMENTED-ENTRY-REF>
                  [!IF "as:modconf('Pwm')[1]/PwmGeneral/PwmTypeofInterruptFunction = 'PWM_ISR_CAT2'"!][!//
                  <INTERRUPT-CATEGORY>CAT-2</INTERRUPT-CATEGORY>
                  [!ELSE!][!//
                  <INTERRUPT-CATEGORY>CAT-1</INTERRUPT-CATEGORY>
                  [!ENDIF!][!//
                  <INTERRUPT-SOURCE>Hardware</INTERRUPT-SOURCE>
                </BSW-INTERRUPT-ENTITY>
                [!ENDIF!][!//
                [!IF "PwmChannelId = '92'"!][!//
                <BSW-INTERRUPT-ENTITY UUID="c5d16d5a-3ae5-4995-93e7-7f59e05a1b27">
                  <SHORT-NAME>Pwm_Ch92Isr</SHORT-NAME>
                  <MINIMUM-START-INTERVAL>0.0</MINIMUM-START-INTERVAL>
                  <REENTRANCY-LEVEL>NON-REENTRANT</REENTRANCY-LEVEL>
                  <IMPLEMENTED-ENTRY-REF DEST="BSW-MODULE-ENTRY">/Pwm_TI_AM263Px/Pwm_ModuleEntry/Pwm_Ch92Isr</IMPLEMENTED-ENTRY-REF>
                  [!IF "as:modconf('Pwm')[1]/PwmGeneral/PwmTypeofInterruptFunction = 'PWM_ISR_CAT2'"!][!//
                  <INTERRUPT-CATEGORY>CAT-2</INTERRUPT-CATEGORY>
                  [!ELSE!][!//
                  <INTERRUPT-CATEGORY>CAT-1</INTERRUPT-CATEGORY>
                  [!ENDIF!][!//
                  <INTERRUPT-SOURCE>Hardware</INTERRUPT-SOURCE>
                </BSW-INTERRUPT-ENTITY>
                [!ENDIF!][!//
                [!IF "PwmChannelId = '93'"!][!//
                <BSW-INTERRUPT-ENTITY UUID="00032c7c-599d-414b-a12b-087c16c49a08">
                  <SHORT-NAME>Pwm_Ch93Isr</SHORT-NAME>
                  <MINIMUM-START-INTERVAL>0.0</MINIMUM-START-INTERVAL>
                  <REENTRANCY-LEVEL>NON-REENTRANT</REENTRANCY-LEVEL>
                  <IMPLEMENTED-ENTRY-REF DEST="BSW-MODULE-ENTRY">/Pwm_TI_AM263Px/Pwm_ModuleEntry/Pwm_Ch93Isr</IMPLEMENTED-ENTRY-REF>
                  [!IF "as:modconf('Pwm')[1]/PwmGeneral/PwmTypeofInterruptFunction = 'PWM_ISR_CAT2'"!][!//
                  <INTERRUPT-CATEGORY>CAT-2</INTERRUPT-CATEGORY>
                  [!ELSE!][!//
                  <INTERRUPT-CATEGORY>CAT-1</INTERRUPT-CATEGORY>
                  [!ENDIF!][!//
                  <INTERRUPT-SOURCE>Hardware</INTERRUPT-SOURCE>
                </BSW-INTERRUPT-ENTITY>
                [!ENDIF!][!//
                [!IF "PwmChannelId = '94'"!][!//
                <BSW-INTERRUPT-ENTITY UUID="e2c7f5b8-deb3-4921-a1e1-21e9c0ce2afa">
                  <SHORT-NAME>Pwm_Ch94Isr</SHORT-NAME>
                  <MINIMUM-START-INTERVAL>0.0</MINIMUM-START-INTERVAL>
                  <REENTRANCY-LEVEL>NON-REENTRANT</REENTRANCY-LEVEL>
                  <IMPLEMENTED-ENTRY-REF DEST="BSW-MODULE-ENTRY">/Pwm_TI_AM263Px/Pwm_ModuleEntry/Pwm_Ch94Isr</IMPLEMENTED-ENTRY-REF>
                  [!IF "as:modconf('Pwm')[1]/PwmGeneral/PwmTypeofInterruptFunction = 'PWM_ISR_CAT2'"!][!//
                  <INTERRUPT-CATEGORY>CAT-2</INTERRUPT-CATEGORY>
                  [!ELSE!][!//
                  <INTERRUPT-CATEGORY>CAT-1</INTERRUPT-CATEGORY>
                  [!ENDIF!][!//
                  <INTERRUPT-SOURCE>Hardware</INTERRUPT-SOURCE>
                </BSW-INTERRUPT-ENTITY>
                [!ENDIF!][!//
                [!IF "PwmChannelId = '95'"!][!//
                <BSW-INTERRUPT-ENTITY UUID="0798c3b6-ec7d-453c-bf47-f2e11b9ca31b">
                  <SHORT-NAME>Pwm_Ch95Isr</SHORT-NAME>
                  <MINIMUM-START-INTERVAL>0.0</MINIMUM-START-INTERVAL>
                  <REENTRANCY-LEVEL>NON-REENTRANT</REENTRANCY-LEVEL>
                  <IMPLEMENTED-ENTRY-REF DEST="BSW-MODULE-ENTRY">/Pwm_TI_AM263Px/Pwm_ModuleEntry/Pwm_Ch95Isr</IMPLEMENTED-ENTRY-REF>
                  [!IF "as:modconf('Pwm')[1]/PwmGeneral/PwmTypeofInterruptFunction = 'PWM_ISR_CAT2'"!][!//
                  <INTERRUPT-CATEGORY>CAT-2</INTERRUPT-CATEGORY>
                  [!ELSE!][!//
                  <INTERRUPT-CATEGORY>CAT-1</INTERRUPT-CATEGORY>
                  [!ENDIF!][!//
                  <INTERRUPT-SOURCE>Hardware</INTERRUPT-SOURCE>
                </BSW-INTERRUPT-ENTITY>
                [!ENDIF!][!//
                [!IF "PwmChannelId = '96'"!][!//
                <BSW-INTERRUPT-ENTITY UUID="cba2b117-da84-487f-ad76-0a74448c850d">
                  <SHORT-NAME>Pwm_Ch96Isr</SHORT-NAME>
                  <MINIMUM-START-INTERVAL>0.0</MINIMUM-START-INTERVAL>
                  <REENTRANCY-LEVEL>NON-REENTRANT</REENTRANCY-LEVEL>
                  <IMPLEMENTED-ENTRY-REF DEST="BSW-MODULE-ENTRY">/Pwm_TI_AM263Px/Pwm_ModuleEntry/Pwm_Ch96Isr</IMPLEMENTED-ENTRY-REF>
                  [!IF "as:modconf('Pwm')[1]/PwmGeneral/PwmTypeofInterruptFunction = 'PWM_ISR_CAT2'"!][!//
                  <INTERRUPT-CATEGORY>CAT-2</INTERRUPT-CATEGORY>
                  [!ELSE!][!//
                  <INTERRUPT-CATEGORY>CAT-1</INTERRUPT-CATEGORY>
                  [!ENDIF!][!//
                  <INTERRUPT-SOURCE>Hardware</INTERRUPT-SOURCE>
                </BSW-INTERRUPT-ENTITY>
                [!ENDIF!][!//
                [!IF "PwmChannelId = '97'"!][!//
                <BSW-INTERRUPT-ENTITY UUID="3f440927-e65c-4ad7-a75c-791646da2580">
                  <SHORT-NAME>Pwm_Ch97Isr</SHORT-NAME>
                  <MINIMUM-START-INTERVAL>0.0</MINIMUM-START-INTERVAL>
                  <REENTRANCY-LEVEL>NON-REENTRANT</REENTRANCY-LEVEL>
                  <IMPLEMENTED-ENTRY-REF DEST="BSW-MODULE-ENTRY">/Pwm_TI_AM263Px/Pwm_ModuleEntry/Pwm_Ch97Isr</IMPLEMENTED-ENTRY-REF>
                  [!IF "as:modconf('Pwm')[1]/PwmGeneral/PwmTypeofInterruptFunction = 'PWM_ISR_CAT2'"!][!//
                  <INTERRUPT-CATEGORY>CAT-2</INTERRUPT-CATEGORY>
                  [!ELSE!][!//
                  <INTERRUPT-CATEGORY>CAT-1</INTERRUPT-CATEGORY>
                  [!ENDIF!][!//
                  <INTERRUPT-SOURCE>Hardware</INTERRUPT-SOURCE>
                </BSW-INTERRUPT-ENTITY>
                [!ENDIF!][!//
                [!IF "PwmChannelId = '98'"!][!//
                <BSW-INTERRUPT-ENTITY UUID="31da4476-e31c-4903-91c4-189d2f9af41d">
                  <SHORT-NAME>Pwm_Ch98Isr</SHORT-NAME>
                  <MINIMUM-START-INTERVAL>0.0</MINIMUM-START-INTERVAL>
                  <REENTRANCY-LEVEL>NON-REENTRANT</REENTRANCY-LEVEL>
                  <IMPLEMENTED-ENTRY-REF DEST="BSW-MODULE-ENTRY">/Pwm_TI_AM263Px/Pwm_ModuleEntry/Pwm_Ch98Isr</IMPLEMENTED-ENTRY-REF>
                  [!IF "as:modconf('Pwm')[1]/PwmGeneral/PwmTypeofInterruptFunction = 'PWM_ISR_CAT2'"!][!//
                  <INTERRUPT-CATEGORY>CAT-2</INTERRUPT-CATEGORY>
                  [!ELSE!][!//
                  <INTERRUPT-CATEGORY>CAT-1</INTERRUPT-CATEGORY>
                  [!ENDIF!][!//
                  <INTERRUPT-SOURCE>Hardware</INTERRUPT-SOURCE>
                </BSW-INTERRUPT-ENTITY>
                [!ENDIF!][!//
                [!IF "PwmChannelId = '99'"!][!//
                <BSW-INTERRUPT-ENTITY UUID="41f070e0-475a-48d9-8cf0-bf24343ed970">
                  <SHORT-NAME>Pwm_Ch99Isr</SHORT-NAME>
                  <MINIMUM-START-INTERVAL>0.0</MINIMUM-START-INTERVAL>
                  <REENTRANCY-LEVEL>NON-REENTRANT</REENTRANCY-LEVEL>
                  <IMPLEMENTED-ENTRY-REF DEST="BSW-MODULE-ENTRY">/Pwm_TI_AM263Px/Pwm_ModuleEntry/Pwm_Ch99Isr</IMPLEMENTED-ENTRY-REF>
                  [!IF "as:modconf('Pwm')[1]/PwmGeneral/PwmTypeofInterruptFunction = 'PWM_ISR_CAT2'"!][!//
                  <INTERRUPT-CATEGORY>CAT-2</INTERRUPT-CATEGORY>
                  [!ELSE!][!//
                  <INTERRUPT-CATEGORY>CAT-1</INTERRUPT-CATEGORY>
                  [!ENDIF!][!//
                  <INTERRUPT-SOURCE>Hardware</INTERRUPT-SOURCE>
                </BSW-INTERRUPT-ENTITY>
                [!ENDIF!][!//
                [!IF "PwmChannelId = '9'"!][!//
                <BSW-INTERRUPT-ENTITY UUID="62b6aa11-3d86-4aca-b095-0f1fd4d9a330">
                  <SHORT-NAME>Pwm_Ch9Isr</SHORT-NAME>
                  <MINIMUM-START-INTERVAL>0.0</MINIMUM-START-INTERVAL>
                  <REENTRANCY-LEVEL>NON-REENTRANT</REENTRANCY-LEVEL>
                  <IMPLEMENTED-ENTRY-REF DEST="BSW-MODULE-ENTRY">/Pwm_TI_AM263Px/Pwm_ModuleEntry/Pwm_Ch9Isr</IMPLEMENTED-ENTRY-REF>
                  [!IF "as:modconf('Pwm')[1]/PwmGeneral/PwmTypeofInterruptFunction = 'PWM_ISR_CAT2'"!][!//
                  <INTERRUPT-CATEGORY>CAT-2</INTERRUPT-CATEGORY>
                  [!ELSE!][!//
                  <INTERRUPT-CATEGORY>CAT-1</INTERRUPT-CATEGORY>
                  [!ENDIF!][!//
                  <INTERRUPT-SOURCE>Hardware</INTERRUPT-SOURCE>
                </BSW-INTERRUPT-ENTITY>
                [!ENDIF!][!//
                [!ENDLOOP!][!//
                [!IF "as:modconf('Pwm')[1]/PwmConfigurationOfOptApiServices/PwmDeInitApi = 'true'"!][!//
                <BSW-CALLED-ENTITY UUID="836c9c4c-c0c5-4db2-bf6d-3b54f782bc28">
                  <SHORT-NAME>Pwm_DeInit</SHORT-NAME>
                  <MINIMUM-START-INTERVAL>0.0</MINIMUM-START-INTERVAL>
                  <REENTRANCY-LEVEL>NON-REENTRANT</REENTRANCY-LEVEL>
                  <CALL-POINTS>
                    [!IF "as:modconf('Pwm')[1]/PwmGeneral/PwmDevErrorDetect = 'true'"!][!//
                    <BSW-DIRECT-CALL-POINT>
                      <SHORT-NAME>Det_ReportError</SHORT-NAME>
                      <CALLED-ENTRY-REF DEST="BSW-MODULE-ENTRY">/AUTOSAR_Det/BSWModuleEntry/Det_ReportError</CALLED-ENTRY-REF>
                    </BSW-DIRECT-CALL-POINT>
                    [!ENDIF!][!//
                  </CALL-POINTS>
                  <IMPLEMENTED-ENTRY-REF DEST="BSW-MODULE-ENTRY">/Pwm_TI_AM263Px/Pwm_ModuleEntry/Pwm_DeInit</IMPLEMENTED-ENTRY-REF>
                </BSW-CALLED-ENTITY>
                [!ENDIF!][!//
                [!IF "as:modconf('Pwm')[1]/PwmGeneral/PwmNotificationSupported = 'true'"!][!//
                <BSW-CALLED-ENTITY UUID="bb0a1c3b-4f62-414f-802a-dc55a91dc4d9">
                  <SHORT-NAME>Pwm_DisableNotification</SHORT-NAME>
                  <CAN-ENTER-EXCLUSIVE-AREA-REFS>
                    <CAN-ENTER-EXCLUSIVE-AREA-REF DEST="EXCLUSIVE-AREA">/Pwm_TI_AM263Px/Pwm/Pwm_Behavior/PWM_EXCLUSIVE_AREA_0</CAN-ENTER-EXCLUSIVE-AREA-REF>
                  </CAN-ENTER-EXCLUSIVE-AREA-REFS>
                  <MINIMUM-START-INTERVAL>0.0</MINIMUM-START-INTERVAL>
                  <REENTRANCY-LEVEL>SINGLE-CORE-REENTRANT</REENTRANCY-LEVEL>
                  <CALL-POINTS>
                    [!IF "as:modconf('Pwm')[1]/PwmGeneral/PwmDevErrorDetect = 'true'"!][!//
                    <BSW-DIRECT-CALL-POINT>
                      <SHORT-NAME>Det_ReportError</SHORT-NAME>
                      <CALLED-ENTRY-REF DEST="BSW-MODULE-ENTRY">/AUTOSAR_Det/BSWModuleEntry/Det_ReportError</CALLED-ENTRY-REF>
                    </BSW-DIRECT-CALL-POINT>
                    [!ENDIF!][!//
                  </CALL-POINTS>
                  <IMPLEMENTED-ENTRY-REF DEST="BSW-MODULE-ENTRY">/Pwm_TI_AM263Px/Pwm_ModuleEntry/Pwm_DisableNotification</IMPLEMENTED-ENTRY-REF>
                </BSW-CALLED-ENTITY>
                [!ENDIF!][!//
                [!IF "as:modconf('Pwm')[1]/PwmGeneral/PwmNotificationSupported = 'true'"!][!//
                <BSW-CALLED-ENTITY UUID="1604a95b-5f19-4931-9f2c-e591a5a5bb21">
                  <SHORT-NAME>Pwm_EnableNotification</SHORT-NAME>
                  <CAN-ENTER-EXCLUSIVE-AREA-REFS>
                    <CAN-ENTER-EXCLUSIVE-AREA-REF DEST="EXCLUSIVE-AREA">/Pwm_TI_AM263Px/Pwm/Pwm_Behavior/PWM_EXCLUSIVE_AREA_0</CAN-ENTER-EXCLUSIVE-AREA-REF>
                  </CAN-ENTER-EXCLUSIVE-AREA-REFS>
                  <MINIMUM-START-INTERVAL>0.0</MINIMUM-START-INTERVAL>
                  <REENTRANCY-LEVEL>SINGLE-CORE-REENTRANT</REENTRANCY-LEVEL>
                  <CALL-POINTS>
                    [!IF "as:modconf('Pwm')[1]/PwmGeneral/PwmDevErrorDetect = 'true'"!][!//
                    <BSW-DIRECT-CALL-POINT>
                      <SHORT-NAME>Det_ReportError</SHORT-NAME>
                      <CALLED-ENTRY-REF DEST="BSW-MODULE-ENTRY">/AUTOSAR_Det/BSWModuleEntry/Det_ReportError</CALLED-ENTRY-REF>
                    </BSW-DIRECT-CALL-POINT>
                    [!ENDIF!][!//
                  </CALL-POINTS>
                  <IMPLEMENTED-ENTRY-REF DEST="BSW-MODULE-ENTRY">/Pwm_TI_AM263Px/Pwm_ModuleEntry/Pwm_EnableNotification</IMPLEMENTED-ENTRY-REF>
                </BSW-CALLED-ENTITY>
                [!ENDIF!][!//
                [!IF "as:modconf('Pwm')[1]/PwmConfigurationOfOptApiServices/PwmGetOutputState = 'true'"!][!//
                <BSW-CALLED-ENTITY UUID="b41ff77a-b500-4861-a0e4-ed4bce1f1d17">
                  <SHORT-NAME>Pwm_GetOutputState</SHORT-NAME>
                  <MINIMUM-START-INTERVAL>0.0</MINIMUM-START-INTERVAL>
                  <REENTRANCY-LEVEL>NON-REENTRANT</REENTRANCY-LEVEL>
                  <IMPLEMENTED-ENTRY-REF DEST="BSW-MODULE-ENTRY">/Pwm_TI_AM263Px/Pwm_ModuleEntry/Pwm_GetOutputState</IMPLEMENTED-ENTRY-REF>
                </BSW-CALLED-ENTITY>
                [!ENDIF!][!//
                [!IF "as:modconf('Pwm')[1]/PwmConfigurationOfOptApiServices/PwmVersionInfoApi = 'true'"!][!//
                <BSW-CALLED-ENTITY UUID="fa050e85-f71d-4836-b4c7-5b6fabf04410">
                  <SHORT-NAME>Pwm_GetVersionInfo</SHORT-NAME>
                  <MINIMUM-START-INTERVAL>0.0</MINIMUM-START-INTERVAL>
                  <REENTRANCY-LEVEL>SINGLE-CORE-REENTRANT</REENTRANCY-LEVEL>
                  <CALL-POINTS>
                    [!IF "as:modconf('Pwm')[1]/PwmGeneral/PwmDevErrorDetect = 'true'"!][!//
                    <BSW-DIRECT-CALL-POINT>
                      <SHORT-NAME>Det_ReportError</SHORT-NAME>
                      <CALLED-ENTRY-REF DEST="BSW-MODULE-ENTRY">/AUTOSAR_Det/BSWModuleEntry/Det_ReportError</CALLED-ENTRY-REF>
                    </BSW-DIRECT-CALL-POINT>
                    [!ENDIF!][!//
                  </CALL-POINTS>
                  <IMPLEMENTED-ENTRY-REF DEST="BSW-MODULE-ENTRY">/Pwm_TI_AM263Px/Pwm_ModuleEntry/Pwm_GetVersionInfo</IMPLEMENTED-ENTRY-REF>
                </BSW-CALLED-ENTITY>
                [!ENDIF!][!//
                <BSW-CALLED-ENTITY UUID="42526311-e4d8-43e7-83f5-582fe8619ae4">
                  <SHORT-NAME>Pwm_Init</SHORT-NAME>
                  <MINIMUM-START-INTERVAL>0.0</MINIMUM-START-INTERVAL>
                  <REENTRANCY-LEVEL>NON-REENTRANT</REENTRANCY-LEVEL>
                  <CALL-POINTS>
                    [!IF "as:modconf('Pwm')[1]/PwmGeneral/PwmDevErrorDetect = 'true'"!][!//
                    <BSW-DIRECT-CALL-POINT>
                      <SHORT-NAME>Det_ReportError</SHORT-NAME>
                      <CALLED-ENTRY-REF DEST="BSW-MODULE-ENTRY">/AUTOSAR_Det/BSWModuleEntry/Det_ReportError</CALLED-ENTRY-REF>
                    </BSW-DIRECT-CALL-POINT>
                    [!ENDIF!][!//
                  </CALL-POINTS>
                  <IMPLEMENTED-ENTRY-REF DEST="BSW-MODULE-ENTRY">/Pwm_TI_AM263Px/Pwm_ModuleEntry/Pwm_Init</IMPLEMENTED-ENTRY-REF>
                </BSW-CALLED-ENTITY>
                [!IF "as:modconf('Pwm')[1]/PwmConfigurationOfOptApiServices/PwmEnableRegisterReadbackApi = 'true'"!][!//
                <BSW-CALLED-ENTITY UUID="3dfc0aa5-b8d7-4ef7-bf7c-d168a2289457">
                  <SHORT-NAME>Pwm_RegisterReadback</SHORT-NAME>
                  <MINIMUM-START-INTERVAL>0.0</MINIMUM-START-INTERVAL>
                  <REENTRANCY-LEVEL>SINGLE-CORE-REENTRANT</REENTRANCY-LEVEL>
                  <CALL-POINTS>
                    [!IF "as:modconf('Pwm')[1]/PwmGeneral/PwmDevErrorDetect = 'true'"!][!//
                    <BSW-DIRECT-CALL-POINT>
                      <SHORT-NAME>Det_ReportError</SHORT-NAME>
                      <CALLED-ENTRY-REF DEST="BSW-MODULE-ENTRY">/AUTOSAR_Det/BSWModuleEntry/Det_ReportError</CALLED-ENTRY-REF>
                    </BSW-DIRECT-CALL-POINT>
                    [!ENDIF!][!//
                  </CALL-POINTS>
                  <IMPLEMENTED-ENTRY-REF DEST="BSW-MODULE-ENTRY">/Pwm_TI_AM263Px/Pwm_ModuleEntry/Pwm_RegisterReadback</IMPLEMENTED-ENTRY-REF>
                </BSW-CALLED-ENTITY>
                [!ENDIF!][!//
                [!IF "as:modconf('Pwm')[1]/PwmConfigurationOfOptApiServices/PwmSetDutyCycle = 'true'"!][!//
                <BSW-CALLED-ENTITY UUID="25af2770-4e48-4c69-83d3-0c9722d1d317">
                  <SHORT-NAME>Pwm_SetDutyCycle</SHORT-NAME>
                  <CAN-ENTER-EXCLUSIVE-AREA-REFS>
                    <CAN-ENTER-EXCLUSIVE-AREA-REF DEST="EXCLUSIVE-AREA">/Pwm_TI_AM263Px/Pwm/Pwm_Behavior/PWM_EXCLUSIVE_AREA_0</CAN-ENTER-EXCLUSIVE-AREA-REF>
                  </CAN-ENTER-EXCLUSIVE-AREA-REFS>
                  <MINIMUM-START-INTERVAL>0.0</MINIMUM-START-INTERVAL>
                  <REENTRANCY-LEVEL>SINGLE-CORE-REENTRANT</REENTRANCY-LEVEL>
                  <IMPLEMENTED-ENTRY-REF DEST="BSW-MODULE-ENTRY">/Pwm_TI_AM263Px/Pwm_ModuleEntry/Pwm_SetDutyCycle</IMPLEMENTED-ENTRY-REF>
                </BSW-CALLED-ENTITY>
                [!ENDIF!][!//
                [!IF "as:modconf('Pwm')[1]/PwmConfigurationOfOptApiServices/PwmSetOutputToIdle = 'true'"!][!//
                <BSW-CALLED-ENTITY UUID="240ddd05-fe4b-478c-adbe-ffa8c43c254f">
                  <SHORT-NAME>Pwm_SetOutputToIdle</SHORT-NAME>
                  <CAN-ENTER-EXCLUSIVE-AREA-REFS>
                    <CAN-ENTER-EXCLUSIVE-AREA-REF DEST="EXCLUSIVE-AREA">/Pwm_TI_AM263Px/Pwm/Pwm_Behavior/PWM_EXCLUSIVE_AREA_0</CAN-ENTER-EXCLUSIVE-AREA-REF>
                  </CAN-ENTER-EXCLUSIVE-AREA-REFS>
                  <MINIMUM-START-INTERVAL>0.0</MINIMUM-START-INTERVAL>
                  <REENTRANCY-LEVEL>SINGLE-CORE-REENTRANT</REENTRANCY-LEVEL>
                  <CALL-POINTS>
                    [!IF "as:modconf('Pwm')[1]/PwmGeneral/PwmDevErrorDetect = 'true'"!][!//
                    <BSW-DIRECT-CALL-POINT>
                      <SHORT-NAME>Det_ReportError</SHORT-NAME>
                      <CALLED-ENTRY-REF DEST="BSW-MODULE-ENTRY">/AUTOSAR_Det/BSWModuleEntry/Det_ReportError</CALLED-ENTRY-REF>
                    </BSW-DIRECT-CALL-POINT>
                    [!ENDIF!][!//
                  </CALL-POINTS>
                  <IMPLEMENTED-ENTRY-REF DEST="BSW-MODULE-ENTRY">/Pwm_TI_AM263Px/Pwm_ModuleEntry/Pwm_SetOutputToIdle</IMPLEMENTED-ENTRY-REF>
                </BSW-CALLED-ENTITY>
                [!ENDIF!][!//
                [!IF "as:modconf('Pwm')[1]/PwmConfigurationOfOptApiServices/PwmSetPeriodAndDuty = 'true'"!][!//
                <BSW-CALLED-ENTITY UUID="35dac5a9-edfc-43ef-970c-b31a587d9b6b">
                  <SHORT-NAME>Pwm_SetPeriodAndDuty</SHORT-NAME>
                  <CAN-ENTER-EXCLUSIVE-AREA-REFS>
                    <CAN-ENTER-EXCLUSIVE-AREA-REF DEST="EXCLUSIVE-AREA">/Pwm_TI_AM263Px/Pwm/Pwm_Behavior/PWM_EXCLUSIVE_AREA_0</CAN-ENTER-EXCLUSIVE-AREA-REF>
                  </CAN-ENTER-EXCLUSIVE-AREA-REFS>
                  <MINIMUM-START-INTERVAL>0.0</MINIMUM-START-INTERVAL>
                  <REENTRANCY-LEVEL>SINGLE-CORE-REENTRANT</REENTRANCY-LEVEL>
                  <CALL-POINTS>
                    [!IF "as:modconf('Pwm')[1]/PwmGeneral/PwmDevErrorDetect = 'true'"!][!//
                    <BSW-DIRECT-CALL-POINT>
                      <SHORT-NAME>Det_ReportError</SHORT-NAME>
                      <CALLED-ENTRY-REF DEST="BSW-MODULE-ENTRY">/AUTOSAR_Det/BSWModuleEntry/Det_ReportError</CALLED-ENTRY-REF>
                    </BSW-DIRECT-CALL-POINT>
                    [!ENDIF!][!//
                  </CALL-POINTS>
                  <IMPLEMENTED-ENTRY-REF DEST="BSW-MODULE-ENTRY">/Pwm_TI_AM263Px/Pwm_ModuleEntry/Pwm_SetPeriodAndDuty</IMPLEMENTED-ENTRY-REF>
                </BSW-CALLED-ENTITY>
                [!ENDIF!][!//
              </ENTITYS>
            </BSW-INTERNAL-BEHAVIOR>
          </INTERNAL-BEHAVIORS>
        </BSW-MODULE-DESCRIPTION>
        <BSW-IMPLEMENTATION UUID="47b6e6c5-163d-43bf-8ef4-bd195e008af7">
          <SHORT-NAME>Pwm_Impl</SHORT-NAME>
          <CODE-DESCRIPTORS>
            <CODE UUID="f88b9383-975f-412d-bce2-272fa3b5f335">
              <SHORT-NAME>Files</SHORT-NAME>
              <ARTIFACT-DESCRIPTORS>
                <AUTOSAR-ENGINEERING-OBJECT>
                  <SHORT-LABEL>V0::Pwm_Irq.c</SHORT-LABEL>
                  <CATEGORY>SWSRC</CATEGORY>
                </AUTOSAR-ENGINEERING-OBJECT>
                <AUTOSAR-ENGINEERING-OBJECT>
                  <SHORT-LABEL>V0::Pwm_Irq.h</SHORT-LABEL>
                  <CATEGORY>SWHDR</CATEGORY>
                </AUTOSAR-ENGINEERING-OBJECT>
                <AUTOSAR-ENGINEERING-OBJECT>
                  <SHORT-LABEL>V0::Pwm_Priv.c</SHORT-LABEL>
                  <CATEGORY>SWSRC</CATEGORY>
                </AUTOSAR-ENGINEERING-OBJECT>
                <AUTOSAR-ENGINEERING-OBJECT>
                  <SHORT-LABEL>V0::Pwm_Priv.h</SHORT-LABEL>
                  <CATEGORY>SWHDR</CATEGORY>
                </AUTOSAR-ENGINEERING-OBJECT>
                <AUTOSAR-ENGINEERING-OBJECT>
                  <SHORT-LABEL>V0::Pwm_Sfo.c</SHORT-LABEL>
                  <CATEGORY>SWSRC</CATEGORY>
                </AUTOSAR-ENGINEERING-OBJECT>
                <AUTOSAR-ENGINEERING-OBJECT>
                  <SHORT-LABEL>V0::Pwm_Sfo.h</SHORT-LABEL>
                  <CATEGORY>SWHDR</CATEGORY>
                </AUTOSAR-ENGINEERING-OBJECT>
                <AUTOSAR-ENGINEERING-OBJECT>
                  <SHORT-LABEL>generate::include::Pwm_Cfg.h</SHORT-LABEL>
                  <CATEGORY>SWHDR</CATEGORY>
                </AUTOSAR-ENGINEERING-OBJECT>
                <AUTOSAR-ENGINEERING-OBJECT>
                  <SHORT-LABEL>generate::src::Pwm_Cfg.c</SHORT-LABEL>
                  <CATEGORY>SWSRC</CATEGORY>
                </AUTOSAR-ENGINEERING-OBJECT>
                <AUTOSAR-ENGINEERING-OBJECT>
                  <SHORT-LABEL>generate::src::Pwm_PBcfg.c</SHORT-LABEL>
                  <CATEGORY>SWSRC</CATEGORY>
                </AUTOSAR-ENGINEERING-OBJECT>
                <AUTOSAR-ENGINEERING-OBJECT>
                  <SHORT-LABEL>include::Pwm.h</SHORT-LABEL>
                  <CATEGORY>SWHDR</CATEGORY>
                </AUTOSAR-ENGINEERING-OBJECT>
                <AUTOSAR-ENGINEERING-OBJECT>
                  <SHORT-LABEL>src::Pwm.c</SHORT-LABEL>
                  <CATEGORY>SWSRC</CATEGORY>
                </AUTOSAR-ENGINEERING-OBJECT>
              </ARTIFACT-DESCRIPTORS>
            </CODE>
          </CODE-DESCRIPTORS>
          <COMPILERS>
            <COMPILER UUID="f5284677-0f1d-4394-867e-f2ca293ad284">
              <SHORT-NAME>tiarmclang</SHORT-NAME>
              <NAME>TI ARM Clang</NAME>
              <OPTIONS>-mcpu=cortex-r5  -mfpu=vfpv3-d16  -mfloat-abi=hard  -c  -mlittle-endian  -ffunction-sections  -gdwarf-3  -Werror -Os  -x  -save-temps  -mthumb  -DAM263PX_SIP_PACKAGE  -DAM263PX_PLATFORM -DAM263PX_R_PACKAGE -DAM263PX_C_PACKAGE </OPTIONS>
              <VENDOR>Texas Instruments</VENDOR>
              <VERSION>4.0.0</VERSION>
            </COMPILER>
          </COMPILERS>
          <LINKERS>
            <LINKER UUID="ca019926-b7a6-499e-be37-4615fdd0dddc">
              <SHORT-NAME>tiarmlnk</SHORT-NAME>
              <NAME>TI ARM Clang Linker</NAME>
              <OPTIONS>-mcpu=cortex-r5  -Wl,--ram_model  -Wl,--reread_libs  -Wl,--warn_sections  -qq -Wl,--emit_warnings_as_errors --diag_suppress=10068 --diag_suppress=10063 </OPTIONS>
              <VENDOR>Texas Instruments</VENDOR>
              <VERSION>4.0.0</VERSION>
            </LINKER>
          </LINKERS>
          <PROGRAMMING-LANGUAGE>C</PROGRAMMING-LANGUAGE>
          <RESOURCE-CONSUMPTION UUID="a53c868a-5ee2-49bd-80a7-207d623f9864">
            <SHORT-NAME>ResourceConsumption</SHORT-NAME>
            <MEMORY-SECTIONS>
              <MEMORY-SECTION UUID="7c33b5f9-d314-45ca-8376-3d90751d9449">
                <SHORT-NAME>PWM_CODE</SHORT-NAME>
                <ALIGNMENT>UNSPECIFIED</ALIGNMENT>
                <SW-ADDRMETHOD-REF DEST="SW-ADDR-METHOD">/AUTOSAR_MemMap/SwAddrMethods/CODE</SW-ADDRMETHOD-REF>
                <SYMBOL>CODE</SYMBOL>
              </MEMORY-SECTION>
              <MEMORY-SECTION UUID="f3e0455f-617b-4d98-990a-29761e661cb6">
                <SHORT-NAME>PWM_CONFIG_DATA</SHORT-NAME>
                <ALIGNMENT>UNSPECIFIED</ALIGNMENT>
                <SW-ADDRMETHOD-REF DEST="SW-ADDR-METHOD">/AUTOSAR_MemMap/SwAddrMethods/CONFIG_DATA</SW-ADDRMETHOD-REF>
                <SYMBOL>CONFIG_DATA</SYMBOL>
              </MEMORY-SECTION>
              <MEMORY-SECTION UUID="2e3f49c5-9c77-4f78-80c6-a5a5283cf24f">
                <SHORT-NAME>PWM_ISR_CODE</SHORT-NAME>
                <ALIGNMENT>UNSPECIFIED</ALIGNMENT>
                <SW-ADDRMETHOD-REF DEST="SW-ADDR-METHOD">/AUTOSAR_MemMap/SwAddrMethods/CODE</SW-ADDRMETHOD-REF>
                <SYMBOL>ISR_CODE</SYMBOL>
              </MEMORY-SECTION>
              <MEMORY-SECTION UUID="0f9eff5a-245d-4d91-83a2-c2869664d3cb">
                <SHORT-NAME>PWM_VAR_INIT_32</SHORT-NAME>
                <ALIGNMENT>32</ALIGNMENT>
                <SW-ADDRMETHOD-REF DEST="SW-ADDR-METHOD">/AUTOSAR_MemMap/SwAddrMethods/VAR_INIT</SW-ADDRMETHOD-REF>
                <SYMBOL>VAR_INIT_32</SYMBOL>
              </MEMORY-SECTION>
              <MEMORY-SECTION UUID="acb1525c-acf1-42bd-b242-aa9b04cbb8b0">
                <SHORT-NAME>PWM_VAR_INIT_8</SHORT-NAME>
                <ALIGNMENT>8</ALIGNMENT>
                <SW-ADDRMETHOD-REF DEST="SW-ADDR-METHOD">/AUTOSAR_MemMap/SwAddrMethods/VAR_INIT</SW-ADDRMETHOD-REF>
                <SYMBOL>VAR_INIT_8</SYMBOL>
              </MEMORY-SECTION>
              <MEMORY-SECTION UUID="13039ea3-837c-4f39-8115-b780e4bd4317">
                <SHORT-NAME>PWM_VAR_NO_INIT_32</SHORT-NAME>
                <ALIGNMENT>32</ALIGNMENT>
                <SW-ADDRMETHOD-REF DEST="SW-ADDR-METHOD">/AUTOSAR_MemMap/SwAddrMethods/VAR_NO_INIT</SW-ADDRMETHOD-REF>
                <SYMBOL>VAR_NO_INIT_32</SYMBOL>
              </MEMORY-SECTION>
              <MEMORY-SECTION UUID="9b0c64b6-1e53-4980-9be5-76804fa06044">
                <SHORT-NAME>PWM_VAR_NO_INIT_UNSPECIFIED</SHORT-NAME>
                <ALIGNMENT>UNSPECIFIED</ALIGNMENT>
                <SW-ADDRMETHOD-REF DEST="SW-ADDR-METHOD">/AUTOSAR_MemMap/SwAddrMethods/VAR_NO_INIT</SW-ADDRMETHOD-REF>
                <SYMBOL>VAR_NO_INIT_UNSPECIFIED</SYMBOL>
              </MEMORY-SECTION>
            </MEMORY-SECTIONS>
          </RESOURCE-CONSUMPTION>
          <SW-VERSION>10.01.00</SW-VERSION>
          <VENDOR-ID>44</VENDOR-ID>
          <AR-RELEASE-VERSION>4.3.1</AR-RELEASE-VERSION>
          <BEHAVIOR-REF DEST="BSW-INTERNAL-BEHAVIOR">/Pwm_TI_AM263Px/Pwm/Pwm_Behavior</BEHAVIOR-REF>
          <VENDOR-SPECIFIC-MODULE-DEF-REFS>
            <VENDOR-SPECIFIC-MODULE-DEF-REF DEST="ECUC-MODULE-DEF">/TI_AM263Px/Pwm</VENDOR-SPECIFIC-MODULE-DEF-REF>
          </VENDOR-SPECIFIC-MODULE-DEF-REFS>
        </BSW-IMPLEMENTATION>
      </ELEMENTS>
