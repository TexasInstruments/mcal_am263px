AUTOSAR XML (schema 00044)
package /TI_AM263Px
  module definition Pwm [0..*]: post-build-variant-support=true, refined-module-def=Pwm, variants post-build/pre-compile  # Configuration of Pwm (Pulse Width Modulation) module.
    container PwmChannelConfigSet  # This container contains the configuration parameters and sub containers of the AUTOSAR Pwm module.
      container PwmChannel [1..128]  # Configuration of an individual PWM channel.
        enumeration PwmChannelClass [0..1]: {PWM_FIXED_PERIOD, PWM_FIXED_PERIOD_SHIFTED, PWM_VARIABLE_PERIOD}, multiplicity set at post-build in variant post-build / pre-compile in variant pre-compile, post-build-variant-multiplicity=true, post-build-variant-value=true, set at post-build in variant post-build / pre-compile in variant pre-compile, default-value=PWM_FIXED_PERIOD  # Class of PWM Channel.
        integer PwmChannelId: 0..255, set at pre-compile, symbolic-name-value=true  # Channel Id of the PWM channel. This value will be assigned to the symbolic name derived of the PwmChannel container short name.
        integer PwmHWChannelId: 0..31, origin=Texas Instruments, set at pre-compile, default-value=0  # Channel Id of the PWM channel. This value will be assigned to the symbolic name derived of the PwmChannel container short name.
        enumeration PwmHwUnit: {PWM_CONTROLSS_G0, PWM_CONTROLSS_G1, PWM_CONTROLSS_G2, PWM_CONTROLSS_G3}, origin=Texas Instruments, post-build-variant-value=true, set at post-build in variant post-build / pre-compile in variant pre-compile, default-value=PWM_CONTROLSS_G0  # The parameter PWM_IDLE_STATE represents the output state of the PWM after the signal is stopped (e.g. call of Pwm_SetOutputToIdle).
        integer PwmDutycycleDefault: 0..32768, post-build-variant-value=true, set at post-build in variant post-build / pre-compile in variant pre-compile, default-value=16384  # Value of duty cycle used for Initialization
        enumeration PwmIdleState: {PWM_HIGH, PWM_LOW}, post-build-variant-value=true, set at post-build in variant post-build / pre-compile in variant pre-compile, default-value=PWM_HIGH  # The parameter PWM_IDLE_STATE represents the output state of the PWM after the signal is stopped (e.g. call of Pwm_SetOutputToIdle).
        function name PwmNotification [0..1]: multiplicity set at post-build in variant post-build / pre-compile in variant pre-compile, post-build-variant-multiplicity=true, post-build-variant-value=true, set at post-build in variant post-build / pre-compile in variant pre-compile, default-value=NULL_PTR  # Definition of the Callback function.
        float PwmPeriodDefault: 0.0..INF, post-build-variant-value=true, set at post-build in variant post-build / pre-compile in variant pre-compile, default-value=1.0  # Value of period used for Initialization.(in seconds).
        enumeration PwmOutputChSelect: {PWM_OUTPUT_CH_A, PWM_OUTPUT_CH_B, PWM_OUTPUT_CH_BOTH_A_AND_B}, origin=Texas Instruments, set at post-build in variant post-build / pre-compile in variant pre-compile, default-value=PWM_OUTPUT_CH_A  # PWM Output Channel select EPWMxA or EPWMxB or Both. Both Outputs available with same duty cycle, period and polarity.
        integer PwmFunctionalClock: origin=Texas Instruments, post-build-variant-value=true, set at post-build in variant post-build / pre-compile in variant pre-compile, default-value=19200000  # Value of the System clock frequency in Hz Default frequency is 125MHz for EPWM, and 25Mhz for GPT.
        enumeration PwmPolarity: {PWM_HIGH, PWM_LOW}, post-build-variant-value=true, set at post-build in variant post-build / pre-compile in variant pre-compile, default-value=PWM_HIGH  # Defines the starting polarity of each PWM channel.
        integer PwmClkPrescaler: 0..7, origin=Texas Instruments, set at post-build in variant post-build / pre-compile in variant pre-compile, default-value=0  # The clock to Timer module is divided by the value specified here TBCLK = SYSCLKOUT / PwmClkPrescaler 0x0 = div by 1, 0x1 = div by 2, 0x2 = div by 4, 0x3 = div by 8, 0x4 = div by 16, 0x5 = div by 32 0x6 = div by 64, 0x7 = div by 128
        integer PwmHSClkPrescaler: 0..7, origin=Texas Instruments, set at post-build in variant post-build / pre-compile in variant pre-compile, default-value=0  # High-Speed Time-base Clock Prescale Bits. These bits determine part of the time-base clock prescale value and acts as a clock divider for the time-base clock. TBCLK = SYSCLKOUT/(PwmHSClkPrescaler x PwmClkPrescaler) 0x0 = div by 1, 0x1 = div by 2, 0x2 = div by 4, 0x3 = div by 6, 0x4 = div by 8, 0x5 = div by 10 0x6 = div by 12, 0x7 = div by 14
        boolean PwmEnableHighRes: origin=Texas Instruments, set at post-build in variant post-build / pre-compile in variant pre-compile, default-value=false  # This parameter will be a switch to enable or disable high resolution (HRPWM) capability of EPWM module.
        reference PwmMcuClockReferencePoint [0..0]: scope=ECU, post-build-variant-value=true, set at post-build in variant post-build / pre-compile in variant pre-compile, destination=McuClockReferencePoint  # This parameter contains reference to the McuClockReferencePoint
    container PwmConfigurationOfOptApiServices
      boolean PwmDeInitApi: set at pre-compile, default-value=true  # Adds / removes the service Pwm_DeInit() from the code.
      boolean PwmGetOutputState: set at pre-compile, default-value=false
      boolean PwmSetDutyCycle: set at pre-compile, default-value=true
      boolean PwmSetOutputToIdle: set at pre-compile, default-value=true
      boolean PwmSetPeriodAndDuty: set at pre-compile, default-value=true
      boolean PwmVersionInfoApi: set at pre-compile, default-value=false  # Switch to indicate that the Pwm_ GetVersionInfo is supported
      boolean PwmEnableRegisterReadbackApi: origin=Texas Instruments, set at pre-compile, default-value=true  # Switch to indicate that the Pwm_RegisterReadBack is supported
    container PwmGeneral
      boolean PwmDevErrorDetect: set at pre-compile, default-value=true  # Switch for enabling the development error detection.
      integer PwmSysClockFrequency: 1..200000000, origin=Texas Instruments, post-build-variant-value=true, set at post-build in variant post-build / pre-compile in variant pre-compile  # Value of the System clock frequency in Hz Default frequency is 200MHz
      boolean PwmDutycycleUpdatedEndperiod: set at pre-compile, default-value=true  # Switch for enabling the update of the duty cycle parameter at the end of the current period.
      boolean PwmSfoSupportEnable: origin=Texas Instrument, set at pre-compile, default-value=false  # Switch for enabling the SFO Inclusion for HRPWM ,If HRPWM is enabled.
      integer PwmDefaultOSCounterId [0..1]: 0..16, origin=Texas Instruments, set at pre-compile, default-value=0  # Default Os Counter Id if node reference to OsCounter ref PwmOsCounterRef is not set
      integer PwmMaxTimeoutDuration: 1..4294967295, origin=Texas Instruments, set at pre-compile, default-value=10000  # Maximum time duration for PWM SFO status. Unit is in clock ticks. Configure the timeout according to r5f clock frequency(400MHz/200MHz)
      integer PwmIndex: 0..1, set at pre-compile, default-value=1  # Specifies the InstanceId of this module instance. If only one instance is present it shall have the Id 0.
      boolean PwmLowPowerStatesSupport [0..0]: multiplicity set at pre-compile, set at pre-compile, default-value=false  # Adds / removes all power state management related APIs (PWM_SetPowerState, PWM_GetCurrentPowerState, PWM_GetTargetPowerState, PWM_PreparePowerState, PWM_Main_PowerTransitionManager), indicating if the HW offers low power state management.This Feature is not supported
      boolean PwmNotificationSupported: set at pre-compile, default-value=true  # Switch to indicate that the notifications are supported
      boolean PwmPeriodUpdatedEndperiod: set at pre-compile, default-value=true  # Switch for enabling the update of the period parameter at the end of the current period.
      boolean PwmPowerStateAsynchTransitionMode [0..0]: multiplicity set at pre-compile, set at pre-compile, default-value=false  # Enables / disables support of the PWM Driver to the asynchronous power state transition.
      function name PwmErrorHook: origin=Texas Instruments, set at pre-compile, default-value=Det_ReportError  # ErrorHook Function | Used to report development errors.
      string PwmDetIncludeFile: origin=Texas Instruments, set at pre-compile, default-value=Det.h  # Include File | Includes the header file where the Error hook function is defined.
      string PwmNotificationsIncludeFile: origin=Texas Instruments, set at pre-compile  # Include File | Includes the header file where the notification functions are defined.
      boolean PwmCfgDebugReporting: origin=Texas Instruments, set at pre-compile, default-value=true  # Switch to Enable/disable debug support.
      enumeration PwmTypeofInterruptFunction: {PWM_ISR_VOID, PWM_ISR_CAT1, PWM_ISR_CAT2}, origin=Texas Instruments, set at pre-compile, default-value=PWM_ISR_CAT1  # Type of ISR function
      reference PwmOsCounterRef [0..1]: origin=Texas Instruments, set at pre-compile, destination=OsCounter  # This parameter contains a reference to the OsCounter, which is used by the PWM driver.
      container PwmPowerStateConfig [0..0]  # Each instance of this parameter defines a power state and the callback to be called when this power state is reached.
        integer PwmPowerState [0..0]: 0..9223372036854775807, set at pre-compile, symbolic-name-value=true  # Each instance of this parameter describes a different power state supported by the PWM HW. It should be defined by the HW supplier and used by the PWMDriver to reference specific HW configurations which set the PWM HW module in the referenced power state.This Feature is not supported
        function name PwmPowerStateReadyCbkRef [0..0]: set at pre-compile  # Each instance of this parameter contains a reference to a power mode callback defined in a CDD or IoHwAbs component.This Feature is not supported
    container PwmPublishedInformation  # Additional published parameters not covered by "Common" Published Information. Note that these parameters have "PUBLISHED-INFORMATION" configuration class setting, since they are published information.
      enumeration PwmDeviceVariant [0..1]: {AM263Px}, multiplicity set at published-information, origin=Texas Instruments, set at published-information, default-value=AM263Px  # Select SOC AM263Px variant
