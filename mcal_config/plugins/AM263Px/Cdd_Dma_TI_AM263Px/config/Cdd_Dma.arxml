AUTOSAR XML (schema 00044)
package /TI_AM263Px
  module definition Cdd_Dma [0..*]: refined-module-def=Cdd, variants pre-compile  # Configuration of the CDD (Complex Device Driver) DMA module.
    container CddDmaDriverHandler [1..64]: requires-index=true  # This container contains the configuration parameters and sub containers of the AUTOSAR Complex device driver (CDD) module.
      enumeration CddDmaTransferType: {CDD_DMA_TRANSFER_TYPE_UART_TX, CDD_DMA_TRANSFER_TYPE_UART_RX, CDD_DMA_TRANSFER_TYPE_ADC, CDD_DMA_TRANSFER_TYPE_MCSPI, CDD_DMA_TRANSFER_TYPE_MEMORY_TRANSFER, CDD_DMA_TRANSFER_TYPE_FLS}, origin=Texas Instruments, set at pre-compile, default-value=CDD_DMA_TRANSFER_TYPE_MEMORY_TRANSFER  # This parameter selects the desired Transfer Type.
      enumeration CddDmaInstance: {CDD_DMA_MSS_A}, origin=Texas Instruments, set at pre-compile, default-value=CDD_DMA_MSS_A  # This parameter selects the desired instance for DMA.
      integer CddDmaRegionID: 0..7, origin=Texas Instruments, set at pre-compile, default-value=0  # This parameter specifies the Region ID for EDMA.
      integer CddDmaTccNumber: 0..63, origin=Texas Instruments, set at pre-compile, default-value=0  # This parameter specifies the TCC number for EDMA.
      integer CddDmaQueueNumber: 0..1, origin=Texas Instruments, set at pre-compile, default-value=0  # This parameter specifies the Default Queue Number for EDMA.
      boolean CddDmaEnableInterrupt: origin=Texas Instruments, set at pre-compile, default-value=true  # This determines whether interrupt needs to be registered.
      enumeration CddDmaTransferModeSelect: {CDD_DMA_TRANSFER_MODE_NORMAL, CDD_DMA_TRANSFER_MODE_LINKING, CDD_DMA_TRANSFER_MODE_CHAINING}, origin=Texas Instruments, set at pre-compile, default-value=CDD_DMA_TRANSFER_MODE_NORMAL  # This parameter selects the desired Transfer Modeselect either normal or linking or chaining.
      container CddDmaChannelGroup [1..64]  # This container contains the DMA Channel Group.
        integer CddDmaChannel: 0..63, origin=Texas Instruments, set at pre-compile, default-value=0  # This parameter select the channel number to be used.
        container CddDmaParamSets [1..256]  # This container contains the DMA params.
          integer CddDmaPramNumber: 0..255, origin=Texas Instruments, set at pre-compile, default-value=0  # This parameter select the param number to be used.
      container CddDmaChannelTriggerConfiguration [0..64]  # This container contains the DMA Channel Trigger reasource.
        enumeration CddDmaDmaChannelModule: {CDD_DMA_TRIG_XBAR_EDMA_MODULE_0, CDD_DMA_TRIG_XBAR_EDMA_MODULE_1, CDD_DMA_TRIG_XBAR_EDMA_MODULE_2, CDD_DMA_TRIG_XBAR_EDMA_MODULE_3, CDD_DMA_TRIG_XBAR_EDMA_MODULE_4, CDD_DMA_TRIG_XBAR_EDMA_MODULE_5, CDD_DMA_TRIG_XBAR_EDMA_MODULE_6, CDD_DMA_TRIG_XBAR_EDMA_MODULE_7, CDD_DMA_TRIG_XBAR_EDMA_MODULE_8, CDD_DMA_TRIG_XBAR_EDMA_MODULE_9, CDD_DMA_TRIG_XBAR_EDMA_MODULE_10, CDD_DMA_TRIG_XBAR_EDMA_MODULE_11, CDD_DMA_TRIG_XBAR_EDMA_MODULE_12, CDD_DMA_TRIG_XBAR_EDMA_MODULE_13, CDD_DMA_TRIG_XBAR_EDMA_MODULE_14, CDD_DMA_TRIG_XBAR_EDMA_MODULE_15, CDD_DMA_TRIG_XBAR_EDMA_MODULE_16, CDD_DMA_TRIG_XBAR_EDMA_MODULE_17, CDD_DMA_TRIG_XBAR_EDMA_MODULE_18, CDD_DMA_TRIG_XBAR_EDMA_MODULE_19, CDD_DMA_TRIG_XBAR_EDMA_MODULE_20, CDD_DMA_TRIG_XBAR_EDMA_MODULE_21, CDD_DMA_TRIG_XBAR_EDMA_MODULE_22, CDD_DMA_TRIG_XBAR_EDMA_MODULE_23, CDD_DMA_TRIG_XBAR_EDMA_MODULE_24, CDD_DMA_TRIG_XBAR_EDMA_MODULE_25, CDD_DMA_TRIG_XBAR_EDMA_MODULE_26, CDD_DMA_TRIG_XBAR_EDMA_MODULE_27, CDD_DMA_TRIG_XBAR_EDMA_MODULE_28, CDD_DMA_TRIG_XBAR_EDMA_MODULE_29, CDD_DMA_TRIG_XBAR_EDMA_MODULE_30, CDD_DMA_TRIG_XBAR_EDMA_MODULE_31, CDD_DMA_TRIG_XBAR_EDMA_MODULE_32, CDD_DMA_TRIG_XBAR_EDMA_MODULE_33, CDD_DMA_TRIG_XBAR_EDMA_MODULE_34, CDD_DMA_TRIG_XBAR_EDMA_MODULE_35, CDD_DMA_TRIG_XBAR_EDMA_MODULE_36, CDD_DMA_TRIG_XBAR_EDMA_MODULE_37, CDD_DMA_TRIG_XBAR_EDMA_MODULE_38, CDD_DMA_TRIG_XBAR_EDMA_MODULE_39, CDD_DMA_TRIG_XBAR_EDMA_MODULE_40, CDD_DMA_TRIG_XBAR_EDMA_MODULE_41, CDD_DMA_TRIG_XBAR_EDMA_MODULE_42, CDD_DMA_TRIG_XBAR_EDMA_MODULE_43, CDD_DMA_TRIG_XBAR_EDMA_MODULE_44, CDD_DMA_TRIG_XBAR_EDMA_MODULE_45, CDD_DMA_TRIG_XBAR_EDMA_MODULE_46, CDD_DMA_TRIG_XBAR_EDMA_MODULE_47, CDD_DMA_TRIG_XBAR_EDMA_MODULE_48, CDD_DMA_TRIG_XBAR_EDMA_MODULE_49, CDD_DMA_TRIG_XBAR_EDMA_MODULE_50, CDD_DMA_TRIG_XBAR_EDMA_MODULE_51, CDD_DMA_TRIG_XBAR_EDMA_MODULE_52, CDD_DMA_TRIG_XBAR_EDMA_MODULE_53, CDD_DMA_TRIG_XBAR_EDMA_MODULE_54, CDD_DMA_TRIG_XBAR_EDMA_MODULE_55, CDD_DMA_TRIG_XBAR_EDMA_MODULE_56, CDD_DMA_TRIG_XBAR_EDMA_MODULE_57, CDD_DMA_TRIG_XBAR_EDMA_MODULE_58, CDD_DMA_TRIG_XBAR_EDMA_MODULE_59, CDD_DMA_TRIG_XBAR_EDMA_MODULE_60, CDD_DMA_TRIG_XBAR_EDMA_MODULE_61, CDD_DMA_TRIG_XBAR_EDMA_MODULE_62, CDD_DMA_TRIG_XBAR_EDMA_MODULE_63}, origin=Texas Instruments, set at pre-compile, default-value=CDD_DMA_TRIG_XBAR_EDMA_MODULE_0  # The DMA channel selected for module.
        enumeration CddDmaChannelTriggerSource: {CDD_DMA_TRIG_XBAR_LIN0_RXDMA, CDD_DMA_TRIG_XBAR_LIN0_TXDMA, CDD_DMA_TRIG_XBAR_LIN1_RXDMA, CDD_DMA_TRIG_XBAR_LIN1_TXDMA, CDD_DMA_TRIG_XBAR_LIN2_RXDMA, CDD_DMA_TRIG_XBAR_LIN2_TXDMA, CDD_DMA_TRIG_XBAR_LIN3_RXDMA, CDD_DMA_TRIG_XBAR_LIN3_TXDMA, CDD_DMA_TRIG_XBAR_LIN4_RXDMA, CDD_DMA_TRIG_XBAR_LIN4_TXDMA, CDD_DMA_TRIG_XBAR_I2C0_TX, CDD_DMA_TRIG_XBAR_I2C0_RX, CDD_DMA_TRIG_XBAR_I2C1_TX, CDD_DMA_TRIG_XBAR_I2C1_RX, CDD_DMA_TRIG_XBAR_I2C2_TX, CDD_DMA_TRIG_XBAR_I2C2_RX, CDD_DMA_TRIG_XBAR_I2C3_TX, CDD_DMA_TRIG_XBAR_I2C3_RX, CDD_DMA_TRIG_XBAR_SPI0_DMA_READ_REQ0, CDD_DMA_TRIG_XBAR_SPI0_DMA_READ_REQ1, CDD_DMA_TRIG_XBAR_SPI0_DMA_READ_REQ2, CDD_DMA_TRIG_XBAR_SPI0_DMA_READ_REQ3, CDD_DMA_TRIG_XBAR_SPI0_DMA_WRITE_REQ0, CDD_DMA_TRIG_XBAR_SPI0_DMA_WRITE_REQ1, CDD_DMA_TRIG_XBAR_SPI0_DMA_WRITE_REQ2, CDD_DMA_TRIG_XBAR_SPI0_DMA_WRITE_REQ3, CDD_DMA_TRIG_XBAR_SPI1_DMA_READ_REQ0, CDD_DMA_TRIG_XBAR_SPI1_DMA_READ_REQ1, CDD_DMA_TRIG_XBAR_SPI1_DMA_READ_REQ2, CDD_DMA_TRIG_XBAR_SPI1_DMA_READ_REQ3, CDD_DMA_TRIG_XBAR_SPI1_DMA_WRITE_REQ0, CDD_DMA_TRIG_XBAR_SPI1_DMA_WRITE_REQ1, CDD_DMA_TRIG_XBAR_SPI1_DMA_WRITE_REQ2, CDD_DMA_TRIG_XBAR_SPI1_DMA_WRITE_REQ3, CDD_DMA_TRIG_XBAR_SPI2_DMA_READ_REQ0, CDD_DMA_TRIG_XBAR_SPI2_DMA_READ_REQ1, CDD_DMA_TRIG_XBAR_SPI2_DMA_READ_REQ2, CDD_DMA_TRIG_XBAR_SPI2_DMA_READ_REQ3, CDD_DMA_TRIG_XBAR_SPI2_DMA_WRITE_REQ0, CDD_DMA_TRIG_XBAR_SPI2_DMA_WRITE_REQ1, CDD_DMA_TRIG_XBAR_SPI2_DMA_WRITE_REQ2, CDD_DMA_TRIG_XBAR_SPI2_DMA_WRITE_REQ3, CDD_DMA_TRIG_XBAR_SPI3_DMA_READ_REQ0, CDD_DMA_TRIG_XBAR_SPI3_DMA_READ_REQ1, CDD_DMA_TRIG_XBAR_SPI3_DMA_READ_REQ2, CDD_DMA_TRIG_XBAR_SPI3_DMA_READ_REQ3, CDD_DMA_TRIG_XBAR_SPI3_DMA_WRITE_REQ0, CDD_DMA_TRIG_XBAR_SPI3_DMA_WRITE_REQ1, CDD_DMA_TRIG_XBAR_SPI3_DMA_WRITE_REQ2, CDD_DMA_TRIG_XBAR_SPI3_DMA_WRITE_REQ3, CDD_DMA_TRIG_XBAR_SPI4_DMA_READ_REQ0, CDD_DMA_TRIG_XBAR_SPI4_DMA_READ_REQ1, CDD_DMA_TRIG_XBAR_SPI4_DMA_READ_REQ2, CDD_DMA_TRIG_XBAR_SPI4_DMA_READ_REQ3, CDD_DMA_TRIG_XBAR_SPI4_DMA_WRITE_REQ0, CDD_DMA_TRIG_XBAR_SPI4_DMA_WRITE_REQ1, CDD_DMA_TRIG_XBAR_SPI4_DMA_WRITE_REQ2, CDD_DMA_TRIG_XBAR_SPI4_DMA_WRITE_REQ3, CDD_DMA_TRIG_XBAR_RTI0_DMA_0, CDD_DMA_TRIG_XBAR_RTI0_DMA_1, CDD_DMA_TRIG_XBAR_RTI0_DMA_2, CDD_DMA_TRIG_XBAR_RTI0_DMA_3, CDD_DMA_TRIG_XBAR_RTI1_DMA_0, CDD_DMA_TRIG_XBAR_RTI1_DMA_1, CDD_DMA_TRIG_XBAR_RTI1_DMA_2, CDD_DMA_TRIG_XBAR_RTI1_DMA_3, CDD_DMA_TRIG_XBAR_RTI2_DMA_0, CDD_DMA_TRIG_XBAR_RTI2_DMA_1, CDD_DMA_TRIG_XBAR_RTI2_DMA_2, CDD_DMA_TRIG_XBAR_RTI2_DMA_3, CDD_DMA_TRIG_XBAR_RTI3_DMA_0, CDD_DMA_TRIG_XBAR_RTI3_DMA_1, CDD_DMA_TRIG_XBAR_RTI3_DMA_2, CDD_DMA_TRIG_XBAR_RTI3_DMA_3, CDD_DMA_TRIG_XBAR_MCANSS0_TX_DMA_0, CDD_DMA_TRIG_XBAR_MCANSS0_TX_DMA_1, CDD_DMA_TRIG_XBAR_MCANSS0_TX_DMA_2, CDD_DMA_TRIG_XBAR_MCANSS0_TX_DMA_3, CDD_DMA_TRIG_XBAR_MCANSS1_TX_DMA_0, CDD_DMA_TRIG_XBAR_MCANSS1_TX_DMA_1, CDD_DMA_TRIG_XBAR_MCANSS1_TX_DMA_2, CDD_DMA_TRIG_XBAR_MCANSS1_TX_DMA_3, CDD_DMA_TRIG_XBAR_MCANSS2_TX_DMA_0, CDD_DMA_TRIG_XBAR_MCANSS2_TX_DMA_1, CDD_DMA_TRIG_XBAR_MCANSS2_TX_DMA_2, CDD_DMA_TRIG_XBAR_MCANSS2_TX_DMA_3, CDD_DMA_TRIG_XBAR_MCANSS3_TX_DMA_0, CDD_DMA_TRIG_XBAR_MCANSS3_TX_DMA_1, CDD_DMA_TRIG_XBAR_MCANSS3_TX_DMA_2, CDD_DMA_TRIG_XBAR_MCANSS3_TX_DMA_3, CDD_DMA_TRIG_XBAR_USART0_DMA_0, CDD_DMA_TRIG_XBAR_USART0_DMA_1, CDD_DMA_TRIG_XBAR_USART1_DMA_0, CDD_DMA_TRIG_XBAR_USART1_DMA_1, CDD_DMA_TRIG_XBAR_USART2_DMA_0, CDD_DMA_TRIG_XBAR_USART2_DMA_1, CDD_DMA_TRIG_XBAR_USART3_DMA_0, CDD_DMA_TRIG_XBAR_USART3_DMA_1, CDD_DMA_TRIG_XBAR_USART4_DMA_0, CDD_DMA_TRIG_XBAR_USART4_DMA_1, CDD_DMA_TRIG_XBAR_USART5_DMA_0, CDD_DMA_TRIG_XBAR_USART5_DMA_1, CDD_DMA_TRIG_XBAR_MCRC_DMA_EVENT_0, CDD_DMA_TRIG_XBAR_MCRC_DMA_EVENT_1, CDD_DMA_TRIG_XBAR_MCRC_DMA_EVENT_2, CDD_DMA_TRIG_XBAR_MCRC_DMA_EVENT_3, CDD_DMA_TRIG_XBAR_QSPI_INTR, CDD_DMA_TRIG_XBAR_GPIO_INT_XBAR_OUT_0, CDD_DMA_TRIG_XBAR_GPIO_INT_XBAR_OUT_1, CDD_DMA_TRIG_XBAR_GPIO_INT_XBAR_OUT_2, CDD_DMA_TRIG_XBAR_GPIO_INT_XBAR_OUT_3, CDD_DMA_TRIG_XBAR_SOC_TIMESYNC_XBAR1_OUT_0, CDD_DMA_TRIG_XBAR_SOC_TIMESYNC_XBAR1_OUT_1, CDD_DMA_TRIG_XBAR_SOC_TIMESYNC_XBAR0_OUT_0, CDD_DMA_TRIG_XBAR_SOC_TIMESYNC_XBAR0_OUT_1, CDD_DMA_TRIG_XBAR_DMA_XBAR_OUT_0, CDD_DMA_TRIG_XBAR_DMA_XBAR_OUT_1, CDD_DMA_TRIG_XBAR_DMA_XBAR_OUT_2, CDD_DMA_TRIG_XBAR_DMA_XBAR_OUT_3, CDD_DMA_TRIG_XBAR_DMA_XBAR_OUT_4, CDD_DMA_TRIG_XBAR_DMA_XBAR_OUT_5, CDD_DMA_TRIG_XBAR_DMA_XBAR_OUT_6, CDD_DMA_TRIG_XBAR_DMA_XBAR_OUT_7, CDD_DMA_TRIG_XBAR_DMA_XBAR_OUT_8, CDD_DMA_TRIG_XBAR_DMA_XBAR_OUT_9, CDD_DMA_TRIG_XBAR_DMA_XBAR_OUT_10, CDD_DMA_TRIG_XBAR_DMA_XBAR_OUT_11, CDD_DMA_TRIG_XBAR_DMA_XBAR_OUT_12, CDD_DMA_TRIG_XBAR_DMA_XBAR_OUT_13, CDD_DMA_TRIG_XBAR_DMA_XBAR_OUT_14, CDD_DMA_TRIG_XBAR_DMA_XBAR_OUT_15, CDD_DMA_TRIG_XBAR_MMC_DMA_RD, CDD_DMA_TRIG_XBAR_MMC_DMA_WR, CDD_DMA_TRIG_XBAR_DTHE_SHA_DMA_REQ0, CDD_DMA_TRIG_XBAR_DTHE_SHA_DMA_REQ1, CDD_DMA_TRIG_XBAR_DTHE_SHA_DMA_REQ2, CDD_DMA_TRIG_XBAR_DTHE_SHA_DMA_REQ3, CDD_DMA_TRIG_XBAR_DTHE_SHA_DMA_REQ4, CDD_DMA_TRIG_XBAR_DTHE_SHA_DMA_REQ5, CDD_DMA_TRIG_XBAR_DTHE_AES_DMA_REQ0, CDD_DMA_TRIG_XBAR_DTHE_AES_DMA_REQ1, CDD_DMA_TRIG_XBAR_DTHE_AES_DMA_REQ2, CDD_DMA_TRIG_XBAR_DTHE_AES_DMA_REQ3, CDD_DMA_TRIG_XBAR_DTHE_AES_DMA_REQ4, CDD_DMA_TRIG_XBAR_DTHE_AES_DMA_REQ5, CDD_DMA_TRIG_XBAR_DTHE_AES_DMA_REQ6, CDD_DMA_TRIG_XBAR_DTHE_AES_DMA_REQ7, CDD_DMA_TRIG_XBAR_MCANSS0_FE_0, CDD_DMA_TRIG_XBAR_MCANSS0_FE_1, CDD_DMA_TRIG_XBAR_MCANSS0_FE_2, CDD_DMA_TRIG_XBAR_MCANSS0_FE_3, CDD_DMA_TRIG_XBAR_MCANSS0_FE_4, CDD_DMA_TRIG_XBAR_MCANSS0_FE_5, CDD_DMA_TRIG_XBAR_MCANSS0_FE_6, CDD_DMA_TRIG_XBAR_MCANSS1_FE_0, CDD_DMA_TRIG_XBAR_MCANSS1_FE_1, CDD_DMA_TRIG_XBAR_MCANSS1_FE_2, CDD_DMA_TRIG_XBAR_MCANSS1_FE_3, CDD_DMA_TRIG_XBAR_MCANSS1_FE_4, CDD_DMA_TRIG_XBAR_MCANSS1_FE_5, CDD_DMA_TRIG_XBAR_MCANSS1_FE_6, CDD_DMA_TRIG_XBAR_MCANSS2_FE_0, CDD_DMA_TRIG_XBAR_MCANSS2_FE_1, CDD_DMA_TRIG_XBAR_MCANSS2_FE_2, CDD_DMA_TRIG_XBAR_MCANSS2_FE_3, CDD_DMA_TRIG_XBAR_MCANSS2_FE_4, CDD_DMA_TRIG_XBAR_MCANSS2_FE_5, CDD_DMA_TRIG_XBAR_MCANSS2_FE_6, CDD_DMA_TRIG_XBAR_MCANSS3_FE_0, CDD_DMA_TRIG_XBAR_MCANSS3_FE_1, CDD_DMA_TRIG_XBAR_MCANSS3_FE_2, CDD_DMA_TRIG_XBAR_MCANSS3_FE_3, CDD_DMA_TRIG_XBAR_MCANSS3_FE_4, CDD_DMA_TRIG_XBAR_MCANSS3_FE_5, CDD_DMA_TRIG_XBAR_MCANSS3_FE_6, CDD_DMA_TRIG_XBAR_GPMC_SDMAREQ, CDD_DMA_TRIG_XBAR_MCANSS4_TX_DMA_0, CDD_DMA_TRIG_XBAR_MCANSS4_TX_DMA_1, CDD_DMA_TRIG_XBAR_MCANSS4_TX_DMA_2, CDD_DMA_TRIG_XBAR_MCANSS4_TX_DMA_3, CDD_DMA_TRIG_XBAR_MCANSS5_TX_DMA_0, CDD_DMA_TRIG_XBAR_MCANSS5_TX_DMA_1, CDD_DMA_TRIG_XBAR_MCANSS5_TX_DMA_2, CDD_DMA_TRIG_XBAR_MCANSS5_TX_DMA_3, CDD_DMA_TRIG_XBAR_MCANSS6_TX_DMA_0, CDD_DMA_TRIG_XBAR_MCANSS6_TX_DMA_1, CDD_DMA_TRIG_XBAR_MCANSS6_TX_DMA_2, CDD_DMA_TRIG_XBAR_MCANSS6_TX_DMA_3, CDD_DMA_TRIG_XBAR_MCANSS7_TX_DMA_0, CDD_DMA_TRIG_XBAR_MCANSS7_TX_DMA_1, CDD_DMA_TRIG_XBAR_MCANSS7_TX_DMA_2, CDD_DMA_TRIG_XBAR_MCANSS7_TX_DMA_3, CDD_DMA_TRIG_XBAR_MCANSS4_FE_0, CDD_DMA_TRIG_XBAR_MCANSS4_FE_1, CDD_DMA_TRIG_XBAR_MCANSS4_FE_2, CDD_DMA_TRIG_XBAR_MCANSS4_FE_3, CDD_DMA_TRIG_XBAR_MCANSS4_FE_4, CDD_DMA_TRIG_XBAR_MCANSS4_FE_5, CDD_DMA_TRIG_XBAR_MCANSS4_FE_6, CDD_DMA_TRIG_XBAR_MCANSS5_FE_0, CDD_DMA_TRIG_XBAR_MCANSS5_FE_1, CDD_DMA_TRIG_XBAR_MCANSS5_FE_2, CDD_DMA_TRIG_XBAR_MCANSS5_FE_3, CDD_DMA_TRIG_XBAR_MCANSS5_FE_4, CDD_DMA_TRIG_XBAR_MCANSS5_FE_5, CDD_DMA_TRIG_XBAR_MCANSS5_FE_6, CDD_DMA_TRIG_XBAR_MCANSS6_FE_0, CDD_DMA_TRIG_XBAR_MCANSS6_FE_1, CDD_DMA_TRIG_XBAR_MCANSS6_FE_2, CDD_DMA_TRIG_XBAR_MCANSS6_FE_3, CDD_DMA_TRIG_XBAR_MCANSS6_FE_4, CDD_DMA_TRIG_XBAR_MCANSS6_FE_5, CDD_DMA_TRIG_XBAR_MCANSS6_FE_6, CDD_DMA_TRIG_XBAR_MCANSS7_FE_0, CDD_DMA_TRIG_XBAR_MCANSS7_FE_1, CDD_DMA_TRIG_XBAR_MCANSS7_FE_2, CDD_DMA_TRIG_XBAR_MCANSS7_FE_3, CDD_DMA_TRIG_XBAR_MCANSS7_FE_4, CDD_DMA_TRIG_XBAR_MCANSS7_FE_5, CDD_DMA_TRIG_XBAR_MCANSS7_FE_6, CDD_DMA_TRIG_XBAR_SPI5_DMA_READ_REQ0, CDD_DMA_TRIG_XBAR_SPI5_DMA_READ_REQ1, CDD_DMA_TRIG_XBAR_SPI5_DMA_READ_REQ2, CDD_DMA_TRIG_XBAR_SPI5_DMA_READ_REQ3, CDD_DMA_TRIG_XBAR_SPI5_DMA_WRITE_REQ0, CDD_DMA_TRIG_XBAR_SPI5_DMA_WRITE_REQ1, CDD_DMA_TRIG_XBAR_SPI5_DMA_WRITE_REQ2, CDD_DMA_TRIG_XBAR_SPI5_DMA_WRITE_REQ3, CDD_DMA_TRIG_XBAR_SPI6_DMA_READ_REQ0, CDD_DMA_TRIG_XBAR_SPI6_DMA_READ_REQ1, CDD_DMA_TRIG_XBAR_SPI6_DMA_READ_REQ2, CDD_DMA_TRIG_XBAR_SPI6_DMA_READ_REQ3, CDD_DMA_TRIG_XBAR_SPI6_DMA_WRITE_REQ0, CDD_DMA_TRIG_XBAR_SPI6_DMA_WRITE_REQ1, CDD_DMA_TRIG_XBAR_SPI6_DMA_WRITE_REQ2, CDD_DMA_TRIG_XBAR_SPI6_DMA_WRITE_REQ3, CDD_DMA_TRIG_XBAR_SPI7_DMA_READ_REQ0, CDD_DMA_TRIG_XBAR_SPI7_DMA_READ_REQ1, CDD_DMA_TRIG_XBAR_SPI7_DMA_READ_REQ2, CDD_DMA_TRIG_XBAR_SPI7_DMA_READ_REQ3, CDD_DMA_TRIG_XBAR_SPI7_DMA_WRITE_REQ0, CDD_DMA_TRIG_XBAR_SPI7_DMA_WRITE_REQ1, CDD_DMA_TRIG_XBAR_SPI7_DMA_WRITE_REQ2, CDD_DMA_TRIG_XBAR_SPI7_DMA_WRITE_REQ3, CDD_DMA_TRIG_XBAR_RTI4_DMA_0, CDD_DMA_TRIG_XBAR_RTI4_DMA_1, CDD_DMA_TRIG_XBAR_RTI4_DMA_2, CDD_DMA_TRIG_XBAR_RTI4_DMA_3, CDD_DMA_TRIG_XBAR_RTI5_DMA_0, CDD_DMA_TRIG_XBAR_RTI5_DMA_1, CDD_DMA_TRIG_XBAR_RTI5_DMA_2, CDD_DMA_TRIG_XBAR_RTI5_DMA_3, CDD_DMA_TRIG_XBAR_RTI6_DMA_0, CDD_DMA_TRIG_XBAR_RTI6_DMA_1, CDD_DMA_TRIG_XBAR_RTI6_DMA_2, CDD_DMA_TRIG_XBAR_RTI6_DMA_3, CDD_DMA_TRIG_XBAR_RTI7_DMA_0, CDD_DMA_TRIG_XBAR_RTI7_DMA_1, CDD_DMA_TRIG_XBAR_RTI7_DMA_2, CDD_DMA_TRIG_XBAR_RTI7_DMA_3}, origin=Texas Instruments, set at pre-compile, default-value=CDD_DMA_TRIG_XBAR_DMA_XBAR_OUT_0  # Source to Trigger DMA Channel.
        enumeration CddDmaDmaChannelXbar: {CDD_DMA_XBAR_DMA_TRIG_XBAR_0, CDD_DMA_XBAR_DMA_TRIG_XBAR_1, CDD_DMA_XBAR_DMA_TRIG_XBAR_2, CDD_DMA_XBAR_DMA_TRIG_XBAR_3, CDD_DMA_XBAR_DMA_TRIG_XBAR_4, CDD_DMA_XBAR_DMA_TRIG_XBAR_5, CDD_DMA_XBAR_DMA_TRIG_XBAR_6, CDD_DMA_XBAR_DMA_TRIG_XBAR_7, CDD_DMA_XBAR_DMA_TRIG_XBAR_8, CDD_DMA_XBAR_DMA_TRIG_XBAR_9, CDD_DMA_XBAR_DMA_TRIG_XBAR_10, CDD_DMA_XBAR_DMA_TRIG_XBAR_11, CDD_DMA_XBAR_DMA_TRIG_XBAR_12, CDD_DMA_XBAR_DMA_TRIG_XBAR_13, CDD_DMA_XBAR_DMA_TRIG_XBAR_14, CDD_DMA_XBAR_DMA_TRIG_XBAR_15}, origin=Texas Instruments, set at pre-compile, default-value=CDD_DMA_XBAR_DMA_TRIG_XBAR_0  # DMA Channel Cross bar source.
        enumeration CddDmaDmaChannelXbarMap: {CDD_DMA_XBAR_EPWM0_SOCA, CDD_DMA_XBAR_EPWM1_SOCA, CDD_DMA_XBAR_EPWM2_SOCA, CDD_DMA_XBAR_EPWM3_SOCA, CDD_DMA_XBAR_EPWM4_SOCA, CDD_DMA_XBAR_EPWM5_SOCA, CDD_DMA_XBAR_EPWM6_SOCA, CDD_DMA_XBAR_EPWM7_SOCA, CDD_DMA_XBAR_EPWM8_SOCA, CDD_DMA_XBAR_EPWM9_SOCA, CDD_DMA_XBAR_EPWM10_SOCA, CDD_DMA_XBAR_EPWM11_SOCA, CDD_DMA_XBAR_EPWM12_SOCA, CDD_DMA_XBAR_EPWM13_SOCA, CDD_DMA_XBAR_EPWM14_SOCA, CDD_DMA_XBAR_EPWM15_SOCA, CDD_DMA_XBAR_EPWM16_SOCA, CDD_DMA_XBAR_EPWM17_SOCA, CDD_DMA_XBAR_EPWM18_SOCA, CDD_DMA_XBAR_EPWM19_SOCA, CDD_DMA_XBAR_EPWM20_SOCA, CDD_DMA_XBAR_EPWM21_SOCA, CDD_DMA_XBAR_EPWM22_SOCA, CDD_DMA_XBAR_EPWM23_SOCA, CDD_DMA_XBAR_EPWM24_SOCA, CDD_DMA_XBAR_EPWM25_SOCA, CDD_DMA_XBAR_EPWM26_SOCA, CDD_DMA_XBAR_EPWM27_SOCA, CDD_DMA_XBAR_EPWM28_SOCA, CDD_DMA_XBAR_EPWM29_SOCA, CDD_DMA_XBAR_EPWM30_SOCA, CDD_DMA_XBAR_EPWM31_SOCA, CDD_DMA_XBAR_EPWM0_SOCB, CDD_DMA_XBAR_EPWM1_SOCB, CDD_DMA_XBAR_EPWM2_SOCB, CDD_DMA_XBAR_EPWM3_SOCB, CDD_DMA_XBAR_EPWM4_SOCB, CDD_DMA_XBAR_EPWM5_SOCB, CDD_DMA_XBAR_EPWM6_SOCB, CDD_DMA_XBAR_EPWM7_SOCB, CDD_DMA_XBAR_EPWM8_SOCB, CDD_DMA_XBAR_EPWM9_SOCB, CDD_DMA_XBAR_EPWM10_SOCB, CDD_DMA_XBAR_EPWM11_SOCB, CDD_DMA_XBAR_EPWM12_SOCB, CDD_DMA_XBAR_EPWM13_SOCB, CDD_DMA_XBAR_EPWM14_SOCB, CDD_DMA_XBAR_EPWM15_SOCB, CDD_DMA_XBAR_EPWM16_SOCB, CDD_DMA_XBAR_EPWM17_SOCB, CDD_DMA_XBAR_EPWM18_SOCB, CDD_DMA_XBAR_EPWM19_SOCB, CDD_DMA_XBAR_EPWM20_SOCB, CDD_DMA_XBAR_EPWM21_SOCB, CDD_DMA_XBAR_EPWM22_SOCB, CDD_DMA_XBAR_EPWM23_SOCB, CDD_DMA_XBAR_EPWM24_SOCB, CDD_DMA_XBAR_EPWM25_SOCB, CDD_DMA_XBAR_EPWM26_SOCB, CDD_DMA_XBAR_EPWM27_SOCB, CDD_DMA_XBAR_EPWM28_SOCB, CDD_DMA_XBAR_EPWM29_SOCB, CDD_DMA_XBAR_EPWM30_SOCB, CDD_DMA_XBAR_EPWM31_SOCB, CDD_DMA_XBAR_ADC0_INT1, CDD_DMA_XBAR_ADC0_INT2, CDD_DMA_XBAR_ADC0_INT3, CDD_DMA_XBAR_ADC0_INT4, CDD_DMA_XBAR_ADC0_EVTINT, CDD_DMA_XBAR_ADC1_INT1, CDD_DMA_XBAR_ADC1_INT2, CDD_DMA_XBAR_ADC1_INT3, CDD_DMA_XBAR_ADC1_INT4, CDD_DMA_XBAR_ADC1_EVTINT, CDD_DMA_XBAR_ADC2_INT1, CDD_DMA_XBAR_ADC2_INT2, CDD_DMA_XBAR_ADC2_INT3, CDD_DMA_XBAR_ADC2_INT4, CDD_DMA_XBAR_ADC2_EVTINT, CDD_DMA_XBAR_ADC3_INT1, CDD_DMA_XBAR_ADC3_INT2, CDD_DMA_XBAR_ADC3_INT3, CDD_DMA_XBAR_ADC3_INT4, CDD_DMA_XBAR_ADC3_EVTINT, CDD_DMA_XBAR_ADC4_INT1, CDD_DMA_XBAR_ADC4_INT2, CDD_DMA_XBAR_ADC4_INT3, CDD_DMA_XBAR_ADC4_INT4, CDD_DMA_XBAR_ADC4_EVTINT, CDD_DMA_XBAR_FSI0_RX_DMA_EVT, CDD_DMA_XBAR_FSI0_DMA_TRIG1, CDD_DMA_XBAR_FSI0_DMA_TRIG2, CDD_DMA_XBAR_FSI1_RX_DMA_EVT, CDD_DMA_XBAR_FSI1_DMA_TRIG1, CDD_DMA_XBAR_FSI1_DMA_TRIG2, CDD_DMA_XBAR_FSI2_RX_DMA_EVT, CDD_DMA_XBAR_FSI2_DMA_TRIG1, CDD_DMA_XBAR_FSI2_DMA_TRIG2, CDD_DMA_XBAR_FSI3_RX_DMA_EVT, CDD_DMA_XBAR_FSI3_DMA_TRIG1, CDD_DMA_XBAR_FSI3_DMA_TRIG2, CDD_DMA_XBAR_FSI0_TX_DMA_EVT, CDD_DMA_XBAR_FSI1_TX_DMA_EVT, CDD_DMA_XBAR_FSI2_TX_DMA_EVT, CDD_DMA_XBAR_FSI3_TX_DMA_EVT, CDD_DMA_XBAR_SD0_FILT0_DRINT, CDD_DMA_XBAR_SD0_FILT1_DRINT, CDD_DMA_XBAR_SD0_FILT2_DRINT, CDD_DMA_XBAR_SD0_FILT3_DRINT, CDD_DMA_XBAR_SD1_FILT0_DRINT, CDD_DMA_XBAR_SD1_FILT1_DRINT, CDD_DMA_XBAR_SD1_FILT2_DRINT, CDD_DMA_XBAR_SD1_FILT3_DRINT, CDD_DMA_XBAR_ECAP0_DMA_INT, CDD_DMA_XBAR_ECAP1_DMA_INT, CDD_DMA_XBAR_ECAP2_DMA_INT, CDD_DMA_XBAR_ECAP3_DMA_INT, CDD_DMA_XBAR_ECAP4_DMA_INT, CDD_DMA_XBAR_ECAP5_DMA_INT, CDD_DMA_XBAR_ECAP6_DMA_INT, CDD_DMA_XBAR_ECAP7_DMA_INT, CDD_DMA_XBAR_ECAP8_DMA_INT, CDD_DMA_XBAR_ECAP9_DMA_INT, CDD_DMA_XBAR_ADCR0_INT1, CDD_DMA_XBAR_ADCR0_INT2, CDD_DMA_XBAR_ADCR0_INT3, CDD_DMA_XBAR_ADCR0_INT4, CDD_DMA_XBAR_ADCR0_EVTINT, CDD_DMA_XBAR_ADCR1_INT1, CDD_DMA_XBAR_ADCR1_INT2, CDD_DMA_XBAR_ADCR1_INT3, CDD_DMA_XBAR_ADCR1_INT4, CDD_DMA_XBAR_ADCR1_EVTINT}, origin=Texas Instruments, set at pre-compile, default-value=CDD_DMA_XBAR_ADC0_INT1  # DMA Channel Cross bar source.
    container CddDmaGeneral  # General configuration settings for the Complex Device Driver
      boolean CddDmaVersionInfoApi: origin=Texas Instruments, set at pre-compile, default-value=true  # Switches the Cdd_Dma_GetVersionInfo function ON or OFF.
      boolean CddDmaDeinitApi: origin=Texas Instruments, set at pre-compile, default-value=true  # Switches the Cdd_Dma_DeInit function ON or OFF.
      boolean CddDmaDevErrorDetect: origin=Texas Instruments, set at pre-compile, default-value=true  # Switches the Development Error Detection and Notification ON or OFF.
      boolean CddDmaRegisterReadBackApi: origin=Texas Instruments, set at pre-compile, default-value=true  # Switches the Cdd_Dma_RegisterReadback function ON or OFF.
      enumeration CddDmaIrqType: {CDD_DMA_ISR_VOID, CDD_DMA_ISR_CAT1, CDD_DMA_ISR_CAT2}, origin=Texas Instruments, set at pre-compile, default-value=CDD_DMA_ISR_VOID  # This parameter specifies the category of Interrupt ReQuest for callbacks.
    container CddPublishedInformation  # Container holding all Complex driver specific published information parameters
