AUTOSAR XML (schema 00044)
package /Lin_TI_AM263px
  bsw module description Lin: category=BSW_MODULE, module-id=82
    implemented-entrys:
      Lin_1_Int0ISR
      Lin_CheckWakeup
      Lin_GetStatus
      Lin_GetVersionInfo
      Lin_GoToSleep
      Lin_GoToSleepInternal
      Lin_Init
      Lin_RegisterReadback
      Lin_SendFrame
      Lin_Wakeup
      Lin_WakeupInternal
    bsw module dependency Det: target-module-id=15, target-module=Det
    bsw internal behavior Lin_Behavior
      exclusive area LIN_EXCLUSIVE_AREA_0
      bsw interrupt entity Lin_1_Int0ISR: reentrancy-level=NON-REENTRANT, implemented-entry=Lin_1_Int0ISR, interrupt-category=CAT-1, interrupt-source=Hardware
      10 x bsw called entity:
        Lin_CheckWakeup: reentrancy-level=NON-REENTRANT, implemented-entry=Lin_CheckWakeup
          bsw direct call point Det_ReportError: called-entry=Det_ReportError
        Lin_GetStatus: can-enter-exclusive-area=LIN_EXCLUSIVE_AREA_0, reentrancy-level=NON-REENTRANT, implemented-entry=Lin_GetStatus
          bsw direct call point Det_ReportError: called-entry=Det_ReportError
        Lin_GetVersionInfo: reentrancy-level=SINGLE-CORE-REENTRANT, implemented-entry=Lin_GetVersionInfo
          bsw direct call point Det_ReportError: called-entry=Det_ReportError
        Lin_GoToSleep: can-enter-exclusive-area=LIN_EXCLUSIVE_AREA_0, reentrancy-level=NON-REENTRANT, implemented-entry=Lin_GoToSleep
          bsw direct call point Det_ReportError: called-entry=Det_ReportError
        Lin_GoToSleepInternal: can-enter-exclusive-area=LIN_EXCLUSIVE_AREA_0, reentrancy-level=NON-REENTRANT, implemented-entry=Lin_GoToSleepInternal
          bsw direct call point Det_ReportError: called-entry=Det_ReportError
        Lin_Init: reentrancy-level=NON-REENTRANT, implemented-entry=Lin_Init
          bsw direct call point Det_ReportError: called-entry=Det_ReportError
        Lin_RegisterReadback: reentrancy-level=SINGLE-CORE-REENTRANT, implemented-entry=Lin_RegisterReadback
          bsw direct call point Det_ReportError: called-entry=Det_ReportError
        Lin_SendFrame: can-enter-exclusive-area=LIN_EXCLUSIVE_AREA_0, reentrancy-level=NON-REENTRANT, implemented-entry=Lin_SendFrame
          bsw direct call point Det_ReportError: called-entry=Det_ReportError
        Lin_Wakeup: can-enter-exclusive-area=LIN_EXCLUSIVE_AREA_0, reentrancy-level=NON-REENTRANT, implemented-entry=Lin_Wakeup
          bsw direct call point Det_ReportError: called-entry=Det_ReportError
        Lin_WakeupInternal: can-enter-exclusive-area=LIN_EXCLUSIVE_AREA_0, reentrancy-level=NON-REENTRANT, implemented-entry=Lin_WakeupInternal
          bsw direct call point Det_ReportError: called-entry=Det_ReportError
  bsw implementation Lin_Impl: programming-language=C, sw-version=10.01.00, vendor-id=44, ar-release-version=4.3.1, behavior=Lin_Behavior, vendor-specific-module-def=Lin
    code-descriptors:
      code Files
        artifact-descriptors:
          short-label=V0::Lin_Priv.h, category=SWHDR
          short-label=V0::Lin_priv.c, category=SWSRC
          short-label=V0::cslr_lin.h, category=SWHDR
          short-label=generate::include::Lin_Cfg.h, category=SWHDR
          short-label=generate::src::Lin_Cfg.c, category=SWSRC
          short-label=generate::src::Lin_PBcfg.c, category=SWSRC
          short-label=include::Lin.h, category=SWHDR
          short-label=include::Lin_Irq.h, category=SWHDR
          short-label=src::Lin.c, category=SWSRC
          short-label=src::Lin_Irq.c, category=SWSRC
    compiler tiarmclang: name=TI ARM Clang, options=-mcpu=cortex-r5 -mfpu=vfpv3-d16 -mfloat-abi=hard -c -mlittle-endian -ffunction-sections -gdwarf-3 -Werror -Os -x -save-temps -mthumb -DAM263PX_SIP_PACKAGE -DAM263PX_PLATFORM -DAM263PX_R_PACKAGE -DAM263PX_C_PACKAGE, vendor=Texas Instruments, version=4.0.0
    linker tiarmlnk: name=TI ARM Clang Linker, options=-mcpu=cortex-r5 -Wl,--ram_model -Wl,--reread_libs -Wl,--warn_sections -qq -Wl,--emit_warnings_as_errors --diag_suppress=10068 --diag_suppress=10063, vendor=Texas Instruments, version=4.0.0
    resource consumption ResourceConsumption
      6 x memory section:
        LIN_CODE: alignment=UNSPECIFIED, sw-addrmethod=CODE, symbol=CODE
        LIN_CONFIG_DATA: alignment=UNSPECIFIED, sw-addrmethod=CONFIG_DATA, symbol=CONFIG_DATA
        LIN_ISR_CODE: alignment=UNSPECIFIED, sw-addrmethod=CODE, symbol=ISR_CODE
        LIN_VAR_INIT_UNSPECIFIED: alignment=UNSPECIFIED, sw-addrmethod=VAR_INIT, symbol=VAR_INIT_UNSPECIFIED
        LIN_VAR_NO_INIT_UNSPECIFIED: alignment=UNSPECIFIED, sw-addrmethod=VAR_NO_INIT, symbol=VAR_NO_INIT_UNSPECIFIED
        LIN_VAR_NO_INIT_8: alignment=8, sw-addrmethod=VAR_NO_INIT, symbol=VAR_NO_INIT_8
package /Lin_TI_AM263px/Lin_ModuleEntry
  20 x bsw module entry, all with sw-service-impl-policy=STANDARD, bsw-entry-kind=CONCRETE:
    Lin_0_Int0ISR: is-reentrant=false, is-synchronous=true, call-type=INTERRUPT, execution-context=INTERRUPT-CAT-1
    Lin_0_Int1ISR: is-reentrant=false, is-synchronous=true, call-type=INTERRUPT, execution-context=INTERRUPT-CAT-1
    Lin_1_Int0ISR: is-reentrant=false, is-synchronous=true, call-type=INTERRUPT, execution-context=INTERRUPT-CAT-1
    Lin_1_Int1ISR: is-reentrant=false, is-synchronous=true, call-type=INTERRUPT, execution-context=INTERRUPT-CAT-1
    Lin_2_Int0ISR: is-reentrant=false, is-synchronous=true, call-type=INTERRUPT, execution-context=INTERRUPT-CAT-1
    Lin_2_Int1ISR: is-reentrant=false, is-synchronous=true, call-type=INTERRUPT, execution-context=INTERRUPT-CAT-1
    Lin_3_Int0ISR: is-reentrant=false, is-synchronous=true, call-type=INTERRUPT, execution-context=INTERRUPT-CAT-1
    Lin_3_Int1ISR: is-reentrant=false, is-synchronous=true, call-type=INTERRUPT, execution-context=INTERRUPT-CAT-1
    Lin_4_Int0ISR: is-reentrant=false, is-synchronous=true, call-type=INTERRUPT, execution-context=INTERRUPT-CAT-1
    Lin_4_Int1ISR: is-reentrant=false, is-synchronous=true, call-type=INTERRUPT, execution-context=INTERRUPT-CAT-1
    Lin_CheckWakeup: service-id=10, is-reentrant=false, is-synchronous=true, call-type=REGULAR, execution-context=UNSPECIFIED
    Lin_GetStatus: service-id=8, is-reentrant=false, is-synchronous=true, call-type=REGULAR, execution-context=UNSPECIFIED
    Lin_GetVersionInfo: service-id=1, is-reentrant=true, is-synchronous=true, call-type=REGULAR, execution-context=UNSPECIFIED
    Lin_GoToSleep: service-id=6, is-reentrant=false, is-synchronous=false, call-type=REGULAR, execution-context=UNSPECIFIED
    Lin_GoToSleepInternal: service-id=9, is-reentrant=false, is-synchronous=true, call-type=REGULAR, execution-context=UNSPECIFIED
    Lin_Init: service-id=0, is-reentrant=false, is-synchronous=true, call-type=REGULAR, execution-context=UNSPECIFIED
    Lin_RegisterReadback: service-id=17, is-reentrant=true, is-synchronous=true, call-type=REGULAR, execution-context=UNSPECIFIED
    Lin_SendFrame: service-id=4, is-reentrant=false, is-synchronous=false, call-type=REGULAR, execution-context=UNSPECIFIED
    Lin_Wakeup: service-id=7, is-reentrant=false, is-synchronous=false, call-type=REGULAR, execution-context=UNSPECIFIED
    Lin_WakeupInternal: service-id=11, is-reentrant=false, is-synchronous=false, call-type=REGULAR, execution-context=UNSPECIFIED
