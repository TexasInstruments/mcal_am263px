AUTOSAR XML (schema 00044)
package /Cdd_Pwm_TI_AM263px
  bsw module description Cdd_Pwm: category=BSW_MODULE, module-id=255
    implemented-entrys:
      Cdd_Pwm_ChopperCfg
      Cdd_Pwm_ChopperEnable
      Cdd_Pwm_ClearCounterStatus
      Cdd_Pwm_CounterComparatorCfg
      Cdd_Pwm_DeInit
      Cdd_Pwm_DeadbandBypass
      Cdd_Pwm_DeadbandCfg
      Cdd_Pwm_SetRisingEdgeDelay
      Cdd_Pwm_SetFallingEdgeDelay
      Cdd_Pwm_SetMinDeadbandDelay
      Cdd_Pwm_HrSetRisingEdgeDelay
      Cdd_Pwm_HrSetFallingEdgeDelay
      Cdd_Pwm_DisableNotification
      Cdd_Pwm_EnableNotification
      Cdd_Pwm_EtGetEventCount
      Cdd_Pwm_EtIntrClear
      Cdd_Pwm_EtIntrStatus
      Cdd_Pwm_G0_Ch0Isr
      Cdd_Pwm_G0_TzCh0Isr
      Cdd_Pwm_G0_Ch1Isr
      Cdd_Pwm_G0_TzCh1Isr
      Cdd_Pwm_GetCounter
      Cdd_Pwm_GetCounterStatus
      Cdd_Pwm_GetVersionInfo
      Cdd_Pwm_HrSetPeriodDutyPhase
      Cdd_Pwm_HrSetPhaseShift
      Cdd_Pwm_HrSetTimeBasePeriod
      Cdd_Pwm_HrSetCounterCompareValue
      Cdd_Pwm_HrSetXcmpRegValue
      Cdd_Pwm_HrSfoCalibration
      Cdd_Pwm_HrSfoStatus
      Cdd_Pwm_Init
      Cdd_Pwm_RegisterReadback
      Cdd_Pwm_SetAbsoluteThreshold
      Cdd_Pwm_SetAdcTrigger
      Cdd_Pwm_SetOutputToIdle
      Cdd_Pwm_SetPeriodDutyPhase
      Cdd_Pwm_SetTimeBaseCounterMode
      Cdd_Pwm_SetPhaseShift
      Cdd_Pwm_SetTimeBasePeriod
      Cdd_Pwm_SetCounterCompareValue
      Cdd_Pwm_SetXcmpRegValue
      Cdd_Pwm_SetXMinMaxRegValue
      Cdd_Pwm_SetCmpShadowRegValue
      Cdd_Pwm_SetPinAction
      Cdd_Pwm_SetRelativeThreshold
      Cdd_Pwm_StartChannelCounter
      Cdd_Pwm_StopChannelCounter
      Cdd_Pwm_SyncDisable
      Cdd_Pwm_SyncEnable
      Cdd_Pwm_TzEventStatusClear
      Cdd_Pwm_TzGetEventStatus
      Cdd_Pwm_TzIntrDisable
      Cdd_Pwm_TzIntrEnable
      Cdd_Pwm_TzTripEventDisable
      Cdd_Pwm_TzTripEventEnable
    bsw module dependency Det: target-module-id=15, target-module=Det
    bsw internal behavior Cdd_Pwm_Behavior
      exclusive area PWM_EXCLUSIVE_AREA_0
      17 x bsw called entity:
        Cdd_Pwm_ChopperCfg: can-enter-exclusive-area=PWM_EXCLUSIVE_AREA_0, reentrancy-level=NON-REENTRANT, implemented-entry=Cdd_Pwm_ChopperCfg
          bsw direct call point Det: called-entry=Det_ReportError
        Cdd_Pwm_ChopperEnable: can-enter-exclusive-area=PWM_EXCLUSIVE_AREA_0, reentrancy-level=NON-REENTRANT, implemented-entry=Cdd_Pwm_ChopperEnable
        Cdd_Pwm_ClearCounterStatus: can-enter-exclusive-area=PWM_EXCLUSIVE_AREA_0, reentrancy-level=NON-REENTRANT, implemented-entry=Cdd_Pwm_ClearCounterStatus
        Cdd_Pwm_CounterComparatorCfg: can-enter-exclusive-area=PWM_EXCLUSIVE_AREA_0, reentrancy-level=NON-REENTRANT, implemented-entry=Cdd_Pwm_CounterComparatorCfg
        Cdd_Pwm_DeInit: reentrancy-level=NON-REENTRANT, implemented-entry=Cdd_Pwm_DeInit
        Cdd_Pwm_DeadbandBypass: can-enter-exclusive-area=PWM_EXCLUSIVE_AREA_0, reentrancy-level=NON-REENTRANT, implemented-entry=Cdd_Pwm_DeadbandBypass
        Cdd_Pwm_DeadbandCfg: can-enter-exclusive-area=PWM_EXCLUSIVE_AREA_0, reentrancy-level=NON-REENTRANT, implemented-entry=Cdd_Pwm_DeadbandCfg
          bsw direct call point Det: called-entry=Det_ReportError
        Cdd_Pwm_SetRisingEdgeDelay: reentrancy-level=NON-REENTRANT, implemented-entry=Cdd_Pwm_SetRisingEdgeDelay
        Cdd_Pwm_SetFallingEdgeDelay: reentrancy-level=NON-REENTRANT, implemented-entry=Cdd_Pwm_SetFallingEdgeDelay
        Cdd_Pwm_SetMinDeadbandDelay: reentrancy-level=NON-REENTRANT, implemented-entry=Cdd_Pwm_SetMinDeadbandDelay
        Cdd_Pwm_HrSetRisingEdgeDelay: reentrancy-level=NON-REENTRANT, implemented-entry=Cdd_Pwm_HrSetRisingEdgeDelay
        Cdd_Pwm_HrSetFallingEdgeDelay: reentrancy-level=NON-REENTRANT, implemented-entry=Cdd_Pwm_HrSetFallingEdgeDelay
        Cdd_Pwm_DisableNotification: can-enter-exclusive-area=PWM_EXCLUSIVE_AREA_0, reentrancy-level=NON-REENTRANT, implemented-entry=Cdd_Pwm_DisableNotification
          bsw direct call point Det: called-entry=Det_ReportError
        Cdd_Pwm_EnableNotification: can-enter-exclusive-area=PWM_EXCLUSIVE_AREA_0, reentrancy-level=NON-REENTRANT, implemented-entry=Cdd_Pwm_EnableNotification
          bsw direct call point Det: called-entry=Det_ReportError
        Cdd_Pwm_EtGetEventCount: reentrancy-level=SINGLE-CORE-REENTRANT, implemented-entry=Cdd_Pwm_EtGetEventCount
        Cdd_Pwm_EtIntrClear: can-enter-exclusive-area=PWM_EXCLUSIVE_AREA_0, reentrancy-level=NON-REENTRANT, implemented-entry=Cdd_Pwm_EtIntrClear
        Cdd_Pwm_EtIntrStatus: can-enter-exclusive-area=PWM_EXCLUSIVE_AREA_0, reentrancy-level=SINGLE-CORE-REENTRANT, implemented-entry=Cdd_Pwm_EtIntrStatus
      4 x bsw interrupt entity, all with reentrancy-level=NON-REENTRANT, interrupt-category=CAT-1, interrupt-source=Hardware:
        Cdd_Pwm_G0_Ch0Isr: implemented-entry=Cdd_Pwm_G0_Ch0Isr
        Cdd_Pwm_G0_TzCh0Isr: implemented-entry=Cdd_Pwm_G0_TzCh0Isr
        Cdd_Pwm_G0_Ch1Isr: implemented-entry=Cdd_Pwm_G0_Ch1Isr
        Cdd_Pwm_G0_TzCh1Isr: implemented-entry=Cdd_Pwm_G0_TzCh1Isr
      35 x bsw called entity:
        Cdd_Pwm_GetCounter: can-enter-exclusive-area=PWM_EXCLUSIVE_AREA_0, reentrancy-level=SINGLE-CORE-REENTRANT, implemented-entry=Cdd_Pwm_GetCounter
          bsw direct call point Det: called-entry=Det_ReportError
        Cdd_Pwm_GetCounterStatus: reentrancy-level=SINGLE-CORE-REENTRANT, implemented-entry=Cdd_Pwm_GetCounterStatus
        Cdd_Pwm_GetVersionInfo: reentrancy-level=SINGLE-CORE-REENTRANT, implemented-entry=Cdd_Pwm_GetVersionInfo
          bsw direct call point Det: called-entry=Det_ReportError
        Cdd_Pwm_HrSetPeriodDutyPhase: can-enter-exclusive-area=PWM_EXCLUSIVE_AREA_0, reentrancy-level=NON-REENTRANT, implemented-entry=Cdd_Pwm_HrSetPeriodDutyPhase
          bsw direct call point Det: called-entry=Det_ReportError
        Cdd_Pwm_HrSetPhaseShift: reentrancy-level=NON-REENTRANT, implemented-entry=Cdd_Pwm_HrSetPhaseShift
        Cdd_Pwm_HrSetTimeBasePeriod: reentrancy-level=NON-REENTRANT, implemented-entry=Cdd_Pwm_HrSetTimeBasePeriod
        Cdd_Pwm_HrSetCounterCompareValue: reentrancy-level=NON-REENTRANT, implemented-entry=Cdd_Pwm_HrSetCounterCompareValue
        Cdd_Pwm_HrSetXcmpRegValue: reentrancy-level=NON-REENTRANT, implemented-entry=Cdd_Pwm_HrSetXcmpRegValue
        Cdd_Pwm_HrSfoCalibration: can-enter-exclusive-area=PWM_EXCLUSIVE_AREA_0, reentrancy-level=NON-REENTRANT, implemented-entry=Cdd_Pwm_HrSfoCalibration
          bsw direct call point Det: called-entry=Det_ReportError
        Cdd_Pwm_HrSfoStatus: can-enter-exclusive-area=PWM_EXCLUSIVE_AREA_0, reentrancy-level=SINGLE-CORE-REENTRANT, implemented-entry=Cdd_Pwm_HrSfoStatus
          bsw direct call point Det: called-entry=Det_ReportError
        Cdd_Pwm_Init: reentrancy-level=NON-REENTRANT, implemented-entry=Cdd_Pwm_Init
          bsw direct call point Det: called-entry=Det_ReportError
        Cdd_Pwm_RegisterReadback: reentrancy-level=NON-REENTRANT, implemented-entry=Cdd_Pwm_RegisterReadback
          bsw direct call point Det: called-entry=Det_ReportError
        Cdd_Pwm_SetAbsoluteThreshold: can-enter-exclusive-area=PWM_EXCLUSIVE_AREA_0, reentrancy-level=NON-REENTRANT, implemented-entry=Cdd_Pwm_SetAbsoluteThreshold
          bsw direct call point Det: called-entry=Det_ReportError
        Cdd_Pwm_SetAdcTrigger: can-enter-exclusive-area=PWM_EXCLUSIVE_AREA_0, reentrancy-level=NON-REENTRANT, implemented-entry=Cdd_Pwm_SetAdcTrigger
        Cdd_Pwm_SetOutputToIdle: can-enter-exclusive-area=PWM_EXCLUSIVE_AREA_0, reentrancy-level=NON-REENTRANT, implemented-entry=Cdd_Pwm_SetOutputToIdle
        Cdd_Pwm_SetPeriodDutyPhase: can-enter-exclusive-area=PWM_EXCLUSIVE_AREA_0, reentrancy-level=NON-REENTRANT, implemented-entry=Cdd_Pwm_SetPeriodDutyPhase
        Cdd_Pwm_SetTimeBaseCounterMode: can-enter-exclusive-area=PWM_EXCLUSIVE_AREA_0, reentrancy-level=NON-REENTRANT, implemented-entry=Cdd_Pwm_SetTimeBaseCounterMode
        Cdd_Pwm_SetPhaseShift: reentrancy-level=NON-REENTRANT, implemented-entry=Cdd_Pwm_SetPhaseShift
        Cdd_Pwm_SetTimeBasePeriod: reentrancy-level=NON-REENTRANT, implemented-entry=Cdd_Pwm_SetTimeBasePeriod
        Cdd_Pwm_SetCounterCompareValue: reentrancy-level=NON-REENTRANT, implemented-entry=Cdd_Pwm_SetCounterCompareValue
        Cdd_Pwm_SetXcmpRegValue: reentrancy-level=NON-REENTRANT, implemented-entry=Cdd_Pwm_SetXcmpRegValue
        Cdd_Pwm_SetXMinMaxRegValue: reentrancy-level=NON-REENTRANT, implemented-entry=Cdd_Pwm_SetXMinMaxRegValue
        Cdd_Pwm_SetCmpShadowRegValue: reentrancy-level=NON-REENTRANT, implemented-entry=Cdd_Pwm_SetCmpShadowRegValue
        Cdd_Pwm_SetPinAction: can-enter-exclusive-area=PWM_EXCLUSIVE_AREA_0, reentrancy-level=NON-REENTRANT, implemented-entry=Cdd_Pwm_SetPinAction
          bsw direct call point Det: called-entry=Det_ReportError
        Cdd_Pwm_SetRelativeThreshold: can-enter-exclusive-area=PWM_EXCLUSIVE_AREA_0, reentrancy-level=NON-REENTRANT, implemented-entry=Cdd_Pwm_SetRelativeThreshold
          bsw direct call point Det: called-entry=Det_ReportError
        Cdd_Pwm_StartChannelCounter: can-enter-exclusive-area=PWM_EXCLUSIVE_AREA_0, reentrancy-level=NON-REENTRANT, implemented-entry=Cdd_Pwm_StartChannelCounter
          bsw direct call point Det: called-entry=Det_ReportError
        Cdd_Pwm_StopChannelCounter: can-enter-exclusive-area=PWM_EXCLUSIVE_AREA_0, reentrancy-level=NON-REENTRANT, implemented-entry=Cdd_Pwm_StopChannelCounter
          bsw direct call point Det: called-entry=Det_ReportError
        Cdd_Pwm_SyncDisable: can-enter-exclusive-area=PWM_EXCLUSIVE_AREA_0, reentrancy-level=NON-REENTRANT, implemented-entry=Cdd_Pwm_SyncDisable
        Cdd_Pwm_SyncEnable: can-enter-exclusive-area=PWM_EXCLUSIVE_AREA_0, reentrancy-level=NON-REENTRANT, implemented-entry=Cdd_Pwm_SyncEnable
        Cdd_Pwm_TzEventStatusClear: can-enter-exclusive-area=PWM_EXCLUSIVE_AREA_0, reentrancy-level=NON-REENTRANT, implemented-entry=Cdd_Pwm_TzEventStatusClear
        Cdd_Pwm_TzGetEventStatus: can-enter-exclusive-area=PWM_EXCLUSIVE_AREA_0, reentrancy-level=NON-REENTRANT, implemented-entry=Cdd_Pwm_TzGetEventStatus
        Cdd_Pwm_TzIntrDisable: can-enter-exclusive-area=PWM_EXCLUSIVE_AREA_0, reentrancy-level=NON-REENTRANT, implemented-entry=Cdd_Pwm_TzIntrDisable
        Cdd_Pwm_TzIntrEnable: can-enter-exclusive-area=PWM_EXCLUSIVE_AREA_0, reentrancy-level=NON-REENTRANT, implemented-entry=Cdd_Pwm_TzIntrEnable
        Cdd_Pwm_TzTripEventDisable: can-enter-exclusive-area=PWM_EXCLUSIVE_AREA_0, reentrancy-level=NON-REENTRANT, implemented-entry=Cdd_Pwm_TzTripEventDisable
        Cdd_Pwm_TzTripEventEnable: can-enter-exclusive-area=PWM_EXCLUSIVE_AREA_0, reentrancy-level=NON-REENTRANT, implemented-entry=Cdd_Pwm_TzTripEventEnable
  bsw implementation Cdd_Pwm_Impl: programming-language=C, sw-version=10.01.00, vendor-id=44, ar-release-version=4.3.1, behavior=Cdd_Pwm_Behavior, vendor-specific-module-def=Cdd_Pwm
    code-descriptors:
      code Files
        artifact-descriptors:
          short-label=V0::Cdd_Pwm_Priv.c, category=SWSRC
          short-label=V0::Cdd_Pwm_Priv.h, category=SWHDR
          short-label=V0::Cdd_Pwm_Sfo.c, category=SWSRC
          short-label=V0::Cdd_Pwm_Sfo.h, category=SWHDR
          short-label=V0::Cdd_Pwm_Types.h, category=SWHDR
          short-label=generate::include::Cdd_Pwm_Cfg.h, category=SWHDR
          short-label=generate::src::Cdd_Pwm_Cfg.c, category=SWSRC
          short-label=generate::src::Cdd_Pwm_PBcfg.c, category=SWSRC
          short-label=include::Cdd_Pwm.h, category=SWHDR
          short-label=include::Cdd_Pwm_Irq.h, category=SWHDR
          short-label=src::Cdd_Pwm.c, category=SWSRC
          short-label=src::Cdd_Pwm_Irq.c, category=SWSRC
    compiler tiarmclang: name=TI ARM Clang, options=-mcpu=cortex-r5 -mfpu=vfpv3-d16 -mfloat-abi=hard -c -mlittle-endian -ffunction-sections -gdwarf-3 -Werror -Os -x -save-temps -mthumb -DAM263PX_SIP_PACKAGE -DAM263PX_PLATFORM -DAM263PX_R_PACKAGE -DAM263PX_C_PACKAGE, vendor=Texas Instruments, version=4.0.0
    linker tiarmlnk: name=TI ARM Clang Linker, options=-mcpu=cortex-r5 -Wl,--ram_model -Wl,--reread_libs -Wl,--warn_sections -qq -Wl,--emit_warnings_as_errors --diag_suppress=10068 --diag_suppress=10063, vendor=Texas Instruments, version=4.0.0
    resource consumption ResourceConsumption
      8 x memory section:
        CDD_PWM_CODE: alignment=UNSPECIFIED, sw-addrmethod=CODE, symbol=CODE
        CDD_PWM_CONFIG_DATA: alignment=UNSPECIFIED, sw-addrmethod=CONFIG_DATA, symbol=CONFIG_DATA
        CDD_PWM_ISR_CODE: alignment=UNSPECIFIED, sw-addrmethod=CODE, symbol=ISR_CODE
        CDD_PWM_VAR_INIT_8: alignment=8, sw-addrmethod=VAR_INIT, symbol=VAR_INIT_8
        CDD_PWM_VAR_INIT_32: alignment=32, sw-addrmethod=VAR_INIT, symbol=VAR_INIT_32
        CDD_PWM_VAR_NO_INIT_16: alignment=16, sw-addrmethod=VAR_NO_INIT, symbol=VAR_NO_INIT_16
        CDD_PWM_VAR_NO_INIT_32: alignment=32, sw-addrmethod=VAR_NO_INIT, symbol=VAR_NO_INIT_32
        CDD_PWM_VAR_NO_INIT_UNSPECIFIED: alignment=UNSPECIFIED, sw-addrmethod=VAR_NO_INIT, symbol=VAR_NO_INIT_UNSPECIFIED
package /Cdd_Pwm_TI_AM263px/Cdd_Pwm_ModuleEntry
  308 x bsw module entry, all with is-synchronous=true, sw-service-impl-policy=STANDARD, bsw-entry-kind=CONCRETE:
    Cdd_Pwm_ChopperCfg: service-id=18, is-reentrant=false, call-type=REGULAR, execution-context=UNSPECIFIED
    Cdd_Pwm_ChopperEnable: service-id=19, is-reentrant=false, call-type=REGULAR, execution-context=UNSPECIFIED
    Cdd_Pwm_ClearCounterStatus: service-id=21, is-reentrant=false, call-type=REGULAR, execution-context=UNSPECIFIED
    Cdd_Pwm_CounterComparatorCfg: service-id=44, is-reentrant=false, call-type=REGULAR, execution-context=UNSPECIFIED
    Cdd_Pwm_DeInit: service-id=1, is-reentrant=false, call-type=REGULAR, execution-context=UNSPECIFIED
    Cdd_Pwm_DeadbandBypass: service-id=17, is-reentrant=false, call-type=REGULAR, execution-context=UNSPECIFIED
    Cdd_Pwm_SetRisingEdgeDelay: service-id=40, is-reentrant=false, call-type=REGULAR, execution-context=UNSPECIFIED
    Cdd_Pwm_SetFallingEdgeDelay: service-id=41, is-reentrant=false, call-type=REGULAR, execution-context=UNSPECIFIED
    Cdd_Pwm_SetMinDeadbandDelay: service-id=47, is-reentrant=false, call-type=REGULAR, execution-context=UNSPECIFIED
    Cdd_Pwm_HrSetRisingEdgeDelay: service-id=45, is-reentrant=false, call-type=REGULAR, execution-context=UNSPECIFIED
    Cdd_Pwm_HrSetFallingEdgeDelay: service-id=46, is-reentrant=false, call-type=REGULAR, execution-context=UNSPECIFIED
    Cdd_Pwm_DeadbandCfg: service-id=16, is-reentrant=false, call-type=REGULAR, execution-context=UNSPECIFIED
    Cdd_Pwm_DisableNotification: service-id=9, is-reentrant=false, call-type=REGULAR, execution-context=UNSPECIFIED
    Cdd_Pwm_EnableNotification: service-id=10, is-reentrant=false, call-type=REGULAR, execution-context=UNSPECIFIED
    Cdd_Pwm_EtGetEventCount: service-id=24, is-reentrant=true, call-type=REGULAR, execution-context=UNSPECIFIED
    Cdd_Pwm_EtIntrClear: service-id=23, is-reentrant=false, call-type=REGULAR, execution-context=UNSPECIFIED
    Cdd_Pwm_EtIntrStatus: service-id=22, is-reentrant=true, call-type=REGULAR, execution-context=UNSPECIFIED
    Cdd_Pwm_G0_Ch0Isr: is-reentrant=false, call-type=INTERRUPT, execution-context=INTERRUPT-CAT-1
    Cdd_Pwm_G0_Ch{10..19}Isr: is-reentrant=false, call-type=INTERRUPT, execution-context=INTERRUPT-CAT-1
    Cdd_Pwm_G0_Ch1Isr: is-reentrant=false, call-type=INTERRUPT, execution-context=INTERRUPT-CAT-1
    Cdd_Pwm_G0_Ch{20..29}Isr: is-reentrant=false, call-type=INTERRUPT, execution-context=INTERRUPT-CAT-1
    Cdd_Pwm_G0_Ch2Isr: is-reentrant=false, call-type=INTERRUPT, execution-context=INTERRUPT-CAT-1
    Cdd_Pwm_G0_Ch30Isr: is-reentrant=false, call-type=INTERRUPT, execution-context=INTERRUPT-CAT-1
    Cdd_Pwm_G0_Ch31Isr: is-reentrant=false, call-type=INTERRUPT, execution-context=INTERRUPT-CAT-1
    Cdd_Pwm_G0_Ch{3..9}Isr: is-reentrant=false, call-type=INTERRUPT, execution-context=INTERRUPT-CAT-1
    Cdd_Pwm_G0_TzCh0Isr: is-reentrant=false, call-type=INTERRUPT, execution-context=INTERRUPT-CAT-1
    Cdd_Pwm_G0_TzCh{10..19}Isr: is-reentrant=false, call-type=INTERRUPT, execution-context=INTERRUPT-CAT-1
    Cdd_Pwm_G0_TzCh1Isr: is-reentrant=false, call-type=INTERRUPT, execution-context=INTERRUPT-CAT-1
    Cdd_Pwm_G0_TzCh{20..29}Isr: is-reentrant=false, call-type=INTERRUPT, execution-context=INTERRUPT-CAT-1
    Cdd_Pwm_G0_TzCh2Isr: is-reentrant=false, call-type=INTERRUPT, execution-context=INTERRUPT-CAT-1
    Cdd_Pwm_G0_TzCh30Isr: is-reentrant=false, call-type=INTERRUPT, execution-context=INTERRUPT-CAT-1
    Cdd_Pwm_G0_TzCh31Isr: is-reentrant=false, call-type=INTERRUPT, execution-context=INTERRUPT-CAT-1
    Cdd_Pwm_G0_TzCh{3..9}Isr: is-reentrant=false, call-type=INTERRUPT, execution-context=INTERRUPT-CAT-1
    Cdd_Pwm_G1_Ch0Isr: is-reentrant=false, call-type=INTERRUPT, execution-context=INTERRUPT-CAT-1
    Cdd_Pwm_G1_Ch{10..19}Isr: is-reentrant=false, call-type=INTERRUPT, execution-context=INTERRUPT-CAT-1
    Cdd_Pwm_G1_Ch1Isr: is-reentrant=false, call-type=INTERRUPT, execution-context=INTERRUPT-CAT-1
    Cdd_Pwm_G1_Ch{20..29}Isr: is-reentrant=false, call-type=INTERRUPT, execution-context=INTERRUPT-CAT-1
    Cdd_Pwm_G1_Ch2Isr: is-reentrant=false, call-type=INTERRUPT, execution-context=INTERRUPT-CAT-1
    Cdd_Pwm_G1_Ch30Isr: is-reentrant=false, call-type=INTERRUPT, execution-context=INTERRUPT-CAT-1
    Cdd_Pwm_G1_Ch31Isr: is-reentrant=false, call-type=INTERRUPT, execution-context=INTERRUPT-CAT-1
    Cdd_Pwm_G1_Ch{3..9}Isr: is-reentrant=false, call-type=INTERRUPT, execution-context=INTERRUPT-CAT-1
    Cdd_Pwm_G1_TzCh0Isr: is-reentrant=false, call-type=INTERRUPT, execution-context=INTERRUPT-CAT-1
    Cdd_Pwm_G1_TzCh{10..19}Isr: is-reentrant=false, call-type=INTERRUPT, execution-context=INTERRUPT-CAT-1
    Cdd_Pwm_G1_TzCh1Isr: is-reentrant=false, call-type=INTERRUPT, execution-context=INTERRUPT-CAT-1
    Cdd_Pwm_G1_TzCh{20..29}Isr: is-reentrant=false, call-type=INTERRUPT, execution-context=INTERRUPT-CAT-1
    Cdd_Pwm_G1_TzCh2Isr: is-reentrant=false, call-type=INTERRUPT, execution-context=INTERRUPT-CAT-1
    Cdd_Pwm_G1_TzCh30Isr: is-reentrant=false, call-type=INTERRUPT, execution-context=INTERRUPT-CAT-1
    Cdd_Pwm_G1_TzCh31Isr: is-reentrant=false, call-type=INTERRUPT, execution-context=INTERRUPT-CAT-1
    Cdd_Pwm_G1_TzCh{3..9}Isr: is-reentrant=false, call-type=INTERRUPT, execution-context=INTERRUPT-CAT-1
    Cdd_Pwm_G2_Ch0Isr: is-reentrant=false, call-type=INTERRUPT, execution-context=INTERRUPT-CAT-1
    Cdd_Pwm_G2_Ch{10..19}Isr: is-reentrant=false, call-type=INTERRUPT, execution-context=INTERRUPT-CAT-1
    Cdd_Pwm_G2_Ch1Isr: is-reentrant=false, call-type=INTERRUPT, execution-context=INTERRUPT-CAT-1
    Cdd_Pwm_G2_Ch{20..29}Isr: is-reentrant=false, call-type=INTERRUPT, execution-context=INTERRUPT-CAT-1
    Cdd_Pwm_G2_Ch2Isr: is-reentrant=false, call-type=INTERRUPT, execution-context=INTERRUPT-CAT-1
    Cdd_Pwm_G2_Ch30Isr: is-reentrant=false, call-type=INTERRUPT, execution-context=INTERRUPT-CAT-1
    Cdd_Pwm_G2_Ch31Isr: is-reentrant=false, call-type=INTERRUPT, execution-context=INTERRUPT-CAT-1
    Cdd_Pwm_G2_Ch{3..9}Isr: is-reentrant=false, call-type=INTERRUPT, execution-context=INTERRUPT-CAT-1
    Cdd_Pwm_G2_TzCh0Isr: is-reentrant=false, call-type=INTERRUPT, execution-context=INTERRUPT-CAT-1
    Cdd_Pwm_G2_TzCh{10..19}Isr: is-reentrant=false, call-type=INTERRUPT, execution-context=INTERRUPT-CAT-1
    Cdd_Pwm_G2_TzCh1Isr: is-reentrant=false, call-type=INTERRUPT, execution-context=INTERRUPT-CAT-1
    Cdd_Pwm_G2_TzCh{20..29}Isr: is-reentrant=false, call-type=INTERRUPT, execution-context=INTERRUPT-CAT-1
    Cdd_Pwm_G2_TzCh2Isr: is-reentrant=false, call-type=INTERRUPT, execution-context=INTERRUPT-CAT-1
    Cdd_Pwm_G2_TzCh30Isr: is-reentrant=false, call-type=INTERRUPT, execution-context=INTERRUPT-CAT-1
    Cdd_Pwm_G2_TzCh31Isr: is-reentrant=false, call-type=INTERRUPT, execution-context=INTERRUPT-CAT-1
    Cdd_Pwm_G2_TzCh{3..9}Isr: is-reentrant=false, call-type=INTERRUPT, execution-context=INTERRUPT-CAT-1
    Cdd_Pwm_G3_Ch0Isr: is-reentrant=false, call-type=INTERRUPT, execution-context=INTERRUPT-CAT-1
    Cdd_Pwm_G3_Ch{10..19}Isr: is-reentrant=false, call-type=INTERRUPT, execution-context=INTERRUPT-CAT-1
    Cdd_Pwm_G3_Ch1Isr: is-reentrant=false, call-type=INTERRUPT, execution-context=INTERRUPT-CAT-1
    Cdd_Pwm_G3_Ch{20..29}Isr: is-reentrant=false, call-type=INTERRUPT, execution-context=INTERRUPT-CAT-1
    Cdd_Pwm_G3_Ch2Isr: is-reentrant=false, call-type=INTERRUPT, execution-context=INTERRUPT-CAT-1
    Cdd_Pwm_G3_Ch30Isr: is-reentrant=false, call-type=INTERRUPT, execution-context=INTERRUPT-CAT-1
    Cdd_Pwm_G3_Ch31Isr: is-reentrant=false, call-type=INTERRUPT, execution-context=INTERRUPT-CAT-1
    Cdd_Pwm_G3_Ch{3..9}Isr: is-reentrant=false, call-type=INTERRUPT, execution-context=INTERRUPT-CAT-1
    Cdd_Pwm_G3_TzCh0Isr: is-reentrant=false, call-type=INTERRUPT, execution-context=INTERRUPT-CAT-1
    Cdd_Pwm_G3_TzCh{10..19}Isr: is-reentrant=false, call-type=INTERRUPT, execution-context=INTERRUPT-CAT-1
    Cdd_Pwm_G3_TzCh1Isr: is-reentrant=false, call-type=INTERRUPT, execution-context=INTERRUPT-CAT-1
    Cdd_Pwm_G3_TzCh{20..29}Isr: is-reentrant=false, call-type=INTERRUPT, execution-context=INTERRUPT-CAT-1
    Cdd_Pwm_G3_TzCh2Isr: is-reentrant=false, call-type=INTERRUPT, execution-context=INTERRUPT-CAT-1
    Cdd_Pwm_G3_TzCh30Isr: is-reentrant=false, call-type=INTERRUPT, execution-context=INTERRUPT-CAT-1
    Cdd_Pwm_G3_TzCh31Isr: is-reentrant=false, call-type=INTERRUPT, execution-context=INTERRUPT-CAT-1
    Cdd_Pwm_G3_TzCh{3..9}Isr: is-reentrant=false, call-type=INTERRUPT, execution-context=INTERRUPT-CAT-1
    Cdd_Pwm_GetCounter: service-id=6, is-reentrant=true, call-type=REGULAR, execution-context=UNSPECIFIED
    Cdd_Pwm_GetCounterStatus: service-id=4, is-reentrant=true, call-type=REGULAR, execution-context=UNSPECIFIED
    Cdd_Pwm_GetVersionInfo: service-id=11, is-reentrant=true, call-type=REGULAR, execution-context=UNSPECIFIED
    Cdd_Pwm_HrSetPeriodDutyPhase: service-id=33, is-reentrant=false, call-type=REGULAR, execution-context=UNSPECIFIED
    Cdd_Pwm_HrSetPhaseShift: service-id=42, is-reentrant=false, call-type=REGULAR, execution-context=UNSPECIFIED
    Cdd_Pwm_HrSetTimeBasePeriod: service-id=43, is-reentrant=false, call-type=REGULAR, execution-context=UNSPECIFIED
    Cdd_Pwm_HrSetCounterCompareValue: service-id=44, is-reentrant=false, call-type=REGULAR, execution-context=UNSPECIFIED
    Cdd_Pwm_HrSetXcmpRegValue: service-id=49, is-reentrant=false, call-type=REGULAR, execution-context=UNSPECIFIED
    Cdd_Pwm_HrSfoCalibration: service-id=34, is-reentrant=false, call-type=REGULAR, execution-context=UNSPECIFIED
    Cdd_Pwm_HrSfoStatus: service-id=35, is-reentrant=true, call-type=REGULAR, execution-context=UNSPECIFIED
    Cdd_Pwm_Init: service-id=0, is-reentrant=false, call-type=REGULAR, execution-context=UNSPECIFIED
    Cdd_Pwm_RegisterReadback: service-id=13, is-reentrant=false, call-type=REGULAR, execution-context=UNSPECIFIED
    Cdd_Pwm_SetAbsoluteThreshold: service-id=7, is-reentrant=false, call-type=REGULAR, execution-context=UNSPECIFIED
    Cdd_Pwm_SetAdcTrigger: service-id=25, is-reentrant=false, call-type=REGULAR, execution-context=UNSPECIFIED
    Cdd_Pwm_SetOutputToIdle: service-id=15, is-reentrant=false, call-type=REGULAR, execution-context=UNSPECIFIED
    Cdd_Pwm_SetPeriodDutyPhase: service-id=14, is-reentrant=false, call-type=REGULAR, execution-context=UNSPECIFIED
    Cdd_Pwm_SetTimeBaseCounterMode: service-id=36, is-reentrant=false, call-type=REGULAR, execution-context=UNSPECIFIED
    Cdd_Pwm_SetPhaseShift: service-id=37, is-reentrant=false, call-type=REGULAR, execution-context=UNSPECIFIED
    Cdd_Pwm_SetTimeBasePeriod: service-id=38, is-reentrant=false, call-type=REGULAR, execution-context=UNSPECIFIED
    Cdd_Pwm_SetCounterCompareValue: service-id=39, is-reentrant=false, call-type=REGULAR, execution-context=UNSPECIFIED
    Cdd_Pwm_SetXcmpRegValue: service-id=48, is-reentrant=false, call-type=REGULAR, execution-context=UNSPECIFIED
    Cdd_Pwm_SetXMinMaxRegValue: service-id=50, is-reentrant=false, call-type=REGULAR, execution-context=UNSPECIFIED
    Cdd_Pwm_SetCmpShadowRegValue: service-id=51, is-reentrant=false, call-type=REGULAR, execution-context=UNSPECIFIED
    Cdd_Pwm_SetPinAction: service-id=5, is-reentrant=false, call-type=REGULAR, execution-context=TASK
    Cdd_Pwm_SetRelativeThreshold: service-id=8, is-reentrant=false, call-type=REGULAR, execution-context=UNSPECIFIED
    Cdd_Pwm_StartChannelCounter: service-id=2, is-reentrant=false, call-type=REGULAR, execution-context=UNSPECIFIED
    Cdd_Pwm_StopChannelCounter: service-id=3, is-reentrant=false, call-type=REGULAR, execution-context=UNSPECIFIED
    Cdd_Pwm_SyncDisable: service-id=43, is-reentrant=false, call-type=REGULAR, execution-context=UNSPECIFIED
    Cdd_Pwm_SyncEnable: service-id=42, is-reentrant=false, call-type=REGULAR, execution-context=UNSPECIFIED
    Cdd_Pwm_TzEventStatusClear: service-id=32, is-reentrant=false, call-type=REGULAR, execution-context=UNSPECIFIED
    Cdd_Pwm_TzGetEventStatus: service-id=31, is-reentrant=false, call-type=REGULAR, execution-context=UNSPECIFIED
    Cdd_Pwm_TzIntrDisable: service-id=30, is-reentrant=false, call-type=REGULAR, execution-context=UNSPECIFIED
    Cdd_Pwm_TzIntrEnable: service-id=29, is-reentrant=false, call-type=REGULAR, execution-context=UNSPECIFIED
    Cdd_Pwm_TzTripEventDisable: service-id=28, is-reentrant=false, call-type=REGULAR, execution-context=UNSPECIFIED
    Cdd_Pwm_TzTripEventEnable: service-id=27, is-reentrant=false, call-type=REGULAR, execution-context=UNSPECIFIED
