AUTOSAR XML (schema 00044)
package /Dio_TI_AM263px
  bsw module description Dio: module-id=120
    expected-entrys:
      Dio_FlipChannel
      Dio_GetVersionInfo
      Dio_ReadChannel
      Dio_ReadChannelGroup
      Dio_ReadPort
      Dio_WriteChannel
      Dio_WriteChannelGroup
      Dio_WritePort
    bsw module dependency Dem: target-module-id=54, target-module=Dem
    bsw module dependency Det: target-module-id=15, target-module=Det
    bsw internal behavior Dio_Behaviour
      exclusive area DIO_EXCLUSIVE_AREA_0
      8 x bsw called entity, all with reentrancy-level=SINGLE-CORE-REENTRANT:
        Dio_FlipChannel: implemented-entry=Dio_FlipChannel
          bsw direct call point Det_ReportError: called-entry=Det_ReportError
        Dio_GetVersionInfo: implemented-entry=Dio_GetVersionInfo
          bsw direct call point Det_ReportError: called-entry=Det_ReportError
        Dio_ReadChannel: implemented-entry=Dio_ReadChannel
          bsw direct call point Det_ReportError: called-entry=Det_ReportError
        Dio_ReadChannelGroup: implemented-entry=Dio_ReadChannelGroup
          bsw direct call point Det_ReportError: called-entry=Det_ReportError
        Dio_ReadPort: implemented-entry=Dio_ReadPort
          bsw direct call point Det_ReportError: called-entry=Det_ReportError
        Dio_WriteChannel: can-enter-exclusive-area=DIO_EXCLUSIVE_AREA_0, implemented-entry=Dio_WriteChannel
          bsw direct call point Dem_SetEventStatus: called-entry=Dem_SetEventStatus
          bsw direct call point Det_ReportError: called-entry=Det_ReportError
        Dio_WriteChannelGroup: can-enter-exclusive-area=DIO_EXCLUSIVE_AREA_0, implemented-entry=Dio_WriteChannelGroup
          bsw direct call point Det_ReportError: called-entry=Det_ReportError
        Dio_WritePort: can-enter-exclusive-area=DIO_EXCLUSIVE_AREA_0, implemented-entry=Dio_WritePort
          bsw direct call point Dem_SetEventStatus: called-entry=Dem_SetEventStatus
          bsw direct call point Det_ReportError: called-entry=Det_ReportError
  bsw implementation Dio_Impl: programming-language=C, sw-version=10.1.0, vendor-id=44, ar-release-version=4.3.1 0, behavior=Dio_Behaviour, vendor-specific-module-def=Dio
    code-descriptors:
      code Files
        artifact-descriptors:
          short-label=V0::Dio_Priv.c, category=SWSRC
          short-label=V0::Dio_Priv.h, category=SWHDR
          short-label=generate::include::Dio_Cfg.h, category=SWHDR
          short-label=generate::src::Dio_Cfg.c, category=SWSRC
          short-label=generate::src::Dio_Lcfg.c, category=SWSRC
          short-label=include::Dio.h, category=SWHDR
          short-label=src::Dio.c, category=SWSRC
    compiler tiarmclang: name=TI ARM Clang, vendor=Texas Instruments, version=4.0.0
    linker tiarmlnk: name=TI ARM Clang Linker, vendor=Texas Instruments, version=4.0.0
    resource consumption ResourceConsumption
      4 x memory section:
        DIO_CODE: alignment=UNSPECIFIED, sw-addrmethod=CODE, symbol=CODE
        DIO_CONFIG_DATA: alignment=UNSPECIFIED, sw-addrmethod=CONST_PBCFG, symbol=CONFIG_DATA
        DIO_CONST_32: alignment=32, sw-addrmethod=CONST, symbol=CONST_32
        DIO_CONST_UNSPECIFIED: alignment=UNSPECIFIED, sw-addrmethod=CONST, symbol=CONST_UNSPECIFIED
package /Dio_TI_AM263px/BSWModuleEntry
  8 x bsw module entry, all with is-reentrant=true, is-synchronous=true, call-type=REGULAR, execution-context=UNSPECIFIED, sw-service-impl-policy=STANDARD, bsw-entry-kind=CONCRETE:
    Dio_FlipChannel: service-id=11
    Dio_GetVersionInfo: service-id=12
    Dio_ReadChannel: service-id=0
    Dio_ReadChannelGroup: service-id=4
    Dio_ReadPort: service-id=2
    Dio_WriteChannel: service-id=1
    Dio_WriteChannelGroup: service-id=5
    Dio_WritePort: service-id=3
