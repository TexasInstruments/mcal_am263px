AUTOSAR XML (schema 00044)
package /EthTrcv_TI_AM263Px
  bsw module description EthTrcv: module-id=73
    implemented-entrys:
      EthTrcv_GetVersionInfo
      EthTrcv_Init
      EthTrcv_SetTransceiverMode
      EthTrcv_GetTransceiverMode
      EthTrcv_StartAutoNegotiation
      EthTrcv_GetLinkState
      EthTrcv_GetBaudRate
      EthTrcv_GetDuplexMode
      EthTrcv_SetPhyTxMode
      EthTrcv_GetCableDiagnosticsResult
      EthTrcv_GetPhyIdentifier
      EthTrcv_SetPhyTestMode
      EthTrcv_ReadMiiIndication
      EthTrcv_WriteMiiIndication
      EthTrcv_MainFunction
    bsw module dependency Dem: target-module-id=54, target-module=Dem
    bsw module dependency Os: target-module-id=01, target-module=Os
    bsw module dependency Det: target-module-id=15, target-module=Det
    bsw internal behavior EthTrcv_Behavior
      exclusive area ETHTRCV_EXCLUSIVE_AREA_0
      14 x bsw called entity:
        EthTrcv_GetVersionInfo: implemented-entry=EthTrcv_GetVersionInfo
          bsw direct call point Det_ReportError: called-entry=Det_ReportError
        EthTrcv_Init: can-enter-exclusive-area=ETHTRCV_EXCLUSIVE_AREA_0, reentrancy-level=NON-REENTRANT, implemented-entry=EthTrcv_Init
          4 x bsw direct call point:
            Det_ReportError: called-entry=Det_ReportError
            Dem_SetEventStatus: called-entry=Dem_SetEventStatus
            GetCounterValue: called-entry=GetCounterValue
            GetElapsedValue: called-entry=GetElapsedValue
        EthTrcv_SetTransceiverMode: can-enter-exclusive-area=ETHTRCV_EXCLUSIVE_AREA_0, reentrancy-level=NON-REENTRANT, implemented-entry=EthTrcv_SetTransceiverMode
          bsw direct call point Det_ReportError: called-entry=Det_ReportError
          bsw direct call point Dem_SetEventStatus: called-entry=Dem_SetEventStatus
        EthTrcv_GetTransceiverMode: can-enter-exclusive-area=ETHTRCV_EXCLUSIVE_AREA_0, reentrancy-level=NON-REENTRANT, implemented-entry=EthTrcv_GetTransceiverMode
          bsw direct call point Det_ReportError: called-entry=Det_ReportError
        EthTrcv_StartAutoNegotiation: can-enter-exclusive-area=ETHTRCV_EXCLUSIVE_AREA_0, reentrancy-level=NON-REENTRANT, implemented-entry=EthTrcv_StartAutoNegotiation
          4 x bsw direct call point:
            Det_ReportError: called-entry=Det_ReportError
            Dem_SetEventStatus: called-entry=Dem_SetEventStatus
            GetCounterValue: called-entry=GetCounterValue
            GetElapsedValue: called-entry=GetElapsedValue
        EthTrcv_GetLinkState: can-enter-exclusive-area=ETHTRCV_EXCLUSIVE_AREA_0, reentrancy-level=NON-REENTRANT, implemented-entry=EthTrcv_GetLinkState
          bsw direct call point Det_ReportError: called-entry=Det_ReportError
          bsw direct call point GetCounterValue: called-entry=GetCounterValue
          bsw direct call point GetElapsedValue: called-entry=GetElapsedValue
        EthTrcv_GetBaudRate: can-enter-exclusive-area=ETHTRCV_EXCLUSIVE_AREA_0, reentrancy-level=NON-REENTRANT, implemented-entry=EthTrcv_GetBaudRate
          bsw direct call point Det_ReportError: called-entry=Det_ReportError
          bsw direct call point Dem_SetEventStatus: called-entry=Dem_SetEventStatus
        EthTrcv_GetDuplexMode: can-enter-exclusive-area=ETHTRCV_EXCLUSIVE_AREA_0, reentrancy-level=NON-REENTRANT, implemented-entry=EthTrcv_GetDuplexMode
          bsw direct call point Det_ReportError: called-entry=Det_ReportError
          bsw direct call point Dem_SetEventStatus: called-entry=Dem_SetEventStatus
        EthTrcv_SetPhyTxMode: can-enter-exclusive-area=ETHTRCV_EXCLUSIVE_AREA_0, reentrancy-level=NON-REENTRANT, implemented-entry=EthTrcv_SetPhyTxMode
          bsw direct call point Det_ReportError: called-entry=Det_ReportError
          bsw direct call point Dem_SetEventStatus: called-entry=Dem_SetEventStatus
        EthTrcv_GetCableDiagnosticsResult: can-enter-exclusive-area=ETHTRCV_EXCLUSIVE_AREA_0, reentrancy-level=NON-REENTRANT, implemented-entry=EthTrcv_GetCableDiagnosticsResult
          bsw direct call point Det_ReportError: called-entry=Det_ReportError
          bsw direct call point Dem_SetEventStatus: called-entry=Dem_SetEventStatus
        EthTrcv_GetPhyIdentifier: can-enter-exclusive-area=ETHTRCV_EXCLUSIVE_AREA_0, reentrancy-level=NON-REENTRANT, implemented-entry=EthTrcv_GetPhyIdentifier
          bsw direct call point Det_ReportError: called-entry=Det_ReportError
        EthTrcv_SetPhyTestMode: can-enter-exclusive-area=ETHTRCV_EXCLUSIVE_AREA_0, reentrancy-level=NON-REENTRANT, implemented-entry=EthTrcv_SetPhyTestMode
          bsw direct call point Det_ReportError: called-entry=Det_ReportError
          bsw direct call point Dem_SetEventStatus: called-entry=Dem_SetEventStatus
        EthTrcv_ReadMiiIndication: reentrancy-level=NON-REENTRANT, implemented-entry=EthTrcv_ReadMiiIndication
        EthTrcv_WriteMiiIndication: reentrancy-level=NON-REENTRANT, implemented-entry=EthTrcv_WriteMiiIndication
      bsw schedulable entity EthTrcv_MainFunction: can-enter-exclusive-area=ETHTRCV_EXCLUSIVE_AREA_0, reentrancy-level=SINGLE-CORE-REENTRANT, implemented-entry=EthTrcv_MainFunction
        bsw direct call point Det_ReportError: called-entry=Det_ReportError
        bsw direct call point EthIf_TrcvModeIndication: called-entry=EthIf_TrcvModeIndication
        bsw direct call point Dem_SetEventStatus: called-entry=Dem_SetEventStatus
      bsw timing event EthTrcvTimingEvent_MainFunction: starts-on-event=EthTrcv_MainFunction, period=0.005
  bsw implementation EthTrcv_Impl: programming-language=C, sw-version=10.01.00, vendor-id=44, ar-release-version=4.3.1, behavior=EthTrcv_Behavior, vendor-specific-module-def=EthTrcv
    code-descriptors:
      code Files
        artifact-descriptors:
          short-label=include::EthTrcv_Cfg.h, category=SWHDR
          short-label=src::EthTrcv_Cfg.c, category=SWSRC
          short-label=src::EthTrcv_Lcfg.c, category=SWSRC
          short-label=src::EthTrcv_PBcfg.c, category=SWSRC
          short-label=include::EthTrcv_Types.h, category=SWHDR
          short-label=src::EthTrcv.c, category=SWSRC
          short-label=include::EthTrcv.h, category=SWHDR
          short-label=V0::EthTrcv_Priv.c, category=SWSRC
          short-label=V0::EthTrcv_Priv.h, category=SWHDR
    compiler tiarmclang: name=TI ARM Clang, options=-mcpu=cortex-r5 -mfpu=vfpv3-d16 -mfloat-abi=hard -c -mlittle-endian -ffunction-sections -gdwarf-3 -Werror -Os -x -save-temps -mthumb -DAM263PX_SIP_PACKAGE -DAM263PX_PLATFORM -DAM263PX_R_PACKAGE -DAM263PX_C_PACKAGE, vendor=Texas Instruments, version=4.0.0
    linker tiarmlnk: name=TI ARM Clang Linker, options=-mcpu=cortex-r5 -Wl,--ram_model -Wl,--reread_libs -Wl,--warn_sections -qq -Wl,--emit_warnings_as_errors --diag_suppress=10068 --diag_suppress=10063, vendor=Texas Instruments, version=4.0.0
    resource consumption ResourceConsumption
      6 x memory section:
        ETHTRCV_CODE: sw-addrmethod=CODE, symbol=CODE
        ETHTRCV_CONFIG_DATA: alignment=UNSPECIFIED, sw-addrmethod=CONFIG_DATA, symbol=CONFIG_DATA
        ETHTRCV_VAR_INIT_32: alignment=32, sw-addrmethod=VAR_INIT, symbol=VAR_INIT_32
        ETHTRCV_VAR_INIT_UNSPECIFIED: alignment=UNSPECIFIED, sw-addrmethod=VAR_INIT, symbol=VAR_INIT_UNSPECIFIED
        ETHTRCV_VAR_NO_INIT_16: alignment=16, sw-addrmethod=VAR_NO_INIT, symbol=VAR_NO_INIT_16
        ETHTRCV_VAR_NO_INIT_UNSPECIFIED: alignment=UNSPECIFIED, sw-addrmethod=VAR_NO_INIT, symbol=VAR_NO_INIT_UNSPECIFIED
package /EthTrcv_TI_AM263Px/EthTrcv_ModuleEntry
  20 x bsw module entry, all with sw-service-impl-policy=STANDARD, bsw-entry-kind=CONCRETE:
    EthTrcv_GetVersionInfo: service-id=0x0b, is-reentrant=true, is-synchronous=true, call-type=REGULAR, execution-context=UNSPECIFIED
    EthTrcv_Init: service-id=0x01, is-reentrant=false, is-synchronous=true, call-type=REGULAR, execution-context=UNSPECIFIED
    EthTrcv_SetTransceiverMode: service-id=0x03, is-reentrant=false, is-synchronous=false, call-type=REGULAR, execution-context=UNSPECIFIED
    EthTrcv_GetTransceiverMode: service-id=0x04, is-reentrant=false, is-synchronous=true, call-type=REGULAR, execution-context=UNSPECIFIED
    EthTrcv_SetTransceiverWakeupMode: service-id=0x0d, is-reentrant=false, is-synchronous=true, call-type=REGULAR, execution-context=UNSPECIFIED
    EthTrcv_GetTransceiverWakeupMode: service-id=0x0e, is-reentrant=false, is-synchronous=true, call-type=REGULAR, execution-context=UNSPECIFIED
    EthTrcv_CheckWakeup: service-id=0x0f, is-reentrant=true, is-synchronous=true, call-type=REGULAR, execution-context=UNSPECIFIED
    EthTrcv_StartAutoNegotiation: service-id=0x05, is-reentrant=false, is-synchronous=true, call-type=REGULAR, execution-context=UNSPECIFIED
    EthTrcv_GetLinkState: service-id=0x06, is-reentrant=false, is-synchronous=true, call-type=REGULAR, execution-context=UNSPECIFIED
    EthTrcv_GetBaudRate: service-id=0x07, is-reentrant=false, is-synchronous=true, call-type=REGULAR, execution-context=UNSPECIFIED
    EthTrcv_GetDuplexMode: service-id=0x08, is-reentrant=false, is-synchronous=true, call-type=REGULAR, execution-context=UNSPECIFIED
    EthTrcv_SetPhyTestMode: service-id=0x11, is-reentrant=false, is-synchronous=true, call-type=REGULAR, execution-context=UNSPECIFIED
    EthTrcv_SetPhyLoopbackMode: service-id=0x12, is-reentrant=false, is-synchronous=true, call-type=REGULAR, execution-context=UNSPECIFIED
    EthTrcv_GetPhySignalQuality: service-id=0x10, is-reentrant=false, is-synchronous=true, call-type=REGULAR, execution-context=UNSPECIFIED
    EthTrcv_SetPhyTxMode: service-id=0x13, is-reentrant=false, is-synchronous=true, call-type=REGULAR, execution-context=UNSPECIFIED
    EthTrcv_GetCableDiagnosticsResult: service-id=0x14, is-reentrant=false, is-synchronous=true, call-type=REGULAR, execution-context=UNSPECIFIED
    EthTrcv_GetPhyIdentifier: service-id=0x15, is-reentrant=false, is-synchronous=true, call-type=REGULAR, execution-context=UNSPECIFIED
    EthTrcv_ReadMiiIndication: service-id=0x09, is-reentrant=false, is-synchronous=true, call-type=REGULAR, execution-context=UNSPECIFIED
    EthTrcv_WriteMiiIndication: service-id=0x0a, is-reentrant=false, is-synchronous=true, call-type=REGULAR, execution-context=UNSPECIFIED
    EthTrcv_MainFunction: service-id=0x0c, is-reentrant=false, is-synchronous=true, call-type=SCHEDULED, execution-context=TASK
