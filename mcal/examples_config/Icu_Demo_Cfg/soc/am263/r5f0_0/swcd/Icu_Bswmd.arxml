AUTOSAR XML (schema 00044)
package /Icu_TI_AM263x
  bsw module description Icu: category=BSW_MODULE, module-id=122
    implemented-entrys:
      Icu_Deinit
      Icu_DisableEdgeCount
      Icu_DisableEdgeDetection
      Icu_DisableNotification
      Icu_EnableEdgeCount
      Icu_EnableEdgeDetection
      Icu_EnableNotification
      Icu_GetDutyCycleValues
      Icu_GetEdgeNumbers
      Icu_GetInputState
      Icu_GetTimeElapsed
      Icu_GetTimestampIndex
      Icu_GetVersionInfo
      Icu_Init
      Icu_IntISR_Fun
      Icu_RegisterReadback
      Icu_ResetEdgeCount
      Icu_SetActivationCondition
      Icu_StartSignalMeasurement
      Icu_StartTimestamp
      Icu_StopSignalMeasurement
      Icu_StopTimestamp
      Icu_ch0Notify
    bsw module dependency Det: target-module-id=15, target-module=Det
    bsw internal behavior Icu_Behavior
      exclusive area ICU_EXCLUSIVE_AREA_0
      14 x bsw called entity:
        Icu_Deinit: reentrancy-level=NON-REENTRANT, implemented-entry=Icu_Deinit
          bsw direct call point Det_ReportError: called-entry=Det_ReportError
        Icu_DisableEdgeCount: can-enter-exclusive-area=ICU_EXCLUSIVE_AREA_0, reentrancy-level=SINGLE-CORE-REENTRANT, implemented-entry=Icu_DisableEdgeCount
          bsw direct call point Det_ReportError: called-entry=Det_ReportError
        Icu_DisableEdgeDetection: can-enter-exclusive-area=ICU_EXCLUSIVE_AREA_0, reentrancy-level=SINGLE-CORE-REENTRANT, implemented-entry=Icu_DisableEdgeDetection
          bsw direct call point Det_ReportError: called-entry=Det_ReportError
        Icu_DisableNotification: can-enter-exclusive-area=ICU_EXCLUSIVE_AREA_0, reentrancy-level=SINGLE-CORE-REENTRANT, implemented-entry=Icu_DisableNotification
          bsw direct call point Det_ReportError: called-entry=Det_ReportError
        Icu_EnableEdgeCount: can-enter-exclusive-area=ICU_EXCLUSIVE_AREA_0, reentrancy-level=SINGLE-CORE-REENTRANT, implemented-entry=Icu_EnableEdgeCount
          bsw direct call point Det_ReportError: called-entry=Det_ReportError
        Icu_EnableEdgeDetection: can-enter-exclusive-area=ICU_EXCLUSIVE_AREA_0, reentrancy-level=SINGLE-CORE-REENTRANT, implemented-entry=Icu_EnableEdgeDetection
          bsw direct call point Det_ReportError: called-entry=Det_ReportError
        Icu_EnableNotification: can-enter-exclusive-area=ICU_EXCLUSIVE_AREA_0, reentrancy-level=SINGLE-CORE-REENTRANT, implemented-entry=Icu_EnableNotification
          bsw direct call point Det_ReportError: called-entry=Det_ReportError
        Icu_GetDutyCycleValues: can-enter-exclusive-area=ICU_EXCLUSIVE_AREA_0, reentrancy-level=SINGLE-CORE-REENTRANT, implemented-entry=Icu_GetDutyCycleValues
          bsw direct call point Det_ReportError: called-entry=Det_ReportError
        Icu_GetEdgeNumbers: can-enter-exclusive-area=ICU_EXCLUSIVE_AREA_0, reentrancy-level=SINGLE-CORE-REENTRANT, implemented-entry=Icu_GetEdgeNumbers
          bsw direct call point Det_ReportError: called-entry=Det_ReportError
        Icu_GetInputState: can-enter-exclusive-area=ICU_EXCLUSIVE_AREA_0, reentrancy-level=SINGLE-CORE-REENTRANT, implemented-entry=Icu_GetInputState
          bsw direct call point Det_ReportError: called-entry=Det_ReportError
        Icu_GetTimeElapsed: can-enter-exclusive-area=ICU_EXCLUSIVE_AREA_0, reentrancy-level=SINGLE-CORE-REENTRANT, implemented-entry=Icu_GetTimeElapsed
          bsw direct call point Det_ReportError: called-entry=Det_ReportError
        Icu_GetTimestampIndex: can-enter-exclusive-area=ICU_EXCLUSIVE_AREA_0, reentrancy-level=SINGLE-CORE-REENTRANT, implemented-entry=Icu_GetTimestampIndex
          bsw direct call point Det_ReportError: called-entry=Det_ReportError
        Icu_GetVersionInfo: can-enter-exclusive-area=ICU_EXCLUSIVE_AREA_0, reentrancy-level=SINGLE-CORE-REENTRANT, implemented-entry=Icu_GetVersionInfo
          bsw direct call point Det_ReportError: called-entry=Det_ReportError
        Icu_Init: reentrancy-level=NON-REENTRANT, implemented-entry=Icu_Init
          bsw direct call point Det_ReportError: called-entry=Det_ReportError
      bsw interrupt entity Icu_IntISR_Fun: reentrancy-level=NON-REENTRANT, implemented-entry=Icu_IntISR_Fun, interrupt-category=CAT-1, interrupt-source=Hardware
        bsw direct call point Det_ReportError: called-entry=Det_ReportError
      7 x bsw called entity, all with reentrancy-level=SINGLE-CORE-REENTRANT:
        Icu_RegisterReadback: implemented-entry=Icu_RegisterReadback
          bsw direct call point Det_ReportError: called-entry=Det_ReportError
        Icu_ResetEdgeCount: can-enter-exclusive-area=ICU_EXCLUSIVE_AREA_0, implemented-entry=Icu_ResetEdgeCount
          bsw direct call point Det_ReportError: called-entry=Det_ReportError
        Icu_SetActivationCondition: can-enter-exclusive-area=ICU_EXCLUSIVE_AREA_0, implemented-entry=Icu_SetActivationCondition
          bsw direct call point Det_ReportError: called-entry=Det_ReportError
        Icu_StartSignalMeasurement: can-enter-exclusive-area=ICU_EXCLUSIVE_AREA_0, implemented-entry=Icu_StartSignalMeasurement
          bsw direct call point Det_ReportError: called-entry=Det_ReportError
        Icu_StartTimestamp: can-enter-exclusive-area=ICU_EXCLUSIVE_AREA_0, implemented-entry=Icu_StartTimestamp
          bsw direct call point Det_ReportError: called-entry=Det_ReportError
        Icu_StopSignalMeasurement: can-enter-exclusive-area=ICU_EXCLUSIVE_AREA_0, implemented-entry=Icu_StopSignalMeasurement
          bsw direct call point Det_ReportError: called-entry=Det_ReportError
        Icu_StopTimestamp: can-enter-exclusive-area=ICU_EXCLUSIVE_AREA_0, implemented-entry=Icu_StopTimestamp
          bsw direct call point Det_ReportError: called-entry=Det_ReportError
          bsw direct call point Det_ReportRuntimeError: called-entry=Det_ReportRuntimeError
      bsw interrupt entity Icu_ch0Notify: reentrancy-level=NON-REENTRANT, implemented-entry=Icu_ch0Notify, interrupt-category=CAT-1, interrupt-source=Hardware
        bsw direct call point Det_ReportError: called-entry=Det_ReportError
  bsw implementation Icu_Impl: programming-language=C, sw-version=10.01.00, vendor-id=44, ar-release-version=4.3.1, behavior=Icu_Behavior, vendor-specific-module-def=Icu
    code-descriptors:
      code Files
        artifact-descriptors:
          short-label=V0::Icu_Priv.h, category=SWHDR
          short-label=V0::Icu_priv.c, category=SWSRC
          short-label=V0::ecap.c, category=SWSRC
          short-label=V0::ecap.h, category=SWHDR
          short-label=V0::hw_icu.h, category=SWHDR
          short-label=generate::include::Icu_Cfg.h, category=SWHDR
          short-label=generate::src::Icu_Cfg.c, category=SWSRC
          short-label=generate::src::Icu_PBcfg.c, category=SWSRC
          short-label=include::Icu.h, category=SWHDR
          short-label=include::Icu_Irq.h, category=SWHDR
          short-label=src::Icu.c, category=SWSRC
          short-label=src::Icu_Irq.c, category=SWSRC
    compiler tiarmclang: name=TI ARM Clang, options=-mcpu=cortex-r5 -mfpu=vfpv3-d16 -mfloat-abi=hard -c -mlittle-endian -ffunction-sections -gdwarf-3 -Werror -Os -x -save-temps -mthumb -DAM263X_PLATFORM, vendor=Texas Instruments, version=2.1.3
    linker tiarmlnk: name=TI ARM Clang Linker, options=-mcpu=cortex-r5 -Wl,--ram_model -Wl,--reread_libs -Wl,--warn_sections -qq -Wl,--emit_warnings_as_errors --diag_suppress=10068 --diag_suppress=10063, vendor=Texas Instruments, version=2.1.3
    resource consumption ResourceConsumption
      5 x memory section:
        ICU_CODE: alignment=UNSPECIFIED, sw-addrmethod=CODE, symbol=CODE
        ICU_CONFIG_DATA: alignment=UNSPECIFIED, sw-addrmethod=CONFIG_DATA, symbol=CONFIG_DATA
        ICU_ISR_CODE: alignment=UNSPECIFIED, sw-addrmethod=CODE, symbol=ISR_CODE
        ICU_VAR_INIT_8: alignment=8, sw-addrmethod=VAR_INIT, symbol=VAR_INIT_8
        ICU_VAR_NO_INIT_UNSPECIFIED: alignment=UNSPECIFIED, sw-addrmethod=VAR_NO_INIT, symbol=VAR_NO_INIT_UNSPECIFIED
package /Icu_TI_AM263x/Icu_ModuleEntry
  36 x bsw module entry, all with sw-service-impl-policy=STANDARD, bsw-entry-kind=CONCRETE:
    Icu_CheckWakeup: service-id=21, is-reentrant=true, is-synchronous=true, call-type=REGULAR, execution-context=UNSPECIFIED
    Icu_Deinit: service-id=1, is-reentrant=true, is-synchronous=false, call-type=REGULAR, execution-context=UNSPECIFIED
    Icu_DisableEdgeCount: service-id=14, is-reentrant=true, is-synchronous=true, call-type=REGULAR, execution-context=UNSPECIFIED
    Icu_DisableEdgeDetection: service-id=23, is-reentrant=true, is-synchronous=true, call-type=REGULAR, execution-context=UNSPECIFIED
    Icu_DisableNotification: service-id=6, is-reentrant=true, is-synchronous=true, call-type=REGULAR, execution-context=UNSPECIFIED
    Icu_DisableWakeup: service-id=3, is-reentrant=true, is-synchronous=true, call-type=REGULAR, execution-context=UNSPECIFIED
    Icu_EnableEdgeCount: service-id=13, is-reentrant=true, is-synchronous=true, call-type=REGULAR, execution-context=UNSPECIFIED
    Icu_EnableEdgeDetection: service-id=22, is-reentrant=true, is-synchronous=true, call-type=REGULAR, execution-context=UNSPECIFIED
    Icu_EnableNotification: service-id=7, is-reentrant=true, is-synchronous=true, call-type=REGULAR, execution-context=UNSPECIFIED
    Icu_EnableWakeup: service-id=4, is-reentrant=true, is-synchronous=true, call-type=REGULAR, execution-context=UNSPECIFIED
    Icu_GetDutyCycleValues: service-id=17, is-reentrant=true, is-synchronous=true, call-type=REGULAR, execution-context=UNSPECIFIED
    Icu_GetEdgeNumbers: service-id=15, is-reentrant=true, is-synchronous=true, call-type=REGULAR, execution-context=UNSPECIFIED
    Icu_GetInputState: service-id=8, is-reentrant=true, is-synchronous=true, call-type=REGULAR, execution-context=UNSPECIFIED
    Icu_GetTimeElapsed: service-id=16, is-reentrant=true, is-synchronous=true, call-type=REGULAR, execution-context=UNSPECIFIED
    Icu_GetTimestampIndex: service-id=11, is-reentrant=true, is-synchronous=true, call-type=REGULAR, execution-context=UNSPECIFIED
    Icu_GetVersionInfo: service-id=18, is-reentrant=true, is-synchronous=true, call-type=REGULAR, execution-context=UNSPECIFIED
    Icu_Init: service-id=0, is-reentrant=false, is-synchronous=true, call-type=REGULAR, execution-context=UNSPECIFIED
    Icu_IntISR_Fun: is-reentrant=false, is-synchronous=true, call-type=INTERRUPT, execution-context=INTERRUPT-CAT-1
    Icu_RegisterReadback: is-reentrant=true, is-synchronous=true, call-type=REGULAR, execution-context=UNSPECIFIED
    Icu_ResetEdgeCount: service-id=12, is-reentrant=true, is-synchronous=true, call-type=REGULAR, execution-context=UNSPECIFIED
    Icu_SetActivationCondition: service-id=5, is-reentrant=true, is-synchronous=true, call-type=REGULAR, execution-context=UNSPECIFIED
    Icu_SetMode: service-id=2, is-reentrant=false, is-synchronous=true, call-type=REGULAR, execution-context=UNSPECIFIED
    Icu_StartSignalMeasurement: service-id=19, is-reentrant=true, is-synchronous=false, call-type=REGULAR, execution-context=UNSPECIFIED
    Icu_StartTimestamp: service-id=9, is-reentrant=true, is-synchronous=false, call-type=REGULAR, execution-context=UNSPECIFIED
    Icu_StopSignalMeasurement: service-id=20, is-reentrant=true, is-synchronous=true, call-type=REGULAR, execution-context=UNSPECIFIED
    Icu_StopTimestamp: service-id=10, is-reentrant=true, is-synchronous=true, call-type=REGULAR, execution-context=UNSPECIFIED
    Icu_ch{0..9}Notify: is-reentrant=false, is-synchronous=true, call-type=INTERRUPT, execution-context=INTERRUPT-CAT-1
