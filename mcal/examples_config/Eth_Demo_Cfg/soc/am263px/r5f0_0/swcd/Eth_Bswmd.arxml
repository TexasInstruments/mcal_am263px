AUTOSAR XML (schema 00044)
package /Eth_TI_AM263px
  bsw module description Eth: module-id=88
    implemented-entrys:
      Eth_Init
      Eth_SetControllerMode
      Eth_GetControllerMode
      Eth_GetPhysAddr
      Eth_SetPhysAddr
      Eth_UpdatePhysAddrFilter
      Eth_WriteMii
      Eth_ReadMii
      Eth_GetCounterValues
      Eth_GetRxStats
      Eth_GetTxStats
      Eth_GetTxErrorCounterValues
      Eth_GetCurrentTime
      Eth_EnableEgressTimeStamp
      Eth_GetEgressTimeStamp
      Eth_GetIngressTimeStamp
      Eth_ProvideTxBuffer
      Eth_Transmit
      Eth_Receive
      Eth_TxConfirmation
      Eth_GetVersionInfo
      Eth_MainFunction
      Eth_RxIrqHdlr_0
      Eth_RxThreshIrqHdlr_0
      Eth_TxIrqHdlr_0
      Eth_MiscIrqHdlr_0
    bsw module dependency Dem: target-module-id=54, target-module=Dem
    bsw module dependency Det: target-module-id=15, target-module=Det
    bsw module dependency EthIf: target-module-id=65, target-module=EthIf
    bsw internal behavior Eth_Behaviour
      exclusive area ETH_EXCLUSIVE_AREA_0
      21 x bsw called entity:
        Eth_Init: can-enter-exclusive-area=ETH_EXCLUSIVE_AREA_0, reentrancy-level=NON-REENTRANT, implemented-entry=Eth_Init
          bsw direct call point Det_ReportError: called-entry=Det_ReportError
          bsw direct call point Dem_SetEventStatus: called-entry=Dem_SetEventStatus
        Eth_SetControllerMode: can-enter-exclusive-area=ETH_EXCLUSIVE_AREA_0, reentrancy-level=NON-REENTRANT, implemented-entry=Eth_SetControllerMode
          bsw direct call point Det_ReportError: called-entry=Det_ReportError
          bsw direct call point Dem_SetEventStatus: called-entry=Dem_SetEventStatus
        Eth_GetControllerMode: reentrancy-level=SINGLE-CORE-REENTRANT, implemented-entry=Eth_GetControllerMode
          bsw direct call point Det_ReportError: called-entry=Det_ReportError
        Eth_GetPhysAddr: reentrancy-level=SINGLE-CORE-REENTRANT, implemented-entry=Eth_GetPhysAddr
          bsw direct call point Det_ReportError: called-entry=Det_ReportError
        Eth_SetPhysAddr: can-enter-exclusive-area=ETH_EXCLUSIVE_AREA_0, reentrancy-level=NON-REENTRANT, implemented-entry=Eth_SetPhysAddr
          bsw direct call point Det_ReportError: called-entry=Det_ReportError
          bsw direct call point Dem_SetEventStatus: called-entry=Dem_SetEventStatus
        Eth_UpdatePhysAddrFilter: reentrancy-level=NON-REENTRANT, implemented-entry=Eth_UpdatePhysAddrFilter
          bsw direct call point Det_ReportError: called-entry=Det_ReportError
          bsw direct call point Dem_SetEventStatus: called-entry=Dem_SetEventStatus
        Eth_WriteMii: reentrancy-level=NON-REENTRANT, implemented-entry=Eth_WriteMii
          bsw direct call point Det_ReportError: called-entry=Det_ReportError
          bsw direct call point Dem_SetEventStatus: called-entry=Dem_SetEventStatus
        Eth_ReadMii: reentrancy-level=NON-REENTRANT, implemented-entry=Eth_ReadMii
          bsw direct call point Det_ReportError: called-entry=Det_ReportError
          bsw direct call point Dem_SetEventStatus: called-entry=Dem_SetEventStatus
        Eth_GetCounterValues: can-enter-exclusive-area=ETH_EXCLUSIVE_AREA_0, reentrancy-level=NON-REENTRANT, implemented-entry=Eth_GetCounterValues
          bsw direct call point Det_ReportError: called-entry=Det_ReportError
        Eth_GetRxStats: can-enter-exclusive-area=ETH_EXCLUSIVE_AREA_0, reentrancy-level=NON-REENTRANT, implemented-entry=Eth_GetRxStats
          bsw direct call point Det_ReportError: called-entry=Det_ReportError
        Eth_GetTxStats: can-enter-exclusive-area=ETH_EXCLUSIVE_AREA_0, reentrancy-level=NON-REENTRANT, implemented-entry=Eth_GetTxStats
          bsw direct call point Det_ReportError: called-entry=Det_ReportError
        Eth_GetTxErrorCounterValues: can-enter-exclusive-area=ETH_EXCLUSIVE_AREA_0, reentrancy-level=NON-REENTRANT, implemented-entry=Eth_GetTxErrorCounterValues
          bsw direct call point Det_ReportError: called-entry=Det_ReportError
        Eth_GetCurrentTime: can-enter-exclusive-area=ETH_EXCLUSIVE_AREA_0, reentrancy-level=NON-REENTRANT, implemented-entry=Eth_GetCurrentTime
          bsw direct call point Det_ReportError: called-entry=Det_ReportError
        Eth_EnableEgressTimeStamp: reentrancy-level=NON-REENTRANT, implemented-entry=Eth_EnableEgressTimeStamp
          bsw direct call point Det_ReportError: called-entry=Det_ReportError
        Eth_GetEgressTimeStamp: can-enter-exclusive-area=ETH_EXCLUSIVE_AREA_0, reentrancy-level=NON-REENTRANT, implemented-entry=Eth_GetEgressTimeStamp
          bsw direct call point Det_ReportError: called-entry=Det_ReportError
        Eth_GetIngressTimeStamp: can-enter-exclusive-area=ETH_EXCLUSIVE_AREA_0, reentrancy-level=NON-REENTRANT, implemented-entry=Eth_GetIngressTimeStamp
          bsw direct call point Det_ReportError: called-entry=Det_ReportError
        Eth_ProvideTxBuffer: can-enter-exclusive-area=ETH_EXCLUSIVE_AREA_0, reentrancy-level=NON-REENTRANT, implemented-entry=Eth_ProvideTxBuffer
          bsw direct call point Det_ReportError: called-entry=Det_ReportError
        Eth_Transmit: can-enter-exclusive-area=ETH_EXCLUSIVE_AREA_0, reentrancy-level=NON-REENTRANT, implemented-entry=Eth_Transmit
          bsw direct call point Det_ReportError: called-entry=Det_ReportError
        Eth_Receive: can-enter-exclusive-area=ETH_EXCLUSIVE_AREA_0, reentrancy-level=NON-REENTRANT, implemented-entry=Eth_Receive
          bsw direct call point Det_ReportError: called-entry=Det_ReportError
          bsw direct call point EthIf_RxIndication: called-entry=EthIf_RxIndication
        Eth_TxConfirmation: can-enter-exclusive-area=ETH_EXCLUSIVE_AREA_0, reentrancy-level=NON-REENTRANT, implemented-entry=Eth_TxConfirmation
          bsw direct call point Det_ReportError: called-entry=Det_ReportError
          bsw direct call point EthIf_TxConfirmation: called-entry=EthIf_TxConfirmation
        Eth_GetVersionInfo: reentrancy-level=SINGLE-CORE-REENTRANT, implemented-entry=Eth_GetVersionInfo
          bsw direct call point Det_ReportError: called-entry=Det_ReportError
      bsw schedulable entity Eth_MainFunction: can-enter-exclusive-area=ETH_EXCLUSIVE_AREA_0, reentrancy-level=SINGLE-CORE-REENTRANT, implemented-entry=Eth_MainFunction
        bsw direct call point Det_ReportError: called-entry=Det_ReportError
        bsw direct call point EthIf_CtrlModeIndication: called-entry=EthIf_CtrlModeIndication
        bsw direct call point Dem_SetEventStatus: called-entry=Dem_SetEventStatus
      4 x bsw interrupt entity, all with reentrancy-level=NON-REENTRANT, interrupt-category=CAT-1, interrupt-source=Hardware:
        Eth_RxIrqHdlr_0: implemented-entry=Eth_RxIrqHdlr_0
          bsw direct call point Det_ReportError: called-entry=Det_ReportError
          bsw direct call point EthIf_RxIndication: called-entry=EthIf_RxIndication
        Eth_RxThreshIrqHdlr_0: implemented-entry=Eth_RxThreshIrqHdlr_0
          bsw direct call point Det_ReportError: called-entry=Det_ReportError
          bsw direct call point EthIf_RxIndication: called-entry=EthIf_RxIndication
        Eth_TxIrqHdlr_0: implemented-entry=Eth_TxIrqHdlr_0
          bsw direct call point Det_ReportError: called-entry=Det_ReportError
          bsw direct call point EthIf_TxConfirmation: called-entry=EthIf_TxConfirmation
        Eth_MiscIrqHdlr_0: implemented-entry=Eth_MiscIrqHdlr_0
          bsw direct call point Dem_SetEventStatus: called-entry=Dem_SetEventStatus
      bsw timing event EthTimingEvent_MainFunction: starts-on-event=Eth_MainFunction, period=0.005
  bsw implementation Eth_Impl: programming-language=C, sw-version=10.1.0, vendor-id=44, ar-release-version=4.3.1, behavior=Eth_Behaviour, vendor-specific-module-def=Eth
    code-descriptors:
      code Files
        artifact-descriptors:
          short-label=V0::Eth_Helpers.c, category=SWSRC
          short-label=V0::Eth_Helpers.h, category=SWHDR
          short-label=generate::include::Eth_Cfg.h, category=SWHDR
          short-label=generate::src::Eth_Cfg.c, category=SWSRC
          short-label=generate::src::Eth_Lcfg.c, category=SWSRC
          short-label=generate::src::Eth_PBcfg.c, category=SWSRC
          short-label=include::Eth.h, category=SWHDR
          short-label=include::Eth_Irq.h, category=SWHDR
          short-label=include::Eth_Types.h, category=SWHDR
          short-label=src::Eth.c, category=SWSRC
          short-label=src::Eth_Irq.c, category=SWSRC
          short-label=src::cpsw::Cpsw.c, category=SWSRC
          short-label=src::cpsw::Cpsw_Ale.c, category=SWSRC
          short-label=src::cpsw::Cpsw_Cpdma.c, category=SWSRC
          short-label=src::cpsw::Cpsw_Cpts.c, category=SWSRC
          short-label=src::cpsw::Cpsw_Mdio.c, category=SWSRC
          short-label=src::cpsw::Cpsw_Port.c, category=SWSRC
          short-label=src::cpsw::Cpsw_Stats.c, category=SWSRC
          short-label=src::cpsw::Eth_Priv.c, category=SWSRC
          short-label=src::cpsw::include::Cpsw.h, category=SWHDR
          short-label=src::cpsw::include::Cpsw_Ale.h, category=SWHDR
          short-label=src::cpsw::include::Cpsw_Cpdma.h, category=SWHDR
          short-label=src::cpsw::include::Cpsw_Cpts.h, category=SWHDR
          short-label=src::cpsw::include::Cpsw_Mdio.h, category=SWHDR
          short-label=src::cpsw::include::Cpsw_Port.h, category=SWHDR
          short-label=src::cpsw::include::Cpsw_Priv.h, category=SWHDR
          short-label=src::cpsw::include::Cpsw_Stats.h, category=SWHDR
          short-label=src::cpsw::include::Cpsw_Types.h, category=SWHDR
          short-label=src::cpsw::include::Eth_Priv.h, category=SWHDR
          short-label=src::hw::Hw_Cpsw.h, category=SWHDR
          short-label=src::hw::Hw_Cpsw_Ale.h, category=SWHDR
          short-label=src::hw::Hw_Cpsw_Cpdma.h, category=SWHDR
          short-label=src::hw::Hw_Cpsw_Cpts.h, category=SWHDR
          short-label=src::hw::Hw_Cpsw_Mdio.h, category=SWHDR
          short-label=src::hw::Hw_Cpsw_Port.h, category=SWHDR
          short-label=src::hw::Hw_Cpsw_Ss.h, category=SWHDR
          short-label=src::hw::Hw_Cpsw_Stats.h, category=SWHDR
    compiler tiarmclang: name=TI ARM Clang, options=-mcpu=cortex-r5 -mfpu=vfpv3-d16 -mfloat-abi=hard -c -mlittle-endian -ffunction-sections -gdwarf-3 -Werror -Os -x -save-temps -mthumb -DAM263PX_SIP_PACKAGE -DAM263PX_PLATFORM -DAM263PX_R_PACKAGE -DAM263PX_C_PACKAGE, vendor=Texas Instruments, version=4.0.0
    linker tiarmlnk: name=TI ARM Clang Linker, options=-mcpu=cortex-r5 -Wl,--ram_model -Wl,--reread_libs -Wl,--warn_sections -qq -Wl,--emit_warnings_as_errors --diag_suppress=10068 --diag_suppress=10063, vendor=Texas Instruments, version=4.0.0
    resource consumption ResourceConsumption
      10 x memory section:
        ETH_CODE: alignment=UNSPECIFIED, sw-addrmethod=CODE, symbol=CODE
        ETH_CONST_UNSPECIFIED: alignment=UNSPECIFIED, sw-addrmethod=CONST, symbol=CONST_UNSPECIFIED
        ETH_ISR_CODE: alignment=UNSPECIFIED, sw-addrmethod=CODE, symbol=ISR_CODE
        ETH_VAR_INIT_UNSPECIFIED: alignment=UNSPECIFIED, sw-addrmethod=VAR_INIT, symbol=VAR_INIT_UNSPECIFIED
        ETH_VAR_NO_INIT_UNSPECIFIED: alignment=UNSPECIFIED, sw-addrmethod=VAR_NO_INIT, symbol=VAR_NO_INIT_UNSPECIFIED
        ETH_VAR_INIT_32: alignment=32, sw-addrmethod=VAR_INIT, symbol=VAR_INIT_32
        ETH_VAR_INIT_8: alignment=8, sw-addrmethod=VAR_INIT, symbol=VAR_INIT_8
        ETH_VAR_NO_INIT_8: alignment=8, sw-addrmethod=VAR_NO_INIT, symbol=VAR_NO_INIT_8
        ETH_CONST_8: alignment=8, sw-addrmethod=CONST, symbol=CONST_8
        ETH_CONFIG_DATA: alignment=UNSPECIFIED, sw-addrmethod=CONFIG_DATA, symbol=CONFIG_DATA
package /Eth_TI_AM263px/Eth_ModuleEntry
  28 x bsw module entry, all with is-synchronous=true, sw-service-impl-policy=STANDARD, bsw-entry-kind=CONCRETE:
    Eth_Init: service-id=0x01, is-reentrant=false, call-type=REGULAR, execution-context=UNSPECIFIED
    Eth_SetControllerMode: service-id=0x03, is-reentrant=false, call-type=REGULAR, execution-context=UNSPECIFIED
    Eth_GetControllerMode: service-id=0x04, is-reentrant=true, call-type=REGULAR, execution-context=UNSPECIFIED
    Eth_GetPhysAddr: service-id=0x08, is-reentrant=true, call-type=REGULAR, execution-context=UNSPECIFIED
    Eth_SetPhysAddr: service-id=0x13, is-reentrant=false, call-type=REGULAR, execution-context=UNSPECIFIED
    Eth_UpdatePhysAddrFilter: service-id=0x12, is-reentrant=false, call-type=REGULAR, execution-context=UNSPECIFIED
    Eth_WriteMii: service-id=0x05, is-reentrant=false, call-type=REGULAR, execution-context=UNSPECIFIED
    Eth_ReadMii: service-id=0x06, is-reentrant=false, call-type=REGULAR, execution-context=UNSPECIFIED
    Eth_GetCounterValues: service-id=0x14, is-reentrant=false, call-type=REGULAR, execution-context=UNSPECIFIED
    Eth_GetRxStats: service-id=0x15, is-reentrant=false, call-type=REGULAR, execution-context=UNSPECIFIED
    Eth_GetTxStats: service-id=0x1C, is-reentrant=false, call-type=REGULAR, execution-context=UNSPECIFIED
    Eth_GetTxErrorCounterValues: service-id=0x1D, is-reentrant=false, call-type=REGULAR, execution-context=TASK
    Eth_GetCurrentTime: service-id=0x16, is-reentrant=false, call-type=REGULAR, execution-context=UNSPECIFIED
    Eth_EnableEgressTimeStamp: service-id=0x17, is-reentrant=false, call-type=REGULAR, execution-context=UNSPECIFIED
    Eth_GetEgressTimeStamp: service-id=0x18, is-reentrant=false, call-type=REGULAR, execution-context=UNSPECIFIED
    Eth_GetIngressTimeStamp: service-id=0x19, is-reentrant=false, call-type=REGULAR, execution-context=UNSPECIFIED
    Eth_ProvideTxBuffer: service-id=0x09, is-reentrant=false, call-type=REGULAR, execution-context=UNSPECIFIED
    Eth_Transmit: service-id=0x0a, is-reentrant=false, call-type=REGULAR, execution-context=UNSPECIFIED
    Eth_Receive: service-id=0x0b, is-reentrant=false, call-type=REGULAR, execution-context=UNSPECIFIED
    Eth_TxConfirmation: service-id=0x0c, is-reentrant=false, call-type=REGULAR, execution-context=UNSPECIFIED
    Eth_GetVersionInfo: service-id=0x0d, is-reentrant=true, call-type=REGULAR, execution-context=UNSPECIFIED
    Eth_SetBandwidthLimit: service-id=0x50, is-reentrant=false, call-type=REGULAR, execution-context=UNSPECIFIED
    Eth_GetBandwidthLimit: service-id=0x51, is-reentrant=true, call-type=REGULAR, execution-context=UNSPECIFIED
    Eth_MainFunction: service-id=0x20, is-reentrant=false, call-type=SCHEDULED, execution-context=TASK
    Eth_RxIrqHdlr_0: service-id=0x10, is-reentrant=false, call-type=INTERRUPT, execution-context=INTERRUPT-CAT-1
    Eth_RxThreshIrqHdlr_0: service-id=0x21, is-reentrant=false, call-type=INTERRUPT, execution-context=INTERRUPT-CAT-1
    Eth_TxIrqHdlr_0: service-id=0x11, is-reentrant=false, call-type=INTERRUPT, execution-context=INTERRUPT-CAT-1
    Eth_MiscIrqHdlr_0: is-reentrant=false, call-type=INTERRUPT, execution-context=INTERRUPT-CAT-1
