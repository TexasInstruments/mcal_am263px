AUTOSAR XML (schema 00044)
package /Cdd_Uart_TI_AM263x
  bsw module description Cdd_Uart: category=BSW_MODULE, module-id=255
    implemented-entrys:
      Cdd_Uart_Cancel
      Cdd_Uart_DeInit
      Cdd_Uart_GetVersionInfo
      Cdd_Uart_Read
      Cdd_Uart_Init
      Cdd_Uart_GetRemainingWords
      Cdd_Uart_Write
      Cdd_Uart_RegisterReadback
    bsw module dependency Det: target-module-id=15, target-module=Det
    bsw module dependency Cdd_Dma: target-module-id=255, target-module=Cdd_Dma_ModuleEntry
    bsw internal behavior Cdd_Uart_Behavior
      exclusive area UART_EXCLUSIVE_AREA_0
      8 x bsw called entity:
        Cdd_Uart_Cancel: can-enter-exclusive-area=UART_EXCLUSIVE_AREA_0, reentrancy-level=NON-REENTRANT, implemented-entry=Cdd_Uart_Cancel
          bsw direct call point Det_ReportError: called-entry=Det_ReportError
          bsw direct call point Cdd_Dma_DisableTransferRegion: called-entry=Cdd_Dma_DisableTransferRegion
        Cdd_Uart_DeInit: reentrancy-level=NON-REENTRANT, implemented-entry=Cdd_Uart_DeInit
          bsw direct call point Det_ReportError: called-entry=Det_ReportError
        Cdd_Uart_GetRemainingWords: reentrancy-level=SINGLE-CORE-REENTRANT, implemented-entry=Cdd_Uart_GetRemainingWords
          bsw direct call point Det_ReportError: called-entry=Det_ReportError
          bsw direct call point Cdd_Dma_GetParam: called-entry=Cdd_Dma_GetParam
        Cdd_Uart_Read: reentrancy-level=SINGLE-CORE-REENTRANT, implemented-entry=Cdd_Uart_Read
          bsw direct call point Det_ReportError: called-entry=Det_ReportError
          bsw direct call point Cdd_Dma_EnableTransferRegion: called-entry=Cdd_Dma_EnableTransferRegion
          bsw direct call point Cdd_Dma_ParamSet: called-entry=Cdd_Dma_ParamSet
        Cdd_Uart_GetVersionInfo: reentrancy-level=SINGLE-CORE-REENTRANT, implemented-entry=Cdd_Uart_GetVersionInfo
          bsw direct call point Det_ReportError: called-entry=Det_ReportError
        Cdd_Uart_Init: reentrancy-level=NON-REENTRANT, implemented-entry=Cdd_Uart_Init
          bsw direct call point Det_ReportError: called-entry=Det_ReportError
          bsw direct call point Cdd_Dma_CbkRegister: called-entry=Cdd_Dma_CbkRegister
        Cdd_Uart_Write: reentrancy-level=SINGLE-CORE-REENTRANT, implemented-entry=Cdd_Uart_Write
          4 x bsw direct call point:
            Det_ReportError: called-entry=Det_ReportError
            Cdd_Dma_EnableTransferRegion: called-entry=Cdd_Dma_EnableTransferRegion
            Cdd_Dma_LinkChannel: called-entry=Cdd_Dma_LinkChannel
            Cdd_Dma_ParamSet: called-entry=Cdd_Dma_ParamSet
        Cdd_Uart_RegisterReadback: reentrancy-level=NON-REENTRANT, implemented-entry=Cdd_Uart_RegisterReadback
          bsw direct call point Det_ReportError: called-entry=Det_ReportError
  bsw implementation Cdd_Uart_Impl: programming-language=C, sw-version=10.01.00, vendor-id=44, ar-release-version=4.3.1, behavior=Cdd_Uart_Behavior, vendor-specific-module-def=Cdd_Uart
    code-descriptors:
      code Files
        artifact-descriptors:
          short-label=generate::include::Cdd_Uart_Cfg.h, category=SWHDR
          short-label=generate::src::Cdd_Uart_Cfg.c, category=SWSRC
          short-label=generate::src::Cdd_Uart_PBcfg.c, category=SWSRC
          short-label=include::Cdd_Uart_Irq.h, category=SWHDR
          short-label=include::Cdd_Uart.h, category=SWHDR
          short-label=src::Cdd_Uart_Irq.c, category=SWSRC
          short-label=src::Cdd_Uart.c, category=SWSRC
          short-label=V0::Cdd_Uart_Priv.c, category=SWSRC
          short-label=V0::Cdd_Uart_Priv.h, category=SWHDR
          short-label=V0::uart_dma_edma.c, category=SWSRC
          short-label=V0::uart_dma.h, category=SWHDR
          short-label=V0::uart.c, category=SWSRC
          short-label=V0::uart.h, category=SWHDR
    compiler tiarmclang: name=TI ARM Clang, options=-mcpu=cortex-r5 -mfpu=vfpv3-d16 -mfloat-abi=hard -c -mlittle-endian -ffunction-sections -gdwarf-3 -Werror -Os -x -save-temps -mthumb -DAM263X_PLATFORM, vendor=Texas Instruments, version=2.1.3
    linker tiarmlnk: name=TI ARM Clang Linker, options=-mcpu=cortex-r5 -Wl,--ram_model -Wl,--reread_libs -Wl,--warn_sections -qq -Wl,--emit_warnings_as_errors --diag_suppress=10068 --diag_suppress=10063, vendor=Texas Instruments, version=2.1.3
    resource consumption ResourceConsumption
      7 x memory section:
        CDD_UART_CODE: sw-addrmethod=CODE, symbol=CODE
        CDD_UART_CONFIG_DATA: alignment=UNSPECIFIED, sw-addrmethod=CONFIG_DATA, symbol=CONFIG_DATA
        CDD_UART_ISR_CODE: sw-addrmethod=CODE, symbol=ISR_CODE
        CDD_UART_VAR_INIT_32: alignment=32, sw-addrmethod=VAR_INIT, symbol=VAR_INIT_32
        CDD_UART_VAR_INIT_UNSPECIFIED: alignment=UNSPECIFIED, sw-addrmethod=VAR_INIT, symbol=VAR_INIT_UNSPECIFIED
        CDD_UART_VAR_NO_INIT_32: alignment=32, sw-addrmethod=VAR_NO_INIT, symbol=VAR_NO_INIT_32
        CDD_UART_VAR_NO_INIT_UNSPECIFIED: alignment=UNSPECIFIED, sw-addrmethod=VAR_NO_INIT, symbol=VAR_NO_INIT_UNSPECIFIED
package /Cdd_Uart_TI_AM263x/Cdd_Uart_ModuleEntry
  14 x bsw module entry, all with is-synchronous=true, sw-service-impl-policy=STANDARD, bsw-entry-kind=CONCRETE:
    Cdd_Uart_Cancel: service-id=6, is-reentrant=false, call-type=REGULAR, execution-context=UNSPECIFIED
    Cdd_Uart_GetRemainingWords: service-id=7, is-reentrant=true, call-type=REGULAR, execution-context=UNSPECIFIED
    Cdd_Uart_DeInit: service-id=11, is-reentrant=false, call-type=REGULAR, execution-context=UNSPECIFIED
    Cdd_Uart_GetVersionInfo: service-id=2, is-reentrant=true, call-type=REGULAR, execution-context=UNSPECIFIED
    Cdd_Uart_Init: service-id=1, is-reentrant=false, call-type=REGULAR, execution-context=UNSPECIFIED
    Cdd_Uart_Write: service-id=4, is-reentrant=true, call-type=REGULAR, execution-context=UNSPECIFIED
    Cdd_Uart_Read: service-id=3, is-reentrant=true, call-type=REGULAR, execution-context=UNSPECIFIED
    Cdd_Uart_RegisterReadback: service-id=13, is-reentrant=true, call-type=REGULAR, execution-context=UNSPECIFIED
    Cdd_Uart_Channel{0..5}Isr: is-reentrant=false, call-type=INTERRUPT, execution-context=INTERRUPT-CAT-1
