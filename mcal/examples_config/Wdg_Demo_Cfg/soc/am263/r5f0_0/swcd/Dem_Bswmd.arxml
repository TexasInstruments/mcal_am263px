AUTOSAR XML (schema 00044)
package /AUTOSAR_Dem
  bsw module description Dem: category=BSW_MODULE, module-id=15
    bsw internal behavior BswInternalBehavior_0
      bsw called entity Dem_ReportErrorStatus: reentrancy-level=SINGLE-CORE-REENTRANT, implemented-entry=Dem_ReportErrorStatus
      bsw called entity Dem_SetEventStatus: reentrancy-level=SINGLE-CORE-REENTRANT, implemented-entry=Dem_SetEventStatus
package /AUTOSAR_Dem/BSWModuleEntry
  bsw module entry Dem_ReportErrorStatus: call-type=CALLOUT, execution-context=UNSPECIFIED, sw-service-impl-policy=STANDARD, bsw-entry-kind=ABSTRACT
  bsw module entry Dem_SetEventStatus: service-id=4, is-reentrant=true, is-synchronous=true, call-type=REGULAR, execution-context=UNSPECIFIED, sw-service-impl-policy=STANDARD, bsw-entry-kind=ABSTRACT
