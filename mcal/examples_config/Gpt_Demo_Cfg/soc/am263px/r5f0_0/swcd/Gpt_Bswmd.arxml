AUTOSAR XML (schema 00044)
package /Gpt_TI_AM263Px
  bsw module description Gpt: category=BSW_MODULE, module-id=100
    implemented-entrys:
      Gpt_Ch{4..31}Isr
      Gpt_DeInit
      Gpt_DisableNotification
      Gpt_EnableNotification
      Gpt_GetPredefTimerValue
      Gpt_GetTimeElapsed
      Gpt_GetTimeRemaining
      Gpt_GetVersionInfo
      Gpt_Init
      Gpt_StartTimer
      Gpt_StopTimer
    bsw module dependency Det: target-module-id=15, target-module=Det
    bsw internal behavior Gpt_Behavior
      exclusive area GPT_EXCLUSIVE_AREA_0
      28 x bsw interrupt entity, all with reentrancy-level=NON-REENTRANT, interrupt-category=CAT-1, interrupt-source=Hardware:
        Gpt_Ch{4..31}Isr: implemented-entry=Gpt_Ch{4..31}Isr
      10 x bsw called entity:
        Gpt_DeInit: reentrancy-level=NON-REENTRANT, implemented-entry=Gpt_DeInit
          bsw direct call point Det_ReportError: called-entry=Det_ReportError
          bsw direct call point Det_ReportRuntimeError: called-entry=Det_ReportRuntimeError
        Gpt_DisableNotification: can-enter-exclusive-area=GPT_EXCLUSIVE_AREA_0, reentrancy-level=SINGLE-CORE-REENTRANT, implemented-entry=Gpt_DisableNotification
          bsw direct call point Det_ReportError: called-entry=Det_ReportError
        Gpt_EnableNotification: can-enter-exclusive-area=GPT_EXCLUSIVE_AREA_0, reentrancy-level=SINGLE-CORE-REENTRANT, implemented-entry=Gpt_EnableNotification
          bsw direct call point Det_ReportError: called-entry=Det_ReportError
        Gpt_GetPredefTimerValue: reentrancy-level=SINGLE-CORE-REENTRANT, implemented-entry=Gpt_GetPredefTimerValue
        Gpt_GetTimeElapsed: reentrancy-level=SINGLE-CORE-REENTRANT, implemented-entry=Gpt_GetTimeElapsed
          bsw direct call point Det_ReportError: called-entry=Det_ReportError
        Gpt_GetTimeRemaining: reentrancy-level=SINGLE-CORE-REENTRANT, implemented-entry=Gpt_GetTimeRemaining
          bsw direct call point Det_ReportError: called-entry=Det_ReportError
        Gpt_GetVersionInfo: reentrancy-level=SINGLE-CORE-REENTRANT, implemented-entry=Gpt_GetVersionInfo
          bsw direct call point Det_ReportError: called-entry=Det_ReportError
        Gpt_Init: reentrancy-level=NON-REENTRANT, implemented-entry=Gpt_Init
          bsw direct call point Det_ReportError: called-entry=Det_ReportError
        Gpt_StartTimer: can-enter-exclusive-area=GPT_EXCLUSIVE_AREA_0, reentrancy-level=SINGLE-CORE-REENTRANT, implemented-entry=Gpt_StartTimer
          bsw direct call point Det_ReportError: called-entry=Det_ReportError
          bsw direct call point Det_ReportRuntimeError: called-entry=Det_ReportRuntimeError
        Gpt_StopTimer: can-enter-exclusive-area=GPT_EXCLUSIVE_AREA_0, reentrancy-level=SINGLE-CORE-REENTRANT, implemented-entry=Gpt_StopTimer
          bsw direct call point Det_ReportError: called-entry=Det_ReportError
  bsw implementation Gpt_Impl: programming-language=C, sw-version=10.01.00, vendor-id=44, ar-release-version=4.3.1, behavior=Gpt_Behavior, vendor-specific-module-def=Gpt
    code-descriptors:
      code Files
        artifact-descriptors:
          short-label=V0::Gpt_Priv.c, category=SWSRC
          short-label=V0::Gpt_Priv.h, category=SWHDR
          short-label=generate::include::Gpt_Cfg.h, category=SWHDR
          short-label=generate::src::Gpt_Cfg.c, category=SWSRC
          short-label=generate::src::Gpt_PBcfg.c, category=SWSRC
          short-label=include::Gpt.h, category=SWHDR
          short-label=include::Gpt_Irq.h, category=SWHDR
          short-label=src::Gpt.c, category=SWSRC
          short-label=src::Gpt_Irq.c, category=SWSRC
    compiler tiarmclang: name=TI ARM Clang, options=-mcpu=cortex-r5 -mfpu=vfpv3-d16 -mfloat-abi=hard -c -mlittle-endian -ffunction-sections -gdwarf-3 -Werror -Os -x -save-temps -mthumb -DAM263PX_SIP_PACKAGE -DAM263PX_PLATFORM -DAM263PX_R_PACKAGE -DAM263PX_C_PACKAGE, vendor=Texas Instruments, version=4.0.0
    linker tiarmlnk: name=TI ARM Clang Linker, options=-mcpu=cortex-r5 -Wl,--ram_model -Wl,--reread_libs -Wl,--warn_sections -qq -Wl,--emit_warnings_as_errors --diag_suppress=10068 --diag_suppress=10063, vendor=Texas Instruments, version=4.0.0
    resource consumption ResourceConsumption
      8 x memory section:
        GPT_CODE: alignment=UNSPECIFIED, sw-addrmethod=CODE, symbol=CODE
        GPT_CONFIG_DATA: alignment=UNSPECIFIED, sw-addrmethod=CONFIG_DATA, symbol=CONFIG_DATA
        GPT_CONST_32: alignment=32, sw-addrmethod=CONST, symbol=CONST_32
        GPT_CONST_UNSPECIFIED: alignment=UNSPECIFIED, sw-addrmethod=CONST, symbol=CONST_UNSPECIFIED
        GPT_ISR_CODE: alignment=UNSPECIFIED, sw-addrmethod=CODE, symbol=ISR_CODE
        GPT_VAR_INIT_UNSPECIFIED: alignment=UNSPECIFIED, sw-addrmethod=VAR_INIT, symbol=VAR_INIT_UNSPECIFIED
        GPT_VAR_NO_INIT_UNSPECIFIED: alignment=UNSPECIFIED, sw-addrmethod=VAR_NO_INIT, symbol=VAR_NO_INIT_UNSPECIFIED
        GPT_VAR_NO_INIT_16: alignment=16, sw-addrmethod=VAR_NO_INIT, symbol=VAR_NO_INIT_16
package /Gpt_TI_AM263Px/Gpt_ModuleEntry
  47 x bsw module entry, all with is-synchronous=true, sw-service-impl-policy=STANDARD, bsw-entry-kind=CONCRETE:
    Gpt_Ch0Isr: is-reentrant=false, call-type=INTERRUPT, execution-context=INTERRUPT-CAT-1
    Gpt_Ch{10..19}Isr: is-reentrant=false, call-type=INTERRUPT, execution-context=INTERRUPT-CAT-1
    Gpt_Ch1Isr: is-reentrant=false, call-type=INTERRUPT, execution-context=INTERRUPT-CAT-1
    Gpt_Ch{20..29}Isr: is-reentrant=false, call-type=INTERRUPT, execution-context=INTERRUPT-CAT-1
    Gpt_Ch2Isr: is-reentrant=false, call-type=INTERRUPT, execution-context=INTERRUPT-CAT-1
    Gpt_Ch30Isr: is-reentrant=false, call-type=INTERRUPT, execution-context=INTERRUPT-CAT-1
    Gpt_Ch31Isr: is-reentrant=false, call-type=INTERRUPT, execution-context=INTERRUPT-CAT-1
    Gpt_Ch{3..9}Isr: is-reentrant=false, call-type=INTERRUPT, execution-context=INTERRUPT-CAT-1
    Gpt_CheckWakeup: service-id=12, is-reentrant=true, call-type=REGULAR, execution-context=UNSPECIFIED
    Gpt_ConfigRegReadBack: service-id=15, is-reentrant=true, call-type=REGULAR, execution-context=UNSPECIFIED
    Gpt_DeInit: service-id=2, is-reentrant=false, call-type=REGULAR, execution-context=UNSPECIFIED
    Gpt_DisableNotification: service-id=8, is-reentrant=true, call-type=REGULAR, execution-context=UNSPECIFIED
    Gpt_DisableWakeup: service-id=10, is-reentrant=true, call-type=REGULAR, execution-context=UNSPECIFIED
    Gpt_EnableNotification: service-id=7, is-reentrant=true, call-type=REGULAR, execution-context=UNSPECIFIED
    Gpt_EnableWakeup: service-id=11, is-reentrant=true, call-type=REGULAR, execution-context=UNSPECIFIED
    Gpt_GetPredefTimerValue: service-id=13, is-reentrant=true, call-type=REGULAR, execution-context=UNSPECIFIED
    Gpt_GetTimeElapsed: service-id=3, is-reentrant=true, call-type=REGULAR, execution-context=UNSPECIFIED
    Gpt_GetTimeRemaining: service-id=4, is-reentrant=true, call-type=REGULAR, execution-context=UNSPECIFIED
    Gpt_GetVersionInfo: service-id=0, is-reentrant=true, call-type=REGULAR, execution-context=UNSPECIFIED
    Gpt_Init: service-id=1, is-reentrant=false, call-type=REGULAR, execution-context=UNSPECIFIED
    Gpt_SetMode: service-id=9, is-reentrant=false, call-type=REGULAR, execution-context=UNSPECIFIED
    Gpt_StartTimer: service-id=5, is-reentrant=true, call-type=REGULAR, execution-context=UNSPECIFIED
    Gpt_StopTimer: service-id=6, is-reentrant=true, call-type=REGULAR, execution-context=UNSPECIFIED
