AUTOSAR XML (schema 00044)
package /Can_TI_AM263Px
  bsw module description Can: category=BSW_MODULE, module-id=80
    implemented-entrys:
      Can_{0..4}_Int0ISR
      Can_DeInit
      Can_DisableControllerInterrupts
      Can_EnableControllerInterrupts
      Can_GetControllerErrorState
      Can_GetControllerMode
      Can_GetVersionInfo
      Can_Init
      Can_MainFunction_BusOff
      Can_MainFunction_Mode
      Can_MainFunction_Read
      Can_MainFunction_Write
      Can_SetBaudrate
      Can_SetControllerMode
      Can_TestLoopBackModeDisable
      Can_TestLoopBackModeEnable
      Can_Write
    bsw module dependency CanIf: target-module-id=60, target-module=CanIf
    bsw module dependency Dem: target-module-id=54, target-module=Dem
    bsw module dependency Det: target-module-id=15, target-module=Det
    bsw internal behavior Can_Behavior
      exclusive area CAN_EXCLUSIVE_AREA_0
      5 x bsw interrupt entity, all with reentrancy-level=NON-REENTRANT, interrupt-category=CAT-1, interrupt-source=Hardware:
        Can_0_Int0ISR: implemented-entry=Can_0_Int0ISR
          5 x bsw direct call point:
            CanIf_TxConfirmation: called-entry=CanIf_TxConfirmation
            CanIf_RxIndication: called-entry=CanIf_RxIndication
            CanIf_ControllerBusOff: called-entry=CanIf_ControllerBusOff
            Dem_SetEventStatus: called-entry=Dem_SetEventStatus
            Det_ReportRuntimeError: called-entry=Det_ReportRuntimeError
        Can_1_Int0ISR: implemented-entry=Can_1_Int0ISR
          5 x bsw direct call point:
            CanIf_TxConfirmation: called-entry=CanIf_TxConfirmation
            CanIf_RxIndication: called-entry=CanIf_RxIndication
            CanIf_ControllerBusOff: called-entry=CanIf_ControllerBusOff
            Dem_SetEventStatus: called-entry=Dem_SetEventStatus
            Det_ReportRuntimeError: called-entry=Det_ReportRuntimeError
        Can_2_Int0ISR: implemented-entry=Can_2_Int0ISR
          5 x bsw direct call point:
            CanIf_TxConfirmation: called-entry=CanIf_TxConfirmation
            CanIf_RxIndication: called-entry=CanIf_RxIndication
            CanIf_ControllerBusOff: called-entry=CanIf_ControllerBusOff
            Dem_SetEventStatus: called-entry=Dem_SetEventStatus
            Det_ReportRuntimeError: called-entry=Det_ReportRuntimeError
        Can_3_Int0ISR: implemented-entry=Can_3_Int0ISR
          5 x bsw direct call point:
            CanIf_TxConfirmation: called-entry=CanIf_TxConfirmation
            CanIf_RxIndication: called-entry=CanIf_RxIndication
            CanIf_ControllerBusOff: called-entry=CanIf_ControllerBusOff
            Dem_SetEventStatus: called-entry=Dem_SetEventStatus
            Det_ReportRuntimeError: called-entry=Det_ReportRuntimeError
        Can_4_Int0ISR: implemented-entry=Can_4_Int0ISR
          5 x bsw direct call point:
            CanIf_TxConfirmation: called-entry=CanIf_TxConfirmation
            CanIf_RxIndication: called-entry=CanIf_RxIndication
            CanIf_ControllerBusOff: called-entry=CanIf_ControllerBusOff
            Dem_SetEventStatus: called-entry=Dem_SetEventStatus
            Det_ReportRuntimeError: called-entry=Det_ReportRuntimeError
      7 x bsw called entity:
        Can_DeInit: reentrancy-level=NON-REENTRANT, implemented-entry=Can_DeInit
          bsw direct call point Dem_SetEventStatus: called-entry=Dem_SetEventStatus
          bsw direct call point Det_ReportError: called-entry=Det_ReportError
        Can_DisableControllerInterrupts: can-enter-exclusive-area=CAN_EXCLUSIVE_AREA_0, reentrancy-level=SINGLE-CORE-REENTRANT, implemented-entry=Can_DisableControllerInterrupts
          bsw direct call point Det_ReportError: called-entry=Det_ReportError
        Can_EnableControllerInterrupts: can-enter-exclusive-area=CAN_EXCLUSIVE_AREA_0, reentrancy-level=SINGLE-CORE-REENTRANT, implemented-entry=Can_EnableControllerInterrupts
          bsw direct call point Det_ReportError: called-entry=Det_ReportError
        Can_GetControllerErrorState: reentrancy-level=NON-REENTRANT, implemented-entry=Can_GetControllerErrorState
          bsw direct call point Det_ReportError: called-entry=Det_ReportError
        Can_GetControllerMode: reentrancy-level=NON-REENTRANT, implemented-entry=Can_GetControllerMode
          bsw direct call point Det_ReportError: called-entry=Det_ReportError
        Can_GetVersionInfo: reentrancy-level=NON-REENTRANT, implemented-entry=Can_GetVersionInfo
          bsw direct call point Det_ReportError: called-entry=Det_ReportError
        Can_Init: reentrancy-level=NON-REENTRANT, implemented-entry=Can_Init
          bsw direct call point Dem_SetEventStatus: called-entry=Dem_SetEventStatus
          bsw direct call point Det_ReportError: called-entry=Det_ReportError
      4 x bsw schedulable entity:
        Can_MainFunction_BusOff: reentrancy-level=NON-REENTRANT, implemented-entry=Can_MainFunction_BusOff
          bsw direct call point CanIf_ControllerBusOff: called-entry=CanIf_ControllerBusOff
          bsw direct call point Dem_SetEventStatus: called-entry=Dem_SetEventStatus
        Can_MainFunction_Mode: reentrancy-level=NON-REENTRANT, implemented-entry=Can_MainFunction_Mode
          bsw direct call point CanIf_ControllerModeIndication: called-entry=CanIf_ControllerModeIndication
        Can_MainFunction_Read: can-enter-exclusive-area=CAN_EXCLUSIVE_AREA_0, reentrancy-level=SINGLE-CORE-REENTRANT, implemented-entry=Can_MainFunction_Read
          bsw direct call point CanIf_RxIndication: called-entry=CanIf_RxIndication
        Can_MainFunction_Write: can-enter-exclusive-area=CAN_EXCLUSIVE_AREA_0, reentrancy-level=SINGLE-CORE-REENTRANT, implemented-entry=Can_MainFunction_Write
          bsw direct call point CanIf_TxConfirmation: called-entry=CanIf_TxConfirmation
      5 x bsw called entity:
        Can_SetBaudrate: can-enter-exclusive-area=CAN_EXCLUSIVE_AREA_0, reentrancy-level=SINGLE-CORE-REENTRANT, implemented-entry=Can_SetBaudrate
          bsw direct call point Det_ReportError: called-entry=Det_ReportError
        Can_SetControllerMode: reentrancy-level=NON-REENTRANT, implemented-entry=Can_SetControllerMode
          4 x bsw direct call point:
            CanIf_ControllerModeIndication: called-entry=CanIf_ControllerModeIndication
            Dem_ReportErrorStatus: called-entry=Dem_ReportErrorStatus
            Dem_SetEventStatus: called-entry=Dem_SetEventStatus
            Det_ReportError: called-entry=Det_ReportError
        Can_TestLoopBackModeDisable: reentrancy-level=NON-REENTRANT, implemented-entry=Can_TestLoopBackModeDisable
          bsw direct call point Dem_SetEventStatus: called-entry=Dem_SetEventStatus
        Can_TestLoopBackModeEnable: reentrancy-level=NON-REENTRANT, implemented-entry=Can_TestLoopBackModeEnable
          bsw direct call point Dem_SetEventStatus: called-entry=Dem_SetEventStatus
        Can_Write: can-enter-exclusive-area=CAN_EXCLUSIVE_AREA_0, reentrancy-level=SINGLE-CORE-REENTRANT, implemented-entry=Can_Write
          bsw direct call point CanIf_TriggerTransmit: called-entry=CanIf_TriggerTransmit
          bsw direct call point Det_ReportError: called-entry=Det_ReportError
      4 x bsw timing event:
        Can_MainFunctionTimingEvent_BusOff: starts-on-event=Can_MainFunction_BusOff, period=10.0
        Can_MainFunctionTimingEvent_Mode: starts-on-event=Can_MainFunction_Mode, period=10.0
        Can_MainFunctionTimingEvent_Read: starts-on-event=Can_MainFunction_Read, period=0.001
        Can_MainFunctionTimingEvent_Write: starts-on-event=Can_MainFunction_Write, period=0.001
  bsw implementation Can_Impl: programming-language=C, sw-version=10.01.00, vendor-id=44, ar-release-version=4.3.1, behavior=Can_Behavior, vendor-specific-module-def=Can
    code-descriptors:
      code Files
        artifact-descriptors:
          short-label=generate::include::Can_Cfg.h, category=SWHDR
          short-label=generate::src::Can_Cfg.c, category=SWSRC
          short-label=generate::src::Can_PBcfg.c, category=SWSRC
          short-label=include::Can.h, category=SWHDR
          short-label=include::Can_Irq.h, category=SWHDR
          short-label=src::Can.c, category=SWSRC
          short-label=src::Can_Irq.c, category=SWSRC
          short-label=V0::Can_Mcan.c, category=SWSRC
          short-label=V0::Can_Priv.c, category=SWSRC
          short-label=V0::Can_Priv.h, category=SWHDR
          short-label=V0::mcan.c, category=SWSRC
          short-label=V0::mcan.h, category=SWHDR
    compiler tiarmclang: name=TI ARM Clang, options=-mcpu=cortex-r5 -mfpu=vfpv3-d16 -mfloat-abi=hard -c -mlittle-endian -ffunction-sections -gdwarf-3 -Werror -Os -x -save-temps -mthumb -DAM263PX_SIP_PACKAGE -DAM263PX_PLATFORM -DAM263PX_R_PACKAGE -DAM263PX_C_PACKAGE, vendor=Texas Instruments, version=4.0.0
    linker tiarmlnk: name=TI ARM Clang Linker, options=-mcpu=cortex-r5 -Wl,--ram_model -Wl,--reread_libs -Wl,--warn_sections -qq -Wl,--emit_warnings_as_errors --diag_suppress=10068 --diag_suppress=10063, vendor=Texas Instruments, version=4.0.0
    resource consumption ResourceConsumption
      10 x memory section:
        CAN_CODE: alignment=UNSPECIFIED, sw-addrmethod=CODE, symbol=CODE
        CAN_CONFIG_DATA: alignment=UNSPECIFIED, sw-addrmethod=CONFIG_DATA, symbol=CONFIG_DATA
        CAN_ISR_CODE: alignment=UNSPECIFIED, sw-addrmethod=CODE, symbol=ISR_CODE
        CAN_VAR_INIT_32: alignment=32, sw-addrmethod=VAR_INIT, symbol=VAR_INIT_32
        CAN_VAR_INIT_8: alignment=8, sw-addrmethod=VAR_INIT, symbol=VAR_INIT_8
        CAN_VAR_INIT_UNSPECIFIED: alignment=UNSPECIFIED, sw-addrmethod=VAR_INIT, symbol=VAR_INIT_UNSPECIFIED
        CAN_VAR_NO_INIT_UNSPECIFIED: alignment=UNSPECIFIED, sw-addrmethod=VAR_NO_INIT, symbol=VAR_NO_INIT_UNSPECIFIED
        CAN_CONST_UNSPECIFIED: alignment=UNSPECIFIED, sw-addrmethod=CONST, symbol=CONST_UNSPECIFIED
        CAN_CONST_8: alignment=UNSPECIFIED, sw-addrmethod=CONST, symbol=CONST_8
        CAN_CONST_32: alignment=UNSPECIFIED, sw-addrmethod=CONST, symbol=CONST_32
package /Can_TI_AM263Px/Can_ModuleEntry
  27 x bsw module entry, all with sw-service-impl-policy=STANDARD, bsw-entry-kind=CONCRETE:
    Can_{0..7}_Int0ISR: is-reentrant=false, is-synchronous=true, call-type=INTERRUPT, execution-context=INTERRUPT-CAT-1
    Can_CheckWakeup: service-id=11, is-reentrant=false, is-synchronous=true, call-type=REGULAR, execution-context=UNSPECIFIED
    Can_DeInit: service-id=16, is-reentrant=false, is-synchronous=true, call-type=REGULAR, execution-context=UNSPECIFIED
    Can_DisableControllerInterrupts: service-id=4, is-reentrant=true, is-synchronous=true, call-type=REGULAR, execution-context=UNSPECIFIED
    Can_EnableControllerInterrupts: service-id=5, is-reentrant=true, is-synchronous=true, call-type=REGULAR, execution-context=UNSPECIFIED
    Can_GetControllerErrorState: service-id=17, is-reentrant=false, is-synchronous=true, call-type=REGULAR, execution-context=UNSPECIFIED
    Can_GetControllerMode: service-id=18, is-reentrant=false, is-synchronous=true, call-type=REGULAR, execution-context=UNSPECIFIED
    Can_GetVersionInfo: service-id=7, is-reentrant=true, is-synchronous=true, call-type=REGULAR, execution-context=UNSPECIFIED
    Can_Init: service-id=0, is-reentrant=false, is-synchronous=true, call-type=REGULAR, execution-context=UNSPECIFIED
    Can_MainFunction_BusOff: service-id=9, is-reentrant=true, is-synchronous=true, call-type=SCHEDULED, execution-context=TASK
    Can_MainFunction_Mode: service-id=12, is-reentrant=true, is-synchronous=true, call-type=SCHEDULED, execution-context=TASK
    Can_MainFunction_Read: service-id=8, is-reentrant=true, is-synchronous=true, call-type=SCHEDULED, execution-context=TASK
    Can_MainFunction_Wakeup: service-id=10, is-reentrant=true, is-synchronous=true, call-type=SCHEDULED, execution-context=TASK
    Can_MainFunction_Write: service-id=1, is-reentrant=true, is-synchronous=true, call-type=SCHEDULED, execution-context=TASK
    Can_RegisterReadback: is-reentrant=false, is-synchronous=true, call-type=REGULAR, execution-context=UNSPECIFIED
    Can_SetBaudrate: service-id=15, is-reentrant=false, is-synchronous=true, call-type=REGULAR, execution-context=UNSPECIFIED
    Can_SetControllerMode: service-id=3, is-reentrant=false, is-synchronous=false, call-type=REGULAR, execution-context=UNSPECIFIED
    Can_TestLoopBackModeDisable: is-reentrant=false, is-synchronous=true, call-type=REGULAR, execution-context=UNSPECIFIED
    Can_TestLoopBackModeEnable: is-reentrant=false, is-synchronous=true, call-type=REGULAR, execution-context=UNSPECIFIED
    Can_Write: service-id=6, is-reentrant=true, is-synchronous=true, call-type=REGULAR, execution-context=UNSPECIFIED
