AUTOSAR XML (schema 00044)
package /Cdd_FsiTx_TI_AM263Px
  bsw module description Cdd_FsiTx: category=BSW_MODULE, module-id=255
    implemented-entrys:
      CddFsiTx_FSIINT1_IrqUnit1
      CddFsiTx_FSIINT2_IrqUnit1
      CddFsiTx_GetStatus
      Cdd_FsiTx_BufferLoad
      Cdd_FsiTx_DeInit
      Cdd_FsiTx_GetVersionInfo
      Cdd_FsiTx_Init
      Cdd_FsiTx_Ping
      Cdd_FsiTx_Reset
      Cdd_FsiTx_RegisterReadback
      Cdd_FsiTx_Transmit
    bsw module dependency Dem: target-module-id=54, target-module=Dem
    bsw module dependency Det: target-module-id=15, target-module=Det
    bsw internal behavior Cdd_Fsi_Tx_Behavior
      exclusive area FSI_TX_EXCLUSIVE_AREA_0
      bsw interrupt entity CddFsiTx_FSIINT1_IrqUnit1: reentrancy-level=NON-REENTRANT, implemented-entry=CddFsiTx_FSIINT1_IrqUnit1, interrupt-category=CAT-1, interrupt-source=Hardware
      bsw interrupt entity CddFsiTx_FSIINT2_IrqUnit1: reentrancy-level=NON-REENTRANT, implemented-entry=CddFsiTx_FSIINT2_IrqUnit1, interrupt-category=CAT-1, interrupt-source=Hardware
      9 x bsw called entity:
        CddFsiTx_GetStatus: reentrancy-level=NON-REENTRANT, implemented-entry=CddFsiTx_GetStatus
        Cdd_FsiTx_BufferLoad: reentrancy-level=NON-REENTRANT, implemented-entry=Cdd_FsiTx_BufferLoad
          bsw direct call point Det_ReportError: called-entry=Det_ReportError
          bsw direct call point Det_ReportRuntimeError: called-entry=Det_ReportRuntimeError
        Cdd_FsiTx_DeInit: reentrancy-level=NON-REENTRANT, implemented-entry=Cdd_FsiTx_DeInit
          bsw direct call point Det_ReportError: called-entry=Det_ReportError
        Cdd_FsiTx_GetVersionInfo: reentrancy-level=SINGLE-CORE-REENTRANT, implemented-entry=Cdd_FsiTx_GetVersionInfo
          bsw direct call point Det_ReportError: called-entry=Det_ReportError
        Cdd_FsiTx_Init: reentrancy-level=NON-REENTRANT, implemented-entry=Cdd_FsiTx_Init
          bsw direct call point Det_ReportError: called-entry=Det_ReportError
        Cdd_FsiTx_Ping: reentrancy-level=NON-REENTRANT, implemented-entry=Cdd_FsiTx_Ping
          bsw direct call point Det_ReportError: called-entry=Det_ReportError
          bsw direct call point Det_ReportRuntimeError: called-entry=Det_ReportRuntimeError
        Cdd_FsiTx_Reset: reentrancy-level=NON-REENTRANT, implemented-entry=Cdd_FsiTx_Reset
          bsw direct call point Det_ReportError: called-entry=Det_ReportError
        Cdd_FsiTx_Transmit: can-enter-exclusive-area=FSI_TX_EXCLUSIVE_AREA_0, reentrancy-level=SINGLE-CORE-REENTRANT, implemented-entry=Cdd_FsiTx_Transmit
          bsw direct call point Det_ReportError: called-entry=Det_ReportError
          bsw direct call point Det_ReportRuntimeError: called-entry=Det_ReportRuntimeError
        Cdd_FsiTx_RegisterReadback: reentrancy-level=NON-REENTRANT, implemented-entry=Cdd_FsiTx_RegisterReadback
          bsw direct call point Det_ReportError: called-entry=Det_ReportError
  bsw implementation Cdd_FsiTx_Impl: programming-language=C, sw-version=10.01.00, vendor-id=44, ar-release-version=4.3.1, behavior=Cdd_Fsi_Tx_Behavior, vendor-specific-module-def=Cdd_FsiTx
    code-descriptors:
      code Files
        artifact-descriptors:
          short-label=V0::Cdd_FsiTx_Irq.c, category=SWSRC
          short-label=V0::Cdd_FsiTx_Irq.h, category=SWHDR
          short-label=V0::Cdd_FsiTx_Platform.c, category=SWSRC
          short-label=V0::Cdd_FsiTx_Platform.c, category=SWSRC
          short-label=V0::Cdd_FsiTx_Priv.c, category=SWSRC
          short-label=V0::Cdd_FsiTx_Priv.h, category=SWHDR
          short-label=V0::Cdd_FsiTx_Reg.h, category=SWHDR
          short-label=V0::Cdd_FsiTx_Types.h, category=SWHDR
          short-label=generate::include::Cdd_FsiTx_Cfg.h, category=SWHDR
          short-label=generate::src::Cdd_FsiTx_Cfg.c, category=SWSRC
          short-label=generate::src::Cdd_FsiTx_PBcfg.c, category=SWSRC
          short-label=include::Cdd_FsiTx.h, category=SWHDR
          short-label=src::Cdd_FsiTx.c, category=SWSRC
    compiler tiarmclang: name=TI ARM Clang, options=-mcpu=cortex-r5 -mfpu=vfpv3-d16 -mfloat-abi=hard -c -mlittle-endian -ffunction-sections -gdwarf-3 -Werror -Os -x -save-temps -mthumb -DAM263PX_SIP_PACKAGE -DAM263PX_PLATFORM -DAM263PX_R_PACKAGE -DAM263PX_C_PACKAGE, vendor=Texas Instruments, version=4.0.0
    linker tiarmlnk: name=TI ARM Clang Linker, options=-mcpu=cortex-r5 -Wl,--ram_model -Wl,--reread_libs -Wl,--warn_sections -qq -Wl,--emit_warnings_as_errors --diag_suppress=10068 --diag_suppress=10063, vendor=Texas Instruments, version=4.0.0
    resource consumption ResourceConsumption
      8 x memory section:
        CDD_FSI_TX_CODE: alignment=UNSPECIFIED, sw-addrmethod=CODE, symbol=CODE
        CDD_FSI_TX_CONFIG_DATA: alignment=UNSPECIFIED, sw-addrmethod=CONFIG_DATA, symbol=CONFIG_DATA
        CDD_FSI_TX_ISR_CODE: alignment=UNSPECIFIED, sw-addrmethod=CODE, symbol=ISR_CODE
        CDD_FSI_TX_VAR_INIT_UNSPECIFIED: alignment=UNSPECIFIED, sw-addrmethod=VAR_INIT, symbol=VAR_INIT_UNSPECIFIED
        CDD_FSI_TX_VAR_INIT_32: alignment=32, sw-addrmethod=VAR_INIT, symbol=VAR_INIT_32
        CDD_FSITX_VAR_INIT_16: prefix=CDD_FSITX, sw-addrmethod=VAR_INIT, symbol=VAR_INIT_16
        CDD_FSI_TX_VAR_NO_INIT_8: alignment=8, sw-addrmethod=VAR_NO_INIT, symbol=VAR_NO_INIT_8
        CDD_FSI_TX_VAR_NO_INIT_UNSPECIFIED: alignment=UNSPECIFIED, sw-addrmethod=VAR_NO_INIT, symbol=VAR_NO_INIT_UNSPECIFIED
package /Cdd_FsiTx_TI_AM263Px/Cdd_FsiTx_ModuleEntry
  17 x bsw module entry, all with is-synchronous=true, sw-service-impl-policy=STANDARD, bsw-entry-kind=CONCRETE:
    CddFsiTx_FSIINT1_IrqUnit{0..3}: is-reentrant=false, call-type=INTERRUPT, execution-context=INTERRUPT-CAT-1
    CddFsiTx_FSIINT2_IrqUnit{0..3}: is-reentrant=false, call-type=INTERRUPT, execution-context=INTERRUPT-CAT-1
    CddFsiTx_GetStatus: service-id=6, is-reentrant=false, call-type=REGULAR, execution-context=UNSPECIFIED
    Cdd_FsiTx_BufferLoad: service-id=4, is-reentrant=false, call-type=REGULAR, execution-context=UNSPECIFIED
    Cdd_FsiTx_DeInit: service-id=8, is-reentrant=false, call-type=REGULAR, execution-context=UNSPECIFIED
    Cdd_FsiTx_GetVersionInfo: service-id=2, is-reentrant=true, call-type=REGULAR, execution-context=UNSPECIFIED
    Cdd_FsiTx_Init: service-id=1, is-reentrant=false, call-type=REGULAR, execution-context=UNSPECIFIED
    Cdd_FsiTx_MainFunction: service-id=7, is-reentrant=true, call-type=REGULAR, execution-context=UNSPECIFIED
    Cdd_FsiTx_Ping: service-id=3, is-reentrant=false, call-type=REGULAR, execution-context=UNSPECIFIED
    Cdd_FsiTx_Reset: service-id=9, is-reentrant=false, call-type=REGULAR, execution-context=UNSPECIFIED
    Cdd_FsiTx_Transmit: service-id=5, is-reentrant=true, call-type=REGULAR, execution-context=UNSPECIFIED
