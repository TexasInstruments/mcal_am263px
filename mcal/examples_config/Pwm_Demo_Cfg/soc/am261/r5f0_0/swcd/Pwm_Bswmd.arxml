AUTOSAR XML (schema 00044)
package /Pwm_TI_AM261x
  bsw module description Pwm: category=BSW_MODULE, module-id=121
    implemented-entrys:
      Pwm_Ch0Isr
      Pwm_DeInit
      Pwm_DisableNotification
      Pwm_EnableNotification
      Pwm_GetVersionInfo
      Pwm_Init
      Pwm_RegisterReadback
      Pwm_SetDutyCycle
      Pwm_SetOutputToIdle
      Pwm_SetPeriodAndDuty
    bsw module dependency Det: target-module-id=15, target-module=Det
    bsw internal behavior Pwm_Behavior
      exclusive area PWM_EXCLUSIVE_AREA_0
      bsw interrupt entity Pwm_Ch0Isr: reentrancy-level=NON-REENTRANT, implemented-entry=Pwm_Ch0Isr, interrupt-category=CAT-1, interrupt-source=Hardware
      9 x bsw called entity:
        Pwm_DeInit: reentrancy-level=NON-REENTRANT, implemented-entry=Pwm_DeInit
          bsw direct call point Det_ReportError: called-entry=Det_ReportError
        Pwm_DisableNotification: can-enter-exclusive-area=PWM_EXCLUSIVE_AREA_0, reentrancy-level=SINGLE-CORE-REENTRANT, implemented-entry=Pwm_DisableNotification
          bsw direct call point Det_ReportError: called-entry=Det_ReportError
        Pwm_EnableNotification: can-enter-exclusive-area=PWM_EXCLUSIVE_AREA_0, reentrancy-level=SINGLE-CORE-REENTRANT, implemented-entry=Pwm_EnableNotification
          bsw direct call point Det_ReportError: called-entry=Det_ReportError
        Pwm_GetVersionInfo: reentrancy-level=SINGLE-CORE-REENTRANT, implemented-entry=Pwm_GetVersionInfo
          bsw direct call point Det_ReportError: called-entry=Det_ReportError
        Pwm_Init: reentrancy-level=NON-REENTRANT, implemented-entry=Pwm_Init
          bsw direct call point Det_ReportError: called-entry=Det_ReportError
        Pwm_RegisterReadback: reentrancy-level=SINGLE-CORE-REENTRANT, implemented-entry=Pwm_RegisterReadback
          bsw direct call point Det_ReportError: called-entry=Det_ReportError
        Pwm_SetDutyCycle: can-enter-exclusive-area=PWM_EXCLUSIVE_AREA_0, reentrancy-level=SINGLE-CORE-REENTRANT, implemented-entry=Pwm_SetDutyCycle
        Pwm_SetOutputToIdle: can-enter-exclusive-area=PWM_EXCLUSIVE_AREA_0, reentrancy-level=SINGLE-CORE-REENTRANT, implemented-entry=Pwm_SetOutputToIdle
          bsw direct call point Det_ReportError: called-entry=Det_ReportError
        Pwm_SetPeriodAndDuty: can-enter-exclusive-area=PWM_EXCLUSIVE_AREA_0, reentrancy-level=SINGLE-CORE-REENTRANT, implemented-entry=Pwm_SetPeriodAndDuty
          bsw direct call point Det_ReportError: called-entry=Det_ReportError
  bsw implementation Pwm_Impl: programming-language=C, sw-version=10.01.00, vendor-id=44, ar-release-version=4.3.1, behavior=Pwm_Behavior, vendor-specific-module-def=Pwm
    code-descriptors:
      code Files
        artifact-descriptors:
          short-label=V0::Pwm_Irq.c, category=SWSRC
          short-label=V0::Pwm_Irq.h, category=SWHDR
          short-label=V0::Pwm_Priv.c, category=SWSRC
          short-label=V0::Pwm_Priv.h, category=SWHDR
          short-label=V0::Pwm_Sfo.c, category=SWSRC
          short-label=V0::Pwm_Sfo.h, category=SWHDR
          short-label=generate::include::Pwm_Cfg.h, category=SWHDR
          short-label=generate::src::Pwm_Cfg.c, category=SWSRC
          short-label=generate::src::Pwm_PBcfg.c, category=SWSRC
          short-label=include::Pwm.h, category=SWHDR
          short-label=src::Pwm.c, category=SWSRC
    compiler tiarmclang: name=TI ARM Clang, options=-mcpu=cortex-r5 -mfpu=vfpv3-d16 -mfloat-abi=hard -c -mlittle-endian -ffunction-sections -gdwarf-3 -Werror -Os -x -save-temps -mthumb -DAM261X_PLATFORM, vendor=Texas Instruments, version=4.0.0
    linker tiarmlnk: name=TI ARM Clang Linker, options=-mcpu=cortex-r5 -Wl,--ram_model -Wl,--reread_libs -Wl,--warn_sections -qq -Wl,--emit_warnings_as_errors --diag_suppress=10068 --diag_suppress=10063, vendor=Texas Instruments, version=4.0.0
    resource consumption ResourceConsumption
      7 x memory section:
        PWM_CODE: alignment=UNSPECIFIED, sw-addrmethod=CODE, symbol=CODE
        PWM_CONFIG_DATA: alignment=UNSPECIFIED, sw-addrmethod=CONFIG_DATA, symbol=CONFIG_DATA
        PWM_ISR_CODE: alignment=UNSPECIFIED, sw-addrmethod=CODE, symbol=ISR_CODE
        PWM_VAR_INIT_32: alignment=32, sw-addrmethod=VAR_INIT, symbol=VAR_INIT_32
        PWM_VAR_INIT_8: alignment=8, sw-addrmethod=VAR_INIT, symbol=VAR_INIT_8
        PWM_VAR_NO_INIT_32: alignment=32, sw-addrmethod=VAR_NO_INIT, symbol=VAR_NO_INIT_32
        PWM_VAR_NO_INIT_UNSPECIFIED: alignment=UNSPECIFIED, sw-addrmethod=VAR_NO_INIT, symbol=VAR_NO_INIT_UNSPECIFIED
package /Pwm_TI_AM261x/Pwm_ModuleEntry
  30 x bsw module entry, all with sw-service-impl-policy=STANDARD, bsw-entry-kind=CONCRETE:
    Pwm_Ch0Isr: is-reentrant=false, is-synchronous=true, call-type=INTERRUPT, execution-context=INTERRUPT-CAT-1
    Pwm_Ch{10..19}Isr: is-reentrant=false, is-synchronous=true, call-type=INTERRUPT, execution-context=INTERRUPT-CAT-1
    Pwm_Ch{1..9}Isr: is-reentrant=false, is-synchronous=true, call-type=INTERRUPT, execution-context=INTERRUPT-CAT-1
    Pwm_DeInit: service-id=1, is-reentrant=false, is-synchronous=true, call-type=REGULAR, execution-context=UNSPECIFIED
    Pwm_DisableNotification: service-id=6, is-reentrant=true, is-synchronous=true, call-type=REGULAR, execution-context=UNSPECIFIED
    Pwm_EnableNotification: service-id=7, is-reentrant=true, is-synchronous=true, call-type=REGULAR, execution-context=UNSPECIFIED
    Pwm_GetOutputState: service-id=5, is-reentrant=true, is-synchronous=true, call-type=REGULAR, execution-context=UNSPECIFIED
    Pwm_GetVersionInfo: service-id=8, is-reentrant=true, is-synchronous=true, call-type=REGULAR, execution-context=UNSPECIFIED
    Pwm_Init: service-id=0, is-reentrant=false, is-synchronous=true, call-type=REGULAR, execution-context=UNSPECIFIED
    Pwm_RegisterReadback: service-id=7, is-reentrant=true, is-synchronous=false, call-type=REGULAR, execution-context=UNSPECIFIED
    Pwm_SetDutyCycle: service-id=2, is-reentrant=true, is-synchronous=true, call-type=REGULAR, execution-context=UNSPECIFIED
    Pwm_SetOutputToIdle: service-id=4, is-reentrant=true, is-synchronous=true, call-type=REGULAR, execution-context=UNSPECIFIED
    Pwm_SetPeriodAndDuty: service-id=3, is-reentrant=true, is-synchronous=true, call-type=REGULAR, execution-context=UNSPECIFIED
