AUTOSAR XML (schema 00044)
package /Cdd_Ipc_TI_AM263px
  bsw module description Cdd_Ipc: category=BSW_MODULE, module-id=255
    implemented-entrys:
      Cdd_Ipc_Construct
      Cdd_Ipc_Destruct
      Cdd_Ipc_DeInit
      Cdd_Ipc_GetVersionInfo
      Cdd_Ipc_Init
      Cdd_Ipc_Isr
      Cdd_Ipc_Notify_RegisterClient
      Cdd_Ipc_Notify_Sync_All
      Cdd_Ipc_Notify_Write
      Cdd_Ipc_Notify_UnregisterClient
      Cdd_Ipc_RpMsg_RecvMsg
      Cdd_Ipc_RpMsg_SendMsg
    bsw module dependency Det: target-module-id=15, target-module=Det
    bsw internal behavior Cdd_Ipc_Behavior
      exclusive area IPC_EXCLUSIVE_AREA_0
      5 x bsw called entity:
        Cdd_Ipc_Construct: reentrancy-level=NON-REENTRANT, implemented-entry=Cdd_Ipc_Construct
          bsw direct call point Det_ReportError: called-entry=Det_ReportError
          bsw direct call point Det_ReportRuntimeError: called-entry=Det_ReportRuntimeError
        Cdd_Ipc_Destruct: reentrancy-level=NON-REENTRANT, implemented-entry=Cdd_Ipc_Destruct
          bsw direct call point Det_ReportError: called-entry=Det_ReportError
        Cdd_Ipc_DeInit: reentrancy-level=NON-REENTRANT, implemented-entry=Cdd_Ipc_DeInit
          bsw direct call point Det_ReportError: called-entry=Det_ReportError
          bsw direct call point Det_ReportRuntimeError: called-entry=Det_ReportRuntimeError
        Cdd_Ipc_GetVersionInfo: reentrancy-level=SINGLE-CORE-REENTRANT, implemented-entry=Cdd_Ipc_GetVersionInfo
          bsw direct call point Det_ReportError: called-entry=Det_ReportError
        Cdd_Ipc_Init: reentrancy-level=NON-REENTRANT, implemented-entry=Cdd_Ipc_Init
          bsw direct call point Det_ReportError: called-entry=Det_ReportError
          bsw direct call point Det_ReportRuntimeError: called-entry=Det_ReportRuntimeError
      bsw interrupt entity Cdd_Ipc_Isr: reentrancy-level=NON-REENTRANT, implemented-entry=Cdd_Ipc_Isr, interrupt-category=CAT-1, interrupt-source=Hardware
      6 x bsw called entity:
        Cdd_Ipc_Notify_RegisterClient: can-enter-exclusive-area=IPC_EXCLUSIVE_AREA_0, reentrancy-level=SINGLE-CORE-REENTRANT, implemented-entry=Cdd_Ipc_Notify_RegisterClient
          bsw direct call point Det_ReportError: called-entry=Det_ReportError
        Cdd_Ipc_Notify_Sync_All: reentrancy-level=NON-REENTRANT, implemented-entry=Cdd_Ipc_Notify_Sync_All
        Cdd_Ipc_Notify_Write: can-enter-exclusive-area=IPC_EXCLUSIVE_AREA_0, reentrancy-level=SINGLE-CORE-REENTRANT, implemented-entry=Cdd_Ipc_Notify_Write
          bsw direct call point Det_ReportError: called-entry=Det_ReportError
        Cdd_Ipc_Notify_UnregisterClient: can-enter-exclusive-area=IPC_EXCLUSIVE_AREA_0, reentrancy-level=NON-REENTRANT, implemented-entry=Cdd_Ipc_Notify_UnregisterClient
          bsw direct call point Det_ReportError: called-entry=Det_ReportError
        Cdd_Ipc_RpMsg_RecvMsg: can-enter-exclusive-area=IPC_EXCLUSIVE_AREA_0, reentrancy-level=NON-REENTRANT, implemented-entry=Cdd_Ipc_RpMsg_RecvMsg
          bsw direct call point Det_ReportError: called-entry=Det_ReportError
        Cdd_Ipc_RpMsg_SendMsg: can-enter-exclusive-area=IPC_EXCLUSIVE_AREA_0, reentrancy-level=NON-REENTRANT, implemented-entry=Cdd_Ipc_RpMsg_SendMsg
          bsw direct call point Det_ReportError: called-entry=Det_ReportError
  bsw implementation Cdd_Ipc_Impl: programming-language=C, sw-version=10.01.00, vendor-id=44, ar-release-version=4.3.1, behavior=Cdd_Ipc_Behavior, vendor-specific-module-def=Cdd_Ipc
    code-descriptors:
      code Files
        artifact-descriptors:
          short-label=generate::include::Cdd_Ipc_Cfg.h, category=SWHDR
          short-label=generate::src::Cdd_Ipc_PBCfg.c, category=SWSRC
          short-label=include::Cdd_Ipc_Irq.h, category=SWHDR
          short-label=include::Cdd_Ipc.h, category=SWHDR
          short-label=include::ipc_notify_lld_utils.h, category=SWHDR
          short-label=include::ipc_notify_v1_lld.h, category=SWHDR
          short-label=include::ipc_notify_v1_mailbox.h, category=SWHDR
          short-label=include::ipc_rpmsg_linux_resource_table.h, category=SWHDR
          short-label=include::ipc_rpmsg_lld_priv.h, category=SWHDR
          short-label=include::ipc_rpmsg_lld_queue.h, category=SWHDR
          short-label=include::ipc_rpmsg_lld.h, category=SWHDR
          short-label=src::Cdd_Ipc_Irq.c, category=SWSRC
          short-label=src::Cdd_Ipc.c, category=SWSRC
          short-label=src::ipc_notify_lld_utils.c, category=SWSRC
          short-label=src::ipc_notify_v1_lld.c, category=SWSRC
          short-label=src::ipc_rpmsg_lld_vring.c, category=SWSRC
          short-label=src::ipc_rpmsg_lld.c, category=SWSRC
          short-label=V0::hw_mailbox.h, category=SWHDR
          short-label=V0::ipc_notify_v1_cfg_lld.c, category=SWSRC
          short-label=V0::ipc_notify_v1_cfg_lld.h, category=SWHDR
    compiler tiarmclang: name=TI ARM Clang, options=-mcpu=cortex-r5 -mfpu=vfpv3-d16 -mfloat-abi=hard -c -mlittle-endian -ffunction-sections -gdwarf-3 -Werror -Os -x -save-temps -mthumb -DAM263PX_SIP_PACKAGE -DAM263PX_PLATFORM -DAM263PX_R_PACKAGE -DAM263PX_C_PACKAGE, vendor=Texas Instruments, version=4.0.0
    linker tiarmlnk: name=TI ARM Clang Linker, options=-mcpu=cortex-r5 -Wl,--ram_model -Wl,--reread_libs -Wl,--warn_sections -qq -Wl,--emit_warnings_as_errors --diag_suppress=10068 --diag_suppress=10063, vendor=Texas Instruments, version=4.0.0
    resource consumption ResourceConsumption
      7 x memory section:
        CDD_IPC_CODE: sw-addrmethod=CODE, symbol=CODE
        CDD_IPC_CONFIG_DATA: alignment=UNSPECIFIED, sw-addrmethod=CONFIG_DATA, symbol=CONFIG_DATA
        CDD_IPC_ISR_CODE: sw-addrmethod=CODE, symbol=ISR_CODE
        CDD_IPC_VAR_INIT_32: alignment=32, sw-addrmethod=VAR_INIT, symbol=VAR_INIT_32
        CDD_IPC_VAR_INIT_UNSPECIFIED: alignment=UNSPECIFIED, sw-addrmethod=VAR_INIT, symbol=VAR_INIT_UNSPECIFIED
        CDD_IPC_VAR_NO_INIT_8: alignment=8, sw-addrmethod=VAR_NO_INIT, symbol=VAR_NO_INIT_8
        CDD_IPC_VAR_NO_INIT_UNSPECIFIED: alignment=UNSPECIFIED, sw-addrmethod=VAR_NO_INIT, symbol=VAR_NO_INIT_UNSPECIFIED
package /Cdd_Ipc_TI_AM263px/Cdd_Ipc_ModuleEntry
  12 x bsw module entry, all with is-synchronous=true, sw-service-impl-policy=STANDARD, bsw-entry-kind=CONCRETE:
    Cdd_Ipc_Construct: service-id=9, is-reentrant=false, call-type=REGULAR, execution-context=UNSPECIFIED
    Cdd_Ipc_Destruct: service-id=16, is-reentrant=false, call-type=REGULAR, execution-context=UNSPECIFIED
    Cdd_Ipc_DeInit: service-id=13, is-reentrant=false, call-type=REGULAR, execution-context=UNSPECIFIED
    Cdd_Ipc_GetVersionInfo: service-id=2, is-reentrant=true, call-type=REGULAR, execution-context=UNSPECIFIED
    Cdd_Ipc_Init: service-id=1, is-reentrant=false, call-type=REGULAR, execution-context=UNSPECIFIED
    Cdd_Ipc_Notify_RegisterClient: service-id=8, is-reentrant=true, call-type=REGULAR, execution-context=UNSPECIFIED
    Cdd_Ipc_Notify_Sync_All: service-id=17, is-reentrant=false, call-type=REGULAR, execution-context=UNSPECIFIED
    Cdd_Ipc_Notify_UnregisterClient: service-id=15, is-reentrant=false, call-type=REGULAR, execution-context=UNSPECIFIED
    Cdd_Ipc_Notify_Write: service-id=4, is-reentrant=true, call-type=REGULAR, execution-context=UNSPECIFIED
    Cdd_Ipc_RpMsg_RecvMsg: service-id=6, is-reentrant=false, call-type=REGULAR, execution-context=UNSPECIFIED
    Cdd_Ipc_RpMsg_SendMsg: service-id=7, is-reentrant=false, call-type=REGULAR, execution-context=UNSPECIFIED
    Cdd_Ipc_Isr: is-reentrant=false, call-type=INTERRUPT, execution-context=INTERRUPT-CAT-1
