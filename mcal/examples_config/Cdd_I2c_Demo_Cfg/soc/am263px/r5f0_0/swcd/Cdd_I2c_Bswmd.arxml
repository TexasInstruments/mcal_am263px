AUTOSAR XML (schema 00044)
package /Cdd_I2c_TI_AM263px
  bsw module description Cdd_I2c: category=BSW_MODULE, module-id=255
    expected-entrys:
      Cdd_I2c_AsyncTransmit
      Cdd_I2c_Cancel
      Cdd_I2c_DeInit
      Cdd_I2c_GetResult
      Cdd_I2c_GetSequenceResult
      Cdd_I2c_GetStatus
      Cdd_I2c_GetVersionInfo
      Cdd_I2c_HwUnit{0..3}_ISR
      Cdd_I2c_Init
      Cdd_I2c_MainFunction
      Cdd_I2c_RegisterReadback
      Cdd_I2c_SetHandling
      Cdd_I2c_SetupEB
      Cdd_I2c_SetupEBDynamic
    bsw module dependency Det: target-module-id=15, target-module=Det
    bsw internal behavior Cdd_I2c_Behavior
      exclusive area I2C_EXCLUSIVE_AREA_0
      7 x bsw called entity:
        Cdd_I2c_AsyncTransmit: can-enter-exclusive-area=I2C_EXCLUSIVE_AREA_0, reentrancy-level=SINGLE-CORE-REENTRANT, implemented-entry=Cdd_I2c_AsyncTransmit
          bsw direct call point Det_ReportError: called-entry=Det_ReportError
        Cdd_I2c_Cancel: reentrancy-level=NON-REENTRANT, implemented-entry=Cdd_I2c_Cancel
          bsw direct call point Det_ReportError: called-entry=Det_ReportError
        Cdd_I2c_Deinit: reentrancy-level=NON-REENTRANT, implemented-entry=Cdd_I2c_DeInit
          bsw direct call point Det_ReportError: called-entry=Det_ReportError
        Cdd_I2c_GetResult: reentrancy-level=SINGLE-CORE-REENTRANT, implemented-entry=Cdd_I2c_GetResult
          bsw direct call point Det_ReportError: called-entry=Det_ReportError
        Cdd_I2c_GetSequenceResult: reentrancy-level=SINGLE-CORE-REENTRANT, implemented-entry=Cdd_I2c_GetSequenceResult
          bsw direct call point Det_ReportError: called-entry=Det_ReportError
        Cdd_I2c_GetStatus: reentrancy-level=SINGLE-CORE-REENTRANT, implemented-entry=Cdd_I2c_GetStatus
        Cdd_I2c_GetVersionInfo: reentrancy-level=SINGLE-CORE-REENTRANT, implemented-entry=Cdd_I2c_GetVersionInfo
          bsw direct call point Det_ReportError: called-entry=Det_ReportError
      4 x bsw interrupt entity, all with reentrancy-level=NON-REENTRANT, interrupt-category=CAT-2:
        Cdd_I2c_HwUnit0_ISR: implemented-entry=Cdd_I2c_HwUnit0_ISR
          bsw direct call point Det_ReportError: called-entry=Det_ReportError
        Cdd_I2c_HwUnit1_ISR: implemented-entry=Cdd_I2c_HwUnit1_ISR
          bsw direct call point Det_ReportError: called-entry=Det_ReportError
        Cdd_I2c_HwUnit2_ISR: implemented-entry=Cdd_I2c_HwUnit2_ISR
          bsw direct call point Det_ReportError: called-entry=Det_ReportError
        Cdd_I2c_HwUnit3_ISR: implemented-entry=Cdd_I2c_HwUnit3_ISR
          bsw direct call point Det_ReportError: called-entry=Det_ReportError
      6 x bsw called entity:
        Cdd_I2c_Init: reentrancy-level=NON-REENTRANT, implemented-entry=Cdd_I2c_Init
          bsw direct call point Det_ReportError: called-entry=Det_ReportError
        Cdd_I2c_MainFunction: can-enter-exclusive-area=I2C_EXCLUSIVE_AREA_0, reentrancy-level=SINGLE-CORE-REENTRANT, implemented-entry=Cdd_I2c_MainFunction
          bsw direct call point Det_ReportError: called-entry=Det_ReportError
        Cdd_I2c_RegisterReadback: reentrancy-level=SINGLE-CORE-REENTRANT, implemented-entry=Cdd_I2c_RegisterReadback
          bsw direct call point Det_ReportError: called-entry=Det_ReportError
        Cdd_I2c_SetHandling: reentrancy-level=SINGLE-CORE-REENTRANT, implemented-entry=Cdd_I2c_SetHandling
          bsw direct call point Det_ReportError: called-entry=Det_ReportError
        Cdd_I2c_SetupEB: reentrancy-level=NON-REENTRANT, implemented-entry=Cdd_I2c_SetupEB
          bsw direct call point Det_ReportError: called-entry=Det_ReportError
        Cdd_I2c_SetupEBDynamic: reentrancy-level=NON-REENTRANT, implemented-entry=Cdd_I2c_SetupEBDynamic
          bsw direct call point Det_ReportError: called-entry=Det_ReportError
  bsw implementation Cdd_I2c_Impl: programming-language=C, sw-version=10.01.00, vendor-id=44, ar-release-version=4.3.1, behavior=Cdd_I2c_Behavior, vendor-specific-module-def=Cdd_I2c
    code-descriptors:
      code Files
        artifact-descriptors:
          short-label=V0::Cdd_I2c_hw_reg.h, category=SWHDR
          short-label=V0::Cdd_I2c_priv.c, category=SWSRC
          short-label=V0::Cdd_I2c_priv.h, category=SWHDR
          short-label=generate::include::Cdd_I2c_Cfg.h, category=SWHDR
          short-label=generate::src::Cdd_I2c_Cfg.c, category=SWSRC
          short-label=generate::src::Cdd_I2c_PBcfg.c, category=SWSRC
          short-label=include::Cdd_I2c.h, category=SWHDR
          short-label=include::Cdd_I2c_Irq.h, category=SWHDR
          short-label=src::Cdd_I2c.c, category=SWSRC
          short-label=src::Cdd_I2c_Irq.c, category=SWSRC
    compiler tiarmclang: name=TI ARM Clang, vendor=Texas Instruments, version=4.0.0
    linker tiarmlnk: name=TI ARM Clang Linker, vendor=Texas Instruments, version=4.0.0
    resource consumption ResourceConsumption
      8 x memory section:
        CDD_I2C_CODE: alignment=UNSPECIFIED, sw-addrmethod=CODE, symbol=CODE
        CDD_I2C_CONFIG_DATA: alignment=UNSPECIFIED, sw-addrmethod=CONST_PBCFG, symbol=CONFIG_DATA
        CDD_I2C_ISR_CODE: alignment=UNSPECIFIED, sw-addrmethod=CODE, symbol=ISR_CODE
        CDD_I2C_VAR_INIT_16: alignment=16, sw-addrmethod=VAR_INIT, symbol=VAR_INIT_16
        CDD_I2C_VAR_INIT_32: alignment=32, sw-addrmethod=VAR_INIT, symbol=VAR_INIT_32
        CDD_I2C_VAR_INIT_8: alignment=8, sw-addrmethod=VAR_INIT, symbol=VAR_INIT_8
        CDD_I2C_VAR_INIT_UNSPECIFIED: alignment=UNSPECIFIED, sw-addrmethod=VAR_INIT, symbol=VAR_INIT_UNSPECIFIED
        CDD_I2C_VAR_NO_INIT_UNSPECIFIED: alignment=UNSPECIFIED, sw-addrmethod=VAR_NO_INIT, symbol=VAR_NO_INIT_UNSPECIFIED
package /Cdd_I2c_TI_AM263px/Cdd_I2c_ModuleEntry
  18 x bsw module entry, all with sw-service-impl-policy=STANDARD, bsw-entry-kind=CONCRETE:
    Cdd_I2c_AsyncTransmit: service-id=5, is-reentrant=true, is-synchronous=false, call-type=REGULAR, execution-context=UNSPECIFIED
    Cdd_I2c_Cancel: service-id=6, is-reentrant=true, is-synchronous=true, call-type=REGULAR, execution-context=UNSPECIFIED
    Cdd_I2c_DeInit: service-id=1, is-reentrant=false, is-synchronous=true, call-type=REGULAR, execution-context=UNSPECIFIED
    Cdd_I2c_GetResult: service-id=10, is-reentrant=true, is-synchronous=true, call-type=REGULAR, execution-context=UNSPECIFIED
    Cdd_I2c_GetSequenceResult: service-id=8, is-reentrant=true, is-synchronous=false, call-type=REGULAR, execution-context=UNSPECIFIED
    Cdd_I2c_GetStatus: service-id=3, is-reentrant=true, is-synchronous=true, call-type=REGULAR, execution-context=UNSPECIFIED
    Cdd_I2c_GetVersionInfo: service-id=2, is-reentrant=true, is-synchronous=true, call-type=REGULAR, execution-context=UNSPECIFIED
    Cdd_I2c_HwUnit{0..3}_ISR: is-reentrant=false, is-synchronous=true, call-type=INTERRUPT, execution-context=INTERRUPT-CAT-2
    Cdd_I2c_Init: service-id=0, is-reentrant=false, is-synchronous=true, call-type=REGULAR, execution-context=UNSPECIFIED
    Cdd_I2c_MainFunction: service-id=9, is-reentrant=true, is-synchronous=true, call-type=REGULAR, execution-context=UNSPECIFIED
    Cdd_I2c_PollingModeProcessing: service-id=10, is-reentrant=false, is-synchronous=true, call-type=REGULAR, execution-context=UNSPECIFIED
    Cdd_I2c_RegisterReadback: service-id=12, is-reentrant=true, is-synchronous=true, call-type=REGULAR, execution-context=UNSPECIFIED
    Cdd_I2c_SetHandling: service-id=11, is-reentrant=true, is-synchronous=true, call-type=REGULAR, execution-context=UNSPECIFIED
    Cdd_I2c_SetupEB: service-id=3, is-reentrant=false, is-synchronous=true, call-type=REGULAR, execution-context=UNSPECIFIED
    Cdd_I2c_SetupEBDynamic: service-id=4, is-reentrant=false, is-synchronous=false, call-type=REGULAR, execution-context=UNSPECIFIED
