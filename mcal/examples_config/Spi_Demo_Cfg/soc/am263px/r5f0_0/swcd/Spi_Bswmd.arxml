AUTOSAR XML (schema 00044)
package /Spi_TI_AM263px
  bsw module description Spi: module-id=83
    implemented-entrys:
      Spi_AsyncTransmit
      Spi_Cancel
      Spi_DeInit
      Spi_GetHWUnitStatus
      Spi_GetJobResult
      Spi_GetSequenceResult
      Spi_GetStatus
      Spi_GetVersionInfo
      Spi_Init
      Spi_IrqUnitMcspi{0..7}TxRx
      Spi_MainFunction_Handling
      Spi_ReadIB
      Spi_SetAsyncMode
      Spi_SetupEB
      Spi_SyncTransmit
      Spi_WriteIB
    bsw module dependency Det: target-module-id=15, target-module=Det
    bsw module dependency Cdd_Dma: target-module-id=255, target-module=Cdd_Dma_ModuleEntry
    bsw internal behavior Spi_Behavior
      exclusive area SPI_EXCLUSIVE_AREA_0
      9 x bsw called entity:
        Spi_AsyncTransmit: can-enter-exclusive-area=SPI_EXCLUSIVE_AREA_0, reentrancy-level=SINGLE-CORE-REENTRANT, implemented-entry=Spi_AsyncTransmit
          5 x bsw direct call point:
            Cdd_Dma_EnableTransferRegion
            Cdd_Dma_LinkChannel
            Cdd_Dma_ParamSet
            Det_ReportError: called-entry=Det_ReportError
            Det_ReportRuntimeError: called-entry=Det_ReportRuntimeError
        Spi_Cancel: can-enter-exclusive-area=SPI_EXCLUSIVE_AREA_0, reentrancy-level=SINGLE-CORE-REENTRANT, implemented-entry=Spi_Cancel
          bsw direct call point Det_ReportError: called-entry=Det_ReportError
        Spi_DeInit: reentrancy-level=NON-REENTRANT, implemented-entry=Spi_DeInit
          bsw direct call point Det_ReportError: called-entry=Det_ReportError
        Spi_GetHWUnitStatus: can-enter-exclusive-area=SPI_EXCLUSIVE_AREA_0, reentrancy-level=SINGLE-CORE-REENTRANT, implemented-entry=Spi_GetHWUnitStatus
          bsw direct call point Det_ReportError: called-entry=Det_ReportError
        Spi_GetJobResult: reentrancy-level=SINGLE-CORE-REENTRANT, implemented-entry=Spi_GetJobResult
          bsw direct call point Det_ReportError: called-entry=Det_ReportError
        Spi_GetSequenceResult: reentrancy-level=SINGLE-CORE-REENTRANT, implemented-entry=Spi_GetSequenceResult
          bsw direct call point Det_ReportError: called-entry=Det_ReportError
        Spi_GetStatus: reentrancy-level=SINGLE-CORE-REENTRANT, implemented-entry=Spi_GetStatus
          bsw direct call point Det_ReportError: called-entry=Det_ReportError
        Spi_GetVersionInfo: reentrancy-level=SINGLE-CORE-REENTRANT, implemented-entry=Spi_GetVersionInfo
          bsw direct call point Det_ReportError: called-entry=Det_ReportError
        Spi_Init: reentrancy-level=NON-REENTRANT, implemented-entry=Spi_Init
          bsw direct call point Cdd_Dma_CbkRegister
          bsw direct call point Det_ReportError: called-entry=Det_ReportError
      8 x bsw interrupt entity, all with reentrancy-level=NON-REENTRANT, interrupt-category=CAT-1, interrupt-source=Hardware:
        Spi_IrqUnitMcspi0TxRx: implemented-entry=Spi_IrqUnitMcspi0TxRx
          bsw direct call point Cdd_Dma_EnableTransferRegion
          bsw direct call point Cdd_Dma_LinkChannel
          bsw direct call point Cdd_Dma_ParamSet
        Spi_IrqUnitMcspi1TxRx: implemented-entry=Spi_IrqUnitMcspi1TxRx
          bsw direct call point Cdd_Dma_EnableTransferRegion
          bsw direct call point Cdd_Dma_LinkChannel
          bsw direct call point Cdd_Dma_ParamSet
        Spi_IrqUnitMcspi2TxRx: implemented-entry=Spi_IrqUnitMcspi2TxRx
          bsw direct call point Cdd_Dma_EnableTransferRegion
          bsw direct call point Cdd_Dma_LinkChannel
          bsw direct call point Cdd_Dma_ParamSet
        Spi_IrqUnitMcspi3TxRx: implemented-entry=Spi_IrqUnitMcspi3TxRx
          bsw direct call point Cdd_Dma_EnableTransferRegion
          bsw direct call point Cdd_Dma_LinkChannel
          bsw direct call point Cdd_Dma_ParamSet
        Spi_IrqUnitMcspi4TxRx: implemented-entry=Spi_IrqUnitMcspi4TxRx
          bsw direct call point Cdd_Dma_EnableTransferRegion
          bsw direct call point Cdd_Dma_LinkChannel
          bsw direct call point Cdd_Dma_ParamSet
        Spi_IrqUnitMcspi5TxRx: implemented-entry=Spi_IrqUnitMcspi5TxRx
          bsw direct call point Cdd_Dma_EnableTransferRegion
          bsw direct call point Cdd_Dma_LinkChannel
          bsw direct call point Cdd_Dma_ParamSet
        Spi_IrqUnitMcspi6TxRx: implemented-entry=Spi_IrqUnitMcspi6TxRx
          bsw direct call point Cdd_Dma_EnableTransferRegion
          bsw direct call point Cdd_Dma_LinkChannel
          bsw direct call point Cdd_Dma_ParamSet
        Spi_IrqUnitMcspi7TxRx: implemented-entry=Spi_IrqUnitMcspi7TxRx
          bsw direct call point Cdd_Dma_EnableTransferRegion
          bsw direct call point Cdd_Dma_LinkChannel
          bsw direct call point Cdd_Dma_ParamSet
      bsw schedulable entity Spi_MainFunction_Handling: reentrancy-level=SINGLE-CORE-REENTRANT, implemented-entry=Spi_MainFunction_Handling
        4 x bsw direct call point:
          Cdd_Dma_EnableTransferRegion
          Cdd_Dma_LinkChannel
          Cdd_Dma_ParamSet
          Det_ReportError: called-entry=Det_ReportError
      5 x bsw called entity:
        Spi_ReadIB: can-enter-exclusive-area=SPI_EXCLUSIVE_AREA_0, reentrancy-level=SINGLE-CORE-REENTRANT, implemented-entry=Spi_ReadIB
          bsw direct call point Det_ReportError: called-entry=Det_ReportError
        Spi_SetAsyncMode: reentrancy-level=NON-REENTRANT, implemented-entry=Spi_SetAsyncMode
          bsw direct call point Det_ReportError: called-entry=Det_ReportError
        Spi_SetupEB: can-enter-exclusive-area=SPI_EXCLUSIVE_AREA_0, reentrancy-level=SINGLE-CORE-REENTRANT, implemented-entry=Spi_SetupEB
          bsw direct call point Det_ReportError: called-entry=Det_ReportError
        Spi_SyncTransmit: can-enter-exclusive-area=SPI_EXCLUSIVE_AREA_0, reentrancy-level=SINGLE-CORE-REENTRANT, implemented-entry=Spi_SyncTransmit
          bsw direct call point Det_ReportError: called-entry=Det_ReportError
          bsw direct call point Det_ReportRuntimeError: called-entry=Det_ReportRuntimeError
        Spi_WriteIB: can-enter-exclusive-area=SPI_EXCLUSIVE_AREA_0, reentrancy-level=SINGLE-CORE-REENTRANT, implemented-entry=Spi_WriteIB
          bsw direct call point Det_ReportError: called-entry=Det_ReportError
      bsw timing event Spi_MainFunctionTimingEvent_Handling: starts-on-event=Spi_MainFunction_Handling, period=0.01
  bsw implementation Spi_Impl: programming-language=C, sw-version=10.01.00, vendor-id=44, ar-release-version=4.3.1, behavior=Spi_Behavior, vendor-specific-module-def=Spi
    code-descriptors:
      code Files
        artifact-descriptors:
          short-label=V0::Spi_Dbg.h, category=SWHDR
          short-label=V0::Spi_Dma.c, category=SWSRC
          short-label=V0::Spi_Irq.c, category=SWSRC
          short-label=V0::Spi_Irq.h, category=SWHDR
          short-label=V0::Spi_Mcspi.c, category=SWSRC
          short-label=V0::Spi_Priv.c, category=SWSRC
          short-label=V0::Spi_Priv.h, category=SWHDR
          short-label=V0::Spi_Utils.c, category=SWSRC
          short-label=V0::Spi_Utils.h, category=SWHDR
          short-label=V0::hw_mcspi.h, category=SWHDR
          short-label=V0::lldr_mcspi.h, category=SWHDR
          short-label=generate::include::Spi_Cfg.h, category=SWHDR
          short-label=generate::src::Spi_Cfg.c, category=SWSRC
          short-label=generate::src::Spi_Lcfg.c, category=SWSRC
          short-label=generate::src::Spi_PBcfg.c, category=SWSRC
          short-label=include::Spi.h, category=SWHDR
          short-label=src::Spi.c, category=SWSRC
    compiler tiarmclang: name=TI ARM Clang, options=-mcpu=cortex-r5 -mfpu=vfpv3-d16 -mfloat-abi=hard -c -mlittle-endian -ffunction-sections -gdwarf-3 -Werror -Os -x -save-temps -mthumb -DAM263PX_SIP_PACKAGE -DAM263PX_PLATFORM -DAM263PX_R_PACKAGE -DAM263PX_C_PACKAGE, vendor=Texas Instruments, version=4.0.0
    linker tiarmlnk: name=TI ARM Clang Linker, options=-mcpu=cortex-r5 -Wl,--ram_model -Wl,--reread_libs -Wl,--warn_sections -qq -Wl,--emit_warnings_as_errors --diag_suppress=10068 --diag_suppress=10063, vendor=Texas Instruments, version=4.0.0
    resource consumption ResourceConsumption
      5 x memory section, all with alignment=UNSPECIFIED:
        SPI_CODE: sw-addrmethod=CODE, symbol=CODE
        SPI_CONFIG_DATA: sw-addrmethod=CONFIG_DATA, symbol=CONFIG_DATA
        SPI_ISR_CODE: sw-addrmethod=CODE, symbol=ISR_CODE
        SPI_VAR_INIT_UNSPECIFIED: sw-addrmethod=VAR_INIT, symbol=VAR_INIT_UNSPECIFIED
        SPI_VAR_NO_INIT_UNSPECIFIED: sw-addrmethod=VAR_NO_INIT, symbol=VAR_NO_INIT_UNSPECIFIED
package /Spi_TI_AM263px/BswModuleEntries
  23 x bsw module entry, all with sw-service-impl-policy=STANDARD, bsw-entry-kind=CONCRETE:
    Spi_AsyncTransmit: service-id=3, is-reentrant=true, is-synchronous=false, call-type=REGULAR, execution-context=UNSPECIFIED
    Spi_Cancel: service-id=12, is-reentrant=true, is-synchronous=false, call-type=REGULAR, execution-context=UNSPECIFIED
    Spi_DeInit: service-id=1, is-reentrant=false, is-synchronous=true, call-type=REGULAR, execution-context=UNSPECIFIED
    Spi_GetHWUnitStatus: service-id=11, is-reentrant=true, is-synchronous=true, call-type=REGULAR, execution-context=UNSPECIFIED
    Spi_GetJobResult: service-id=7, is-reentrant=true, is-synchronous=true, call-type=REGULAR, execution-context=UNSPECIFIED
    Spi_GetSequenceResult: service-id=8, is-reentrant=true, is-synchronous=true, call-type=REGULAR, execution-context=UNSPECIFIED
    Spi_GetStatus: service-id=6, is-reentrant=true, is-synchronous=true, call-type=REGULAR, execution-context=UNSPECIFIED
    Spi_GetVersionInfo: service-id=9, is-reentrant=true, is-synchronous=true, call-type=REGULAR, execution-context=UNSPECIFIED
    Spi_Init: service-id=0, is-reentrant=false, is-synchronous=true, call-type=REGULAR, execution-context=UNSPECIFIED
    Spi_IrqUnitMcspi{0..7}TxRx: is-reentrant=false, is-synchronous=true, call-type=INTERRUPT, execution-context=INTERRUPT-CAT-1
    Spi_MainFunction_Handling: service-id=16, is-reentrant=false, is-synchronous=true, call-type=SCHEDULED, execution-context=UNSPECIFIED
    Spi_ReadIB: service-id=4, is-reentrant=true, is-synchronous=true, call-type=REGULAR, execution-context=UNSPECIFIED
    Spi_SetAsyncMode: service-id=13, is-reentrant=false, is-synchronous=true, call-type=REGULAR, execution-context=UNSPECIFIED
    Spi_SetupEB: service-id=5, is-reentrant=true, is-synchronous=true, call-type=REGULAR, execution-context=UNSPECIFIED
    Spi_SyncTransmit: service-id=10, is-reentrant=true, is-synchronous=false, call-type=REGULAR, execution-context=UNSPECIFIED
    Spi_WriteIB: service-id=2, is-reentrant=true, is-synchronous=true, call-type=REGULAR, execution-context=UNSPECIFIED
