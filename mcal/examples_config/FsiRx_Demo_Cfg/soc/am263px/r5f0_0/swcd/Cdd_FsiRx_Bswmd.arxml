AUTOSAR XML (schema 00044)
package /Cdd_FsiRx_TI_AM263Px
  bsw module description Cdd_FsiRx: category=BSW_MODULE, module-id=255
    implemented-entrys:
      CddFsiRx_FSIINT1_IrqUnit1
      CddFsiRx_FSIINT2_IrqUnit1
      CddFsiRx_GetStatus
      Cdd_FsiRx_DeInit
      Cdd_FsiRx_GetVersionInfo
      Cdd_FsiRx_Init
      Cdd_FsiRx_Reset
      Cdd_FsiRx_RegisterReadback
      Cdd_FsiRx_setUpBuffer
    bsw module dependency Dem: target-module-id=54, target-module=Dem
    bsw module dependency Det: target-module-id=15, target-module=Det
    bsw internal behavior Cdd_Fsi_Rx_Behavior
      exclusive area FSI_RX_EXCLUSIVE_AREA_0
      bsw interrupt entity CddFsiRx_FSIINT1_IrqUnit1: reentrancy-level=NON-REENTRANT, implemented-entry=CddFsiRx_FSIINT1_IrqUnit1, interrupt-category=CAT-1, interrupt-source=Hardware
        bsw direct call point Dem: called-entry=Dem_SetEventStatus
        bsw direct call point Det_ReportRuntimeError: called-entry=Det_ReportRuntimeError
        bsw direct call point Det_ReportError: called-entry=Det_ReportError
      bsw interrupt entity CddFsiRx_FSIINT2_IrqUnit1: reentrancy-level=NON-REENTRANT, implemented-entry=CddFsiRx_FSIINT2_IrqUnit1, interrupt-category=CAT-1, interrupt-source=Hardware
        bsw direct call point Dem: called-entry=Dem_SetEventStatus
        bsw direct call point Det_ReportRuntimeError: called-entry=Det_ReportRuntimeError
        bsw direct call point Det_ReportError: called-entry=Det_ReportError
      7 x bsw called entity:
        CddFsiRx_GetStatus: reentrancy-level=NON-REENTRANT, implemented-entry=CddFsiRx_GetStatus
        Cdd_FsiRx_DeInit: reentrancy-level=NON-REENTRANT, implemented-entry=Cdd_FsiRx_DeInit
          bsw direct call point Det_ReportError: called-entry=Det_ReportError
        Cdd_FsiRx_GetVersionInfo: reentrancy-level=SINGLE-CORE-REENTRANT, implemented-entry=Cdd_FsiRx_GetVersionInfo
          bsw direct call point Det_ReportError: called-entry=Det_ReportError
        Cdd_FsiRx_Init: reentrancy-level=NON-REENTRANT, implemented-entry=Cdd_FsiRx_Init
          bsw direct call point Det_ReportError: called-entry=Det_ReportError
        Cdd_FsiRx_Reset: reentrancy-level=NON-REENTRANT, implemented-entry=Cdd_FsiRx_Reset
          bsw direct call point Det_ReportError: called-entry=Det_ReportError
        Cdd_FsiRx_setUpBuffer: can-enter-exclusive-area=FSI_RX_EXCLUSIVE_AREA_0, reentrancy-level=SINGLE-CORE-REENTRANT, implemented-entry=Cdd_FsiRx_setUpBuffer
          bsw direct call point Det_ReportError: called-entry=Det_ReportError
        Cdd_FsiRx_RegisterReadback: reentrancy-level=NON-REENTRANT, implemented-entry=Cdd_FsiRx_RegisterReadback
          bsw direct call point Det_ReportError: called-entry=Det_ReportError
  bsw implementation Cdd_FsiRx_Impl: programming-language=C, sw-version=10.01.00, vendor-id=44, ar-release-version=4.3.1, behavior=Cdd_Fsi_Rx_Behavior, vendor-specific-module-def=Cdd_FsiRx
    code-descriptors:
      code Files
        artifact-descriptors:
          short-label=V0::Cdd_FsiRx_Irq.c, category=SWSRC
          short-label=V0::Cdd_FsiRx_Irq.h, category=SWHDR
          short-label=V0::Cdd_FsiRx_Platform.c, category=SWSRC
          short-label=V0::Cdd_FsiRx_Platform.c, category=SWSRC
          short-label=V0::Cdd_FsiRx_Priv.c, category=SWSRC
          short-label=V0::Cdd_FsiRx_Priv.h, category=SWHDR
          short-label=V0::Cdd_FsiRx_Reg.h, category=SWHDR
          short-label=V0::Cdd_FsiRx_Types.h, category=SWHDR
          short-label=generate::include::Cdd_FsiRx_Cfg.h, category=SWHDR
          short-label=generate::src::Cdd_FsiRx_Cfg.c, category=SWSRC
          short-label=generate::src::Cdd_FsiRx_PBcfg.c, category=SWSRC
          short-label=include::Cdd_FsiRx.h, category=SWHDR
          short-label=src::Cdd_FsiRx.c, category=SWSRC
    compiler tiarmclang: name=TI ARM Clang, options=-mcpu=cortex-r5 -mfpu=vfpv3-d16 -mfloat-abi=hard -c -mlittle-endian -ffunction-sections -gdwarf-3 -Werror -Os -x -save-temps -mthumb -DAM263PX_SIP_PACKAGE -DAM263PX_PLATFORM -DAM263PX_R_PACKAGE -DAM263PX_C_PACKAGE, vendor=Texas Instruments, version=4.0.0
    linker tiarmlnk: name=TI ARM Clang Linker, options=-mcpu=cortex-r5 -Wl,--ram_model -Wl,--reread_libs -Wl,--warn_sections -qq -Wl,--emit_warnings_as_errors --diag_suppress=10068 --diag_suppress=10063, vendor=Texas Instruments, version=4.0.0
    resource consumption ResourceConsumption
      6 x memory section:
        CDD_FSI_RX_CODE: alignment=UNSPECIFIED, sw-addrmethod=CODE, symbol=CODE
        CDD_FSI_RX_CONFIG_DATA: alignment=UNSPECIFIED, sw-addrmethod=CONFIG_DATA, symbol=CONFIG_DATA
        CDD_FSI_RX_ISR_CODE: alignment=UNSPECIFIED, sw-addrmethod=CODE, symbol=ISR_CODE
        CDD_FSI_RX_VAR_INIT_16: alignment=16, sw-addrmethod=VAR_INIT, symbol=VAR_INIT_16
        CDD_FSI_RX_VAR_NO_INIT_16: alignment=16, sw-addrmethod=VAR_NO_INIT, symbol=VAR_NO_INIT_16
        CDD_FSI_RX_VAR_NO_INIT_UNSPECIFIED: alignment=UNSPECIFIED, sw-addrmethod=VAR_NO_INIT, symbol=VAR_NO_INIT_UNSPECIFIED
package /Cdd_FsiRx_TI_AM263Px/Cdd_FsiRx_ModuleEntry
  15 x bsw module entry, all with is-synchronous=true, sw-service-impl-policy=STANDARD, bsw-entry-kind=CONCRETE:
    CddFsiRx_FSIINT1_IrqUnit{0..3}: is-reentrant=false, call-type=INTERRUPT, execution-context=INTERRUPT-CAT-1
    CddFsiRx_FSIINT2_IrqUnit{0..3}: is-reentrant=false, call-type=INTERRUPT, execution-context=INTERRUPT-CAT-1
    CddFsiRx_GetStatus: service-id=5, is-reentrant=false, call-type=REGULAR, execution-context=UNSPECIFIED
    Cdd_FsiRx_DeInit: service-id=4, is-reentrant=false, call-type=REGULAR, execution-context=UNSPECIFIED
    Cdd_FsiRx_GetVersionInfo: service-id=2, is-reentrant=true, call-type=REGULAR, execution-context=UNSPECIFIED
    Cdd_FsiRx_Init: service-id=1, is-reentrant=false, call-type=REGULAR, execution-context=UNSPECIFIED
    Cdd_FsiRx_MainFunction: service-id=3, is-reentrant=true, call-type=REGULAR, execution-context=UNSPECIFIED
    Cdd_FsiRx_Reset: service-id=6, is-reentrant=false, call-type=REGULAR, execution-context=UNSPECIFIED
    Cdd_FsiRx_setUpBuffer: service-id=7, is-reentrant=true, call-type=REGULAR, execution-context=UNSPECIFIED
