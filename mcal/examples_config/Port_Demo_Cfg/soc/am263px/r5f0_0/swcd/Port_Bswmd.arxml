AUTOSAR XML (schema 00044)
package /Port_TI_AM263px
  bsw module description Port: category=BSW_MODULE, module-id=124
    implemented-entrys:
      Port_ClearInterruptStatus
      Port_GetInterruptStatus
      Port_GetVersionInfo
      Port_Init
      Port_RefreshPortDirection
      Port_SetPinDirection
      Port_SetPinMode
      Port_PinDisableIntrNotification
      Port_PinEnableIntrNotification
      Port_Bnk1Isr
    bsw module dependency Dem: target-module-id=54, target-module=Dem
    bsw module dependency Det: target-module-id=15, target-module=Det
    bsw internal behavior Port_Behavior
      exclusive area PORT_EXCLUSIVE_AREA_0
      bsw interrupt entity Port_Bnk1Isr: reentrancy-level=NON-REENTRANT, implemented-entry=Port_Bnk1Isr, interrupt-category=CAT-1, interrupt-source=Hardware
        bsw direct call point Det_ReportError: called-entry=Det_ReportError
      9 x bsw called entity:
        Port_ClearInterruptStatus: reentrancy-level=SINGLE-CORE-REENTRANT, implemented-entry=Port_ClearInterruptStatus
          bsw direct call point Det_ReportError: called-entry=Det_ReportError
        Port_GetInterruptStatus: reentrancy-level=SINGLE-CORE-REENTRANT, implemented-entry=Port_GetInterruptStatus
          bsw direct call point Det_ReportError: called-entry=Det_ReportError
        Port_GetVersionInfo: reentrancy-level=SINGLE-CORE-REENTRANT, implemented-entry=Port_GetVersionInfo
          bsw direct call point Det_ReportError: called-entry=Det_ReportError
        Port_Init: reentrancy-level=NON-REENTRANT, implemented-entry=Port_Init
          bsw direct call point Dem_SetEventStatus: called-entry=Dem_SetEventStatus
          bsw direct call point Det_ReportError: called-entry=Det_ReportError
        Port_PinDisableIntrNotification: reentrancy-level=SINGLE-CORE-REENTRANT, implemented-entry=Port_PinDisableIntrNotification
          bsw direct call point Det_ReportError: called-entry=Det_ReportError
        Port_PinEnableIntrNotification: reentrancy-level=SINGLE-CORE-REENTRANT, implemented-entry=Port_PinEnableIntrNotification
          bsw direct call point Det_ReportError: called-entry=Det_ReportError
        Port_RefreshPortDirection: reentrancy-level=NON-REENTRANT, implemented-entry=Port_RefreshPortDirection
          bsw direct call point Dem_SetEventStatus: called-entry=Dem_SetEventStatus
          bsw direct call point Det_ReportError: called-entry=Det_ReportError
        Port_SetPinDirection: can-enter-exclusive-area=PORT_EXCLUSIVE_AREA_0, reentrancy-level=SINGLE-CORE-REENTRANT, implemented-entry=Port_SetPinDirection
          bsw direct call point Dem_SetEventStatus: called-entry=Dem_SetEventStatus
          bsw direct call point Det_ReportError: called-entry=Det_ReportError
        Port_SetPinMode: can-enter-exclusive-area=PORT_EXCLUSIVE_AREA_0, reentrancy-level=SINGLE-CORE-REENTRANT, implemented-entry=Port_SetPinMode
          bsw direct call point Dem_SetEventStatus: called-entry=Dem_SetEventStatus
          bsw direct call point Det_ReportError: called-entry=Det_ReportError
  bsw implementation Port_Impl: programming-language=C, sw-version=10.01.00, vendor-id=44, ar-release-version=4.3.1, behavior=Port_Behavior, vendor-specific-module-def=Port
    code-descriptors:
      code Files
        artifact-descriptors:
          short-label=V0::Port_Irq.h, category=SWHDR
          short-label=V0::Port_Irq.c, category=SWSRC
          short-label=V0::Port_Priv.c, category=SWSRC
          short-label=V0::Port_Priv.h, category=SWHDR
          short-label=generate::include::Port_Cfg.h, category=SWHDR
          short-label=generate::src::Port_Cfg.c, category=SWSRC
          short-label=generate::src::Port_PBcfg.c, category=SWSRC
          short-label=include::Port.h, category=SWHDR
          short-label=src::Port.c, category=SWSRC
    compiler tiarmclang: name=TI ARM Clang, options=-mcpu=cortex-r5 -mfpu=vfpv3-d16 -mfloat-abi=hard -c -mlittle-endian -ffunction-sections -gdwarf-3 -Werror -Os -x -save-temps -mthumb -DAM263PX_SIP_PACKAGE -DAM263PX_PLATFORM -DAM263PX_R_PACKAGE -DAM263PX_C_PACKAGE, vendor=Texas Instruments, version=4.0.0
    linker tiarmlnk: name=TI ARM Clang Linker, options=-mcpu=cortex-r5 -Wl,--ram_model -Wl,--reread_libs -Wl,--warn_sections -qq -Wl,--emit_warnings_as_errors --diag_suppress=10068 --diag_suppress=10063, vendor=Texas Instruments, version=4.0.0
    resource consumption ResourceConsumption
      6 x memory section:
        PORT_CODE: sw-addrmethod=CODE, symbol=CODE
        PORT_CONFIG_DATA: alignment=UNSPECIFIED, sw-addrmethod=CONFIG_DATA, symbol=CONFIG_DATA
        PORT_CONST_UNSPECIFIED: alignment=UNSPECIFIED, sw-addrmethod=CONST, symbol=CONST_UNSPECIFIED
        PORT_ISR_CODE: sw-addrmethod=CODE, symbol=ISR_CODE
        PORT_VAR_INIT_UNSPECIFIED: alignment=UNSPECIFIED, sw-addrmethod=VAR_INIT, symbol=VAR_INIT_UNSPECIFIED
        PORT_VAR_NO_INIT_UNSPECIFIED: alignment=UNSPECIFIED, sw-addrmethod=VAR_NO_INIT, symbol=VAR_NO_INIT_UNSPECIFIED
package /Port_TI_AM263px/Port_ModuleEntry
  157 x bsw module entry, all with is-synchronous=true, sw-service-impl-policy=STANDARD, bsw-entry-kind=CONCRETE:
    Port_ClearInterruptStatus: service-id=8, is-reentrant=true, call-type=REGULAR, execution-context=UNSPECIFIED
    Port_GetInterruptStatus: service-id=7, is-reentrant=true, call-type=REGULAR, execution-context=UNSPECIFIED
    Port_GetVersionInfo: service-id=3, is-reentrant=true, call-type=REGULAR, execution-context=UNSPECIFIED
    Port_Init: service-id=0, is-reentrant=false, call-type=REGULAR, execution-context=UNSPECIFIED
    Port_PinDisableIntrNotification: service-id=6, is-reentrant=true, call-type=REGULAR, execution-context=UNSPECIFIED
    Port_PinEnableIntrNotification: service-id=5, is-reentrant=true, call-type=REGULAR, execution-context=UNSPECIFIED
    Port_RefreshPortDirection: service-id=2, is-reentrant=false, call-type=REGULAR, execution-context=UNSPECIFIED
    Port_SetPinDirection: service-id=1, is-reentrant=true, call-type=REGULAR, execution-context=UNSPECIFIED
    Port_SetPinMode: service-id=4, is-reentrant=true, call-type=REGULAR, execution-context=UNSPECIFIED
    Port_Bnk{0..8}Isr: is-reentrant=false, call-type=INTERRUPT, execution-context=INTERRUPT-CAT-1
    Port_Ch{0..138}Isr: is-reentrant=false, call-type=INTERRUPT, execution-context=INTERRUPT-CAT-1
