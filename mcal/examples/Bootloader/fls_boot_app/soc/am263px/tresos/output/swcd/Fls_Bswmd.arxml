AUTOSAR XML (schema 00044)
package /Fls_TI_AM263Px
  bsw module description Fls: module-id=92
    implemented-entrys:
      Fls_BlankCheck
      Fls_Cancel
      Fls_Compare
      Fls_Erase
      Fls_GetJobResult
      Fls_GetStatus
      Fls_GetVersionInfo
      Fls_Hdlr
      Fls_Init
      Fls_MainFunction
      Fls_Read
      Fls_RegisterReadback
      Fls_SetEraseType
      Fls_SetMode
      Fls_Write
    bsw module dependency Det: target-module-id=15, target-module=Det
    bsw module dependency Cdd_Dma: target-module-id=255, target-module=Cdd_Dma_ModuleEntry
    bsw internal behavior Fls_Behavior
      exclusive area FLS_EXCLUSIVE_AREA_0
      7 x bsw called entity:
        Fls_BlankCheck: can-enter-exclusive-area=FLS_EXCLUSIVE_AREA_0, reentrancy-level=NON-REENTRANT, implemented-entry=Fls_BlankCheck
          bsw direct call point Det_ReportError: called-entry=Det_ReportError
          bsw direct call point Det_ReportRuntimeError: called-entry=Det_ReportRuntimeError
          bsw direct call point Det_ReportTransientFault: called-entry=Det_ReportTransientFault
        Fls_Cancel: reentrancy-level=NON-REENTRANT, implemented-entry=Fls_Cancel
          bsw direct call point Det_ReportError: called-entry=Det_ReportError
        Fls_Compare: can-enter-exclusive-area=FLS_EXCLUSIVE_AREA_0, reentrancy-level=NON-REENTRANT, implemented-entry=Fls_Compare
          bsw direct call point Det_ReportError: called-entry=Det_ReportError
          bsw direct call point Det_ReportRuntimeError: called-entry=Det_ReportRuntimeError
          bsw direct call point Det_ReportTransientFault: called-entry=Det_ReportTransientFault
        Fls_Erase: can-enter-exclusive-area=FLS_EXCLUSIVE_AREA_0, reentrancy-level=NON-REENTRANT, implemented-entry=Fls_Erase
          bsw direct call point Det_ReportError: called-entry=Det_ReportError
          bsw direct call point Det_ReportRuntimeError: called-entry=Det_ReportRuntimeError
          bsw direct call point Det_ReportTransientFault: called-entry=Det_ReportTransientFault
        Fls_GetJobResult: reentrancy-level=SINGLE-CORE-REENTRANT, implemented-entry=Fls_GetJobResult
          bsw direct call point Det_ReportError: called-entry=Det_ReportError
        Fls_GetStatus: reentrancy-level=SINGLE-CORE-REENTRANT, implemented-entry=Fls_GetStatus
        Fls_GetVersionInfo: reentrancy-level=SINGLE-CORE-REENTRANT, implemented-entry=Fls_GetVersionInfo
          bsw direct call point Det_ReportError: called-entry=Det_ReportError
      bsw interrupt entity Fls_Hdlr: reentrancy-level=NON-REENTRANT, implemented-entry=Fls_Hdlr, interrupt-category=CAT-1, interrupt-source=Hardware
        bsw direct call point Cdd_Dma_ParamSet: called-entry=Cdd_Dma_ParamSet
        bsw direct call point Cdd_Dma_ChainChannel: called-entry=Cdd_Dma_ChainChannel
        bsw direct call point Cdd_Dma_EnableTransferRegion: called-entry=Cdd_Dma_EnableTransferRegion
      bsw called entity Fls_Init: reentrancy-level=NON-REENTRANT, implemented-entry=Fls_Init
        bsw direct call point Det_ReportError: called-entry=Det_ReportError
        bsw direct call point Det_ReportRuntimeError: called-entry=Det_ReportRuntimeError
        bsw direct call point Cdd_Dma_CbkRegister: called-entry=Cdd_Dma_CbkRegister
      bsw schedulable entity Fls_MainFunction: can-enter-exclusive-area=FLS_EXCLUSIVE_AREA_0, reentrancy-level=NON-REENTRANT, implemented-entry=Fls_MainFunction
        6 x bsw direct call point:
          Det_ReportError: called-entry=Det_ReportError
          Det_ReportRuntimeError: called-entry=Det_ReportRuntimeError
          Cdd_Dma_ParamSet: called-entry=Cdd_Dma_ParamSet
          Cdd_Dma_ChainChannel: called-entry=Cdd_Dma_ChainChannel
          Cdd_Dma_EnableTransferRegion: called-entry=Cdd_Dma_EnableTransferRegion
          Det_ReportTransientFault: called-entry=Det_ReportTransientFault
      5 x bsw called entity:
        Fls_Read: can-enter-exclusive-area=FLS_EXCLUSIVE_AREA_0, reentrancy-level=NON-REENTRANT, implemented-entry=Fls_Read
          bsw direct call point Det_ReportError: called-entry=Det_ReportError
          bsw direct call point Det_ReportRuntimeError: called-entry=Det_ReportRuntimeError
          bsw direct call point Det_ReportTransientFault: called-entry=Det_ReportTransientFault
        Fls_RegisterReadback: can-enter-exclusive-area=FLS_EXCLUSIVE_AREA_0, reentrancy-level=SINGLE-CORE-REENTRANT, implemented-entry=Fls_RegisterReadback
          bsw direct call point Det_ReportError: called-entry=Det_ReportError
        Fls_SetEraseType: reentrancy-level=NON-REENTRANT, implemented-entry=Fls_SetEraseType
        Fls_SetMode: reentrancy-level=NON-REENTRANT, implemented-entry=Fls_SetMode
        Fls_Write: can-enter-exclusive-area=FLS_EXCLUSIVE_AREA_0, reentrancy-level=NON-REENTRANT, implemented-entry=Fls_Write
          bsw direct call point Det_ReportError: called-entry=Det_ReportError
          bsw direct call point Det_ReportRuntimeError: called-entry=Det_ReportRuntimeError
          bsw direct call point Det_ReportTransientFault: called-entry=Det_ReportTransientFault
      bsw timing event Fls_MainFunctionTimingEvent: starts-on-event=Fls_MainFunction, period=1.0
  bsw implementation Fls_Impl: programming-language=C, sw-version=10.01.00, vendor-id=44, ar-release-version=4.3.1, behavior=Fls_Behavior, vendor-specific-module-def=Fls
    code-descriptors:
      code Files
        artifact-descriptors:
          short-label=V2::Fls_Brd_Nor.h, category=SWHDR
          short-label=V2::Fls_Brd_Nor_Ospi.c, category=SWSRC
          short-label=V2::Fls_Ospi.c, category=SWSRC
          short-label=V2::Fls_Ospi.h, category=SWHDR
          short-label=V2::Fls_Ospi_Edma.c, category=SWSRC
          short-label=V2::Fls_Ospi_Edma.h, category=SWHDR
          short-label=V2::Fls_Ospi_Phy.c, category=SWSRC
          short-label=V2::Fls_Ospi_Phy.h, category=SWHDR
          short-label=generate::include::Fls_Cfg.h, category=SWHDR
          short-label=generate::src::Fls_Cfg.c, category=SWSRC
          short-label=generate::src::Fls_PBcfg.c, category=SWSRC
          short-label=include::Fls.h, category=SWHDR
          short-label=include::Fls_Cbk.h, category=SWHDR
          short-label=include::Fls_Irq.h, category=SWHDR
          short-label=src::Fls.c, category=SWSRC
          short-label=src::Fls_Irq.c, category=SWSRC
    compiler tiarmclang: name=TI ARM Clang, options=-mcpu=cortex-r5 -mfpu=vfpv3-d16 -mfloat-abi=hard -c -mlittle-endian -ffunction-sections -gdwarf-3 -Werror -Os -x -save-temps -mthumb -DAM263PX_SIP_PACKAGE -DAM263PX_PLATFORM -DAM263PX_R_PACKAGE -DAM263PX_C_PACKAGE, vendor=Texas Instruments, version=4.0.0
    linker tiarmlnk: name=TI ARM Clang Linker, options=-mcpu=cortex-r5 -Wl,--ram_model -Wl,--reread_libs -Wl,--warn_sections -qq -Wl,--emit_warnings_as_errors --diag_suppress=10068 --diag_suppress=10063, vendor=Texas Instruments, version=4.0.0
    resource consumption ResourceConsumption
      9 x memory section:
        FLS_CODE: sw-addrmethod=CODE, symbol=CODE
        FLS_CONFIG_DATA: alignment=UNSPECIFIED, sw-addrmethod=CONFIG_DATA, symbol=CONFIG_DATA
        FLS_ISR_CODE: sw-addrmethod=CODE, symbol=ISR_CODE
        FLS_VAR_INIT_32: alignment=32, sw-addrmethod=VAR_INIT, symbol=VAR_INIT_32
        FLS_VAR_INIT_8: alignment=8, sw-addrmethod=VAR_INIT, symbol=VAR_INIT_8
        FLS_VAR_INIT_UNSPECIFIED: alignment=UNSPECIFIED, sw-addrmethod=VAR_INIT, symbol=VAR_INIT_UNSPECIFIED
        FLS_VAR_NO_INIT_32: alignment=32, sw-addrmethod=VAR_NO_INIT, symbol=VAR_NO_INIT_32
        FLS_VAR_NO_INIT_8: alignment=8, sw-addrmethod=VAR_NO_INIT, symbol=VAR_NO_INIT_8
        FLS_VAR_NO_INIT_UNSPECIFIED: alignment=UNSPECIFIED, sw-addrmethod=VAR_NO_INIT, symbol=VAR_NO_INIT_UNSPECIFIED
package /Fls_TI_AM263Px/Fls_ModuleEntry
  15 x bsw module entry, all with sw-service-impl-policy=STANDARD, bsw-entry-kind=CONCRETE:
    Fls_BlankCheck: service-id=10, is-reentrant=false, is-synchronous=false, call-type=REGULAR, execution-context=UNSPECIFIED
    Fls_Cancel: service-id=3, is-reentrant=false, is-synchronous=true, call-type=REGULAR, execution-context=UNSPECIFIED
    Fls_Compare: service-id=8, is-reentrant=false, is-synchronous=false, call-type=REGULAR, execution-context=UNSPECIFIED
    Fls_Erase: service-id=1, is-reentrant=false, is-synchronous=false, call-type=REGULAR, execution-context=UNSPECIFIED
    Fls_GetJobResult: service-id=5, is-reentrant=true, is-synchronous=true, call-type=REGULAR, execution-context=UNSPECIFIED
    Fls_GetStatus: service-id=4, is-reentrant=true, is-synchronous=true, call-type=REGULAR, execution-context=UNSPECIFIED
    Fls_GetVersionInfo: service-id=16, is-reentrant=true, is-synchronous=true, call-type=REGULAR, execution-context=UNSPECIFIED
    Fls_Hdlr: is-reentrant=false, is-synchronous=true, call-type=INTERRUPT, execution-context=INTERRUPT-CAT-1
    Fls_Init: service-id=0, is-reentrant=false, is-synchronous=true, call-type=REGULAR, execution-context=UNSPECIFIED
    Fls_MainFunction: service-id=6, is-reentrant=false, is-synchronous=true, call-type=SCHEDULED, execution-context=TASK
    Fls_Read: service-id=7, is-reentrant=false, is-synchronous=false, call-type=REGULAR, execution-context=UNSPECIFIED
    Fls_RegisterReadback: service-id=11, is-reentrant=true, is-synchronous=true, call-type=REGULAR, execution-context=UNSPECIFIED
    Fls_SetEraseType: service-id=12, is-reentrant=false, is-synchronous=true, call-type=REGULAR, execution-context=UNSPECIFIED
    Fls_SetMode: service-id=9, is-reentrant=false, is-synchronous=true, call-type=REGULAR, execution-context=UNSPECIFIED
    Fls_Write: service-id=2, is-reentrant=false, is-synchronous=false, call-type=REGULAR, execution-context=UNSPECIFIED
