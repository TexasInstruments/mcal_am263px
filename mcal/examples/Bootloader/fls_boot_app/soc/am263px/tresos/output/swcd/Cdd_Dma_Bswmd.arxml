AUTOSAR XML (schema 00044)
package /Cdd_Dma_TI_AM263px
  bsw module description Cdd_Dma: category=BSW_MODULE, module-id=255
    implemented-entrys:
      CDD_EDMA_lld_transferCompletionMasterIsrFxn
      Cdd_Dma_ChainChannel
      Cdd_Dma_CbkRegister
      Cdd_Dma_DeInit
      Cdd_Dma_DisableTransferRegion
      Cdd_Dma_EnableTransferRegion
      Cdd_Dma_GetInitStatus
      Cdd_Dma_GetParam
      Cdd_Dma_GetStatus
      Cdd_Dma_GetVersionInfo
      Cdd_Dma_Init
      Cdd_Dma_LinkChannel
      Cdd_Dma_ParamSet
      Cdd_Dma_RegisterReadback
    bsw module dependency Det: target-module-id=15, target-module=Det
    bsw internal behavior Cdd_Dma_Behavior
      exclusive area DMA_EXCLUSIVE_AREA_0
      bsw interrupt entity CDD_EDMA_lld_transferCompletionMasterIsrFxn: reentrancy-level=NON-REENTRANT, implemented-entry=CDD_EDMA_lld_transferCompletionMasterIsrFxn, interrupt-category=CAT-1, interrupt-source=Hardware
      13 x bsw called entity:
        Cdd_Dma_CbkRegister: can-enter-exclusive-area=DMA_EXCLUSIVE_AREA_0, reentrancy-level=NON-REENTRANT, implemented-entry=Cdd_Dma_CbkRegister
          bsw direct call point Det_ReportError: called-entry=Det_ReportError
        Cdd_Dma_ChainChannel: reentrancy-level=SINGLE-CORE-REENTRANT, implemented-entry=Cdd_Dma_ChainChannel
          bsw direct call point Det_ReportError: called-entry=Det_ReportError
        Cdd_Dma_DeInit: reentrancy-level=NON-REENTRANT, implemented-entry=Cdd_Dma_DeInit
          bsw direct call point Det_ReportError: called-entry=Det_ReportError
        Cdd_Dma_DisableTransferRegion: reentrancy-level=SINGLE-CORE-REENTRANT, implemented-entry=Cdd_Dma_DisableTransferRegion
          bsw direct call point Det_ReportError: called-entry=Det_ReportError
        Cdd_Dma_EnableTransferRegion: reentrancy-level=SINGLE-CORE-REENTRANT, implemented-entry=Cdd_Dma_EnableTransferRegion
          bsw direct call point Det_ReportError: called-entry=Det_ReportError
          bsw direct call point Det_ReportRuntimeError: called-entry=Det_ReportRuntimeError
        Cdd_Dma_GetInitStatus: reentrancy-level=SINGLE-CORE-REENTRANT, implemented-entry=Cdd_Dma_GetInitStatus
        Cdd_Dma_GetParam: reentrancy-level=SINGLE-CORE-REENTRANT, implemented-entry=Cdd_Dma_GetParam
          bsw direct call point Det_ReportError: called-entry=Det_ReportError
        Cdd_Dma_GetStatus: reentrancy-level=SINGLE-CORE-REENTRANT, implemented-entry=Cdd_Dma_GetStatus
          bsw direct call point Det_ReportError: called-entry=Det_ReportError
        Cdd_Dma_GetVersionInfo: reentrancy-level=SINGLE-CORE-REENTRANT, implemented-entry=Cdd_Dma_GetVersionInfo
          bsw direct call point Det_ReportError: called-entry=Det_ReportError
        Cdd_Dma_Init: reentrancy-level=NON-REENTRANT, implemented-entry=Cdd_Dma_Init
          bsw direct call point Det_ReportError: called-entry=Det_ReportError
        Cdd_Dma_LinkChannel: reentrancy-level=SINGLE-CORE-REENTRANT, implemented-entry=Cdd_Dma_LinkChannel
          bsw direct call point Det_ReportError: called-entry=Det_ReportError
        Cdd_Dma_ParamSet: reentrancy-level=SINGLE-CORE-REENTRANT, implemented-entry=Cdd_Dma_ParamSet
          bsw direct call point Det_ReportError: called-entry=Det_ReportError
          bsw direct call point Det_ReportRuntimeError: called-entry=Det_ReportRuntimeError
        Cdd_Dma_RegisterReadback: reentrancy-level=NON-REENTRANT, implemented-entry=Cdd_Dma_RegisterReadback
          bsw direct call point Det_ReportError: called-entry=Det_ReportError
  bsw implementation Cdd_Dma_Impl: programming-language=C, sw-version=10.01.00, vendor-id=44, ar-release-version=4.3.1, behavior=Cdd_Dma_Behavior, vendor-specific-module-def=Cdd_Dma
    code-descriptors:
      code Files
        artifact-descriptors:
          short-label=V0::Cdd_Dma_dmaxbar.h, category=SWHDR
          short-label=V0::Cdd_Dma_soc.c, category=SWSRC
          short-label=V0::Cdd_Dma_trig_xbar.h, category=SWHDR
          short-label=V0::Cdd_Dma_xbar.h, category=SWHDR
          short-label=generate::include::Cdd_Dma_Cfg.h, category=SWHDR
          short-label=generate::src::Cdd_Dma_Cfg.c, category=SWSRC
          short-label=include::Cdd_Dma.h, category=SWHDR
          short-label=include::Cdd_Dma_Priv.h, category=SWHDR
          short-label=include::Cdd_Dma_cslr_tpcc.h, category=SWHDR
          short-label=include::Cdd_Dma_cslr_tptc.h, category=SWHDR
          short-label=include::Cdd_Dma_edma.h, category=SWHDR
          short-label=include::Cdd_Dma_Irq.h, category=SWHDR
          short-label=src::Cdd_Dma.c, category=SWSRC
          short-label=src::Cdd_Dma_Irq.c, category=SWSRC
          short-label=src::Cdd_Dma_Priv.c, category=SWSRC
    compiler tiarmclang: name=TI ARM Clang, options=-mcpu=cortex-r5 -mfpu=vfpv3-d16 -mfloat-abi=hard -c -mlittle-endian -ffunction-sections -gdwarf-3 -Werror -Os -x -save-temps -mthumb -DAM263PX_SIP_PACKAGE -DAM263PX_PLATFORM -DAM263PX_R_PACKAGE -DAM263PX_C_PACKAGE, vendor=Texas Instruments, version=4.0.0
    linker tiarmlnk: name=TI ARM Clang Linker, options=-mcpu=cortex-r5 -Wl,--ram_model -Wl,--reread_libs -Wl,--warn_sections -qq -Wl,--emit_warnings_as_errors --diag_suppress=10068 --diag_suppress=10063, vendor=Texas Instruments, version=4.0.0
    resource consumption ResourceConsumption
      7 x memory section:
        CDD_DMA_CODE: sw-addrmethod=CODE, symbol=CODE
        CDD_DMA_CONFIG_DATA: alignment=UNSPECIFIED, sw-addrmethod=CONFIG_DATA, symbol=CONFIG_DATA
        CDD_DMA_ISR_CODE: sw-addrmethod=CODE, symbol=ISR_CODE
        CDD_DMA_VAR_INIT_32: alignment=32, sw-addrmethod=VAR_INIT, symbol=VAR_INIT_32
        CDD_DMA_VAR_INIT_8: alignment=8, sw-addrmethod=VAR_INIT, symbol=VAR_INIT_8
        CDD_DMA_VAR_INIT_UNSPECIFIED: alignment=UNSPECIFIED, sw-addrmethod=VAR_INIT, symbol=VAR_INIT_UNSPECIFIED
        CDD_DMA_VAR_NO_INIT_UNSPECIFIED: alignment=UNSPECIFIED, sw-addrmethod=VAR_NO_INIT, symbol=VAR_NO_INIT_UNSPECIFIED
package /Cdd_Dma_TI_AM263px/Cdd_Dma_ModuleEntry
  14 x bsw module entry, all with is-synchronous=true, sw-service-impl-policy=STANDARD, bsw-entry-kind=CONCRETE:
    CDD_EDMA_lld_transferCompletionMasterIsrFxn: is-reentrant=false, call-type=INTERRUPT, execution-context=INTERRUPT-CAT-1
    Cdd_Dma_CbkRegister: service-id=3, is-reentrant=false, call-type=REGULAR, execution-context=UNSPECIFIED
    Cdd_Dma_ChainChannel: service-id=6, is-reentrant=true, call-type=REGULAR, execution-context=UNSPECIFIED
    Cdd_Dma_DeInit: service-id=2, is-reentrant=false, call-type=REGULAR, execution-context=UNSPECIFIED
    Cdd_Dma_DisableTransferRegion: service-id=12, is-reentrant=true, call-type=REGULAR, execution-context=UNSPECIFIED
    Cdd_Dma_EnableTransferRegion: service-id=7, is-reentrant=true, call-type=REGULAR, execution-context=UNSPECIFIED
    Cdd_Dma_GetInitStatus: service-id=10, is-reentrant=true, call-type=REGULAR, execution-context=UNSPECIFIED
    Cdd_Dma_GetParam: service-id=11, is-reentrant=true, call-type=REGULAR, execution-context=UNSPECIFIED
    Cdd_Dma_GetStatus: service-id=8, is-reentrant=true, call-type=REGULAR, execution-context=UNSPECIFIED
    Cdd_Dma_GetVersionInfo: service-id=9, is-reentrant=true, call-type=REGULAR, execution-context=UNSPECIFIED
    Cdd_Dma_Init: service-id=1, is-reentrant=false, call-type=REGULAR, execution-context=UNSPECIFIED
    Cdd_Dma_LinkChannel: service-id=5, is-reentrant=true, call-type=REGULAR, execution-context=UNSPECIFIED
    Cdd_Dma_ParamSet: service-id=4, is-reentrant=true, call-type=REGULAR, execution-context=UNSPECIFIED
    Cdd_Dma_RegisterReadback: service-id=13, is-reentrant=false, call-type=REGULAR, execution-context=UNSPECIFIED
