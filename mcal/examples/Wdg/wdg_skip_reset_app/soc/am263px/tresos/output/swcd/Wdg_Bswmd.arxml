AUTOSAR XML (schema 00044)
package /Wdg_TI_AM263Px
  bsw module description Wdg: category=BSW_MODULE, implemented-entrys=[Wdg_GetVersionInfo, Wdg_Init, Wdg_RegisterReadback, Wdg_SetMode, Wdg_SetTriggerCondition, Wdg_Trigger], module-id=102
    bsw module dependency Dem: target-module-id=54, target-module=Dem
    bsw module dependency Det: target-module-id=15, target-module=Det
    bsw internal behavior Wdg_Behavior
      exclusive area WDG_EXCLUSIVE_AREA_0
      6 x bsw called entity:
        Wdg_GetVersionInfo: reentrancy-level=SINGLE-CORE-REENTRANT, implemented-entry=Wdg_GetVersionInfo
          bsw direct call point Det_ReportError: called-entry=Det_ReportError
        Wdg_Init: reentrancy-level=NON-REENTRANT, implemented-entry=Wdg_Init
          bsw direct call point Dem_SetEventStatus: called-entry=Dem_SetEventStatus
          bsw direct call point Det_ReportError: called-entry=Det_ReportError
        Wdg_RegisterReadback: reentrancy-level=SINGLE-CORE-REENTRANT, implemented-entry=Wdg_RegisterReadback
        Wdg_SetMode: can-enter-exclusive-area=WDG_EXCLUSIVE_AREA_0, reentrancy-level=NON-REENTRANT, implemented-entry=Wdg_SetMode
          bsw direct call point Dem_SetEventStatus: called-entry=Dem_SetEventStatus
          bsw direct call point Det_ReportError: called-entry=Det_ReportError
          bsw direct call point Det_ReportRuntimeError: called-entry=Det_ReportRuntimeError
        Wdg_SetTriggerCondition: can-enter-exclusive-area=WDG_EXCLUSIVE_AREA_0, reentrancy-level=NON-REENTRANT, implemented-entry=Wdg_SetTriggerCondition
          bsw direct call point Det_ReportError: called-entry=Det_ReportError
        Wdg_Trigger: reentrancy-level=NON-REENTRANT, implemented-entry=Wdg_Trigger
          bsw direct call point Det_ReportError: called-entry=Det_ReportError
  bsw implementation Wdg_Impl: programming-language=C, sw-version=10.01.00, vendor-id=44, ar-release-version=4.3.1, behavior=Wdg_Behavior, vendor-specific-module-def=Wdg
    code-descriptors:
      code Files
        artifact-descriptors:
          short-label=generate::include::Wdg_Cfg.h, category=SWHDR
          short-label=generate::src::Wdg_Cfg.c, category=SWSRC
          short-label=generate::src::Wdg_Lcfg.c, category=SWSRC
          short-label=generate::src::Wdg_PBcfg.c, category=SWSRC
          short-label=include::Wdg.h, category=SWHDR
          short-label=src::Wdg.c, category=SWSRC
          short-label=V0::Wdg_Priv.c, category=SWSRC
          short-label=V0::Wdg_Priv.h, category=SWHDR
    compiler tiarmclang: name=TI ARM Clang, options=-mcpu=cortex-r5 -mfpu=vfpv3-d16 -mfloat-abi=hard -c -mlittle-endian -ffunction-sections -gdwarf-3 -Werror -Os -x -save-temps -mthumb -DAM263PX_SIP_PACKAGE -DAM263PX_PLATFORM -DAM263PX_R_PACKAGE -DAM263PX_C_PACKAGE, vendor=Texas Instruments, version=4.0.0
    linker tiarmlnk: name=TI ARM Clang Linker, options=-mcpu=cortex-r5 -Wl,--ram_model -Wl,--reread_libs -Wl,--warn_sections -qq -Wl,--emit_warnings_as_errors --diag_suppress=10068 --diag_suppress=10063, vendor=Texas Instruments, version=4.0.0
    resource consumption ResourceConsumption
      5 x memory section:
        WDG_CODE: sw-addrmethod=CODE, symbol=CODE
        WDG_CONFIG_DATA: alignment=UNSPECIFIED, sw-addrmethod=CONFIG_DATA, symbol=CONFIG_DATA
        WDG_CONST_UNSPECIFIED: alignment=UNSPECIFIED, sw-addrmethod=CONST, symbol=CONST_UNSPECIFIED
        WDG_VAR_INIT_UNSPECIFIED: alignment=UNSPECIFIED, sw-addrmethod=VAR_INIT, symbol=VAR_INIT_UNSPECIFIED
        WDG_VAR_NO_INIT_UNSPECIFIED: alignment=UNSPECIFIED, sw-addrmethod=VAR_NO_INIT, symbol=VAR_NO_INIT_UNSPECIFIED
package /Wdg_TI_AM263Px/Wdg_ModuleEntry
  6 x bsw module entry, all with is-synchronous=true, call-type=REGULAR, execution-context=UNSPECIFIED, sw-service-impl-policy=STANDARD, bsw-entry-kind=CONCRETE:
    Wdg_GetVersionInfo: service-id=4, is-reentrant=true
    Wdg_Init: service-id=0, is-reentrant=false
    Wdg_RegisterReadback: service-id=6, is-reentrant=true
    Wdg_SetMode: service-id=1, is-reentrant=false
    Wdg_SetTriggerCondition: service-id=3, is-reentrant=false
    Wdg_Trigger: service-id=5, is-reentrant=false
