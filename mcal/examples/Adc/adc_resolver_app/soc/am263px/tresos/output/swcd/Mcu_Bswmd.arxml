AUTOSAR XML (schema 00044)
package /Mcu_TI_AM263Px
  bsw module description Mcu: category=BSW_MODULE, module-id=101
    implemented-entrys:
      Mcu_DeInit
      Mcu_GetPllStatus
      Mcu_GetRamState
      Mcu_GetResetRawValue
      Mcu_GetResetReason
      Mcu_GetVersionInfo
      Mcu_Init
      Mcu_InitClock
      Mcu_InitRamSection
      Mcu_PerformReset
      Mcu_RegisterReadback
      Mcu_SetMode
    bsw module dependency Dem: target-module-id=54, target-module=Dem
    bsw module dependency Det: target-module-id=15, target-module=Det
    bsw internal behavior Mcu_Behavior
      exclusive area MCU_EXCLUSIVE_AREA_0
      12 x bsw called entity:
        Mcu_DeInit: reentrancy-level=NON-REENTRANT, implemented-entry=Mcu_DeInit
        Mcu_GetPllStatus: reentrancy-level=SINGLE-CORE-REENTRANT, implemented-entry=Mcu_GetPllStatus
          bsw direct call point Det_ReportError: called-entry=Det_ReportError
        Mcu_GetRamState: reentrancy-level=SINGLE-CORE-REENTRANT, implemented-entry=Mcu_GetRamState
          bsw direct call point Det_ReportError: called-entry=Det_ReportError
        Mcu_GetResetRawValue: reentrancy-level=SINGLE-CORE-REENTRANT, implemented-entry=Mcu_GetResetRawValue
          bsw direct call point Det_ReportError: called-entry=Det_ReportError
        Mcu_GetResetReason: reentrancy-level=SINGLE-CORE-REENTRANT, implemented-entry=Mcu_GetResetReason
          bsw direct call point Det_ReportError: called-entry=Det_ReportError
        Mcu_GetVersionInfo: reentrancy-level=SINGLE-CORE-REENTRANT, implemented-entry=Mcu_GetVersionInfo
          bsw direct call point Det_ReportError: called-entry=Det_ReportError
        Mcu_Init: reentrancy-level=NON-REENTRANT, implemented-entry=Mcu_Init
          bsw direct call point Dem_SetEventStatus: called-entry=Dem_SetEventStatus
          bsw direct call point Det_ReportError: called-entry=Det_ReportError
        Mcu_InitClock: reentrancy-level=NON-REENTRANT, implemented-entry=Mcu_InitClock
          bsw direct call point Dem_SetEventStatus: called-entry=Dem_SetEventStatus
          bsw direct call point Det_ReportError: called-entry=Det_ReportError
        Mcu_InitRamSection: reentrancy-level=NON-REENTRANT, implemented-entry=Mcu_InitRamSection
          bsw direct call point Det_ReportError: called-entry=Det_ReportError
        Mcu_PerformReset: can-enter-exclusive-area=MCU_EXCLUSIVE_AREA_0, reentrancy-level=NON-REENTRANT, implemented-entry=Mcu_PerformReset
          bsw direct call point Dem_SetEventStatus: called-entry=Dem_SetEventStatus
          bsw direct call point Det_ReportError: called-entry=Det_ReportError
        Mcu_RegisterReadback: reentrancy-level=SINGLE-CORE-REENTRANT, implemented-entry=Mcu_RegisterReadback
          bsw direct call point Det_ReportError: called-entry=Det_ReportError
        Mcu_SetMode: reentrancy-level=SINGLE-CORE-REENTRANT, implemented-entry=Mcu_SetMode
          bsw direct call point Det_ReportError: called-entry=Det_ReportError
  bsw implementation Mcu_Impl: programming-language=C, sw-version=10.01.00, vendor-id=44, ar-release-version=4.3.1, behavior=Mcu_Behavior, vendor-specific-module-def=Mcu
    code-descriptors:
      code Files
        artifact-descriptors:
          short-label=V2::Mcu_Priv.c, category=SWSRC
          short-label=V2::Mcu_Priv.h, category=SWHDR
          short-label=V2::Mcu_Xbar.c, category=SWSRC
          short-label=V2::Mcu_Xbar.h, category=SWHDR
          short-label=V2::Mcu_XbarOutput.h, category=SWHDR
          short-label=V2::Mcu_XbarPwm.h, category=SWHDR
          short-label=generate::include::Mcu_Cfg.h, category=SWHDR
          short-label=generate::src::Mcu_Cfg.c, category=SWSRC
          short-label=generate::src::Mcu_PBcfg.c, category=SWSRC
          short-label=include::Mcu.h, category=SWHDR
          short-label=src::Mcu.c, category=SWSRC
    compiler tiarmclang: name=TI ARM Clang, options=-mcpu=cortex-r5 -mfpu=vfpv3-d16 -mfloat-abi=hard -c -mlittle-endian -ffunction-sections -gdwarf-3 -Werror -Os -x -save-temps -mthumb -DAM263PX_SIP_PACKAGE -DAM263PX_PLATFORM -DAM263PX_R_PACKAGE -DAM263PX_C_PACKAGE, vendor=Texas Instruments, version=4.0.0
    linker tiarmlnk: name=TI ARM Clang Linker, options=-mcpu=cortex-r5 -Wl,--ram_model -Wl,--reread_libs -Wl,--warn_sections -qq -Wl,--emit_warnings_as_errors --diag_suppress=10068 --diag_suppress=10063, vendor=Texas Instruments, version=4.0.0
    resource consumption ResourceConsumption
      4 x memory section:
        MCU_CODE: sw-addrmethod=CODE, symbol=CODE
        MCU_CONFIG_DATA: alignment=UNSPECIFIED, sw-addrmethod=CONFIG_DATA, symbol=CONFIG_DATA
        MCU_VAR_INIT_8: alignment=8, sw-addrmethod=VAR_INIT, symbol=VAR_INIT_8
        MCU_VAR_INIT_UNSPECIFIED: alignment=UNSPECIFIED, sw-addrmethod=VAR_INIT, symbol=VAR_INIT_UNSPECIFIED
package /Mcu_TI_AM263Px/Mcu_ModuleEntry
  13 x bsw module entry, all with is-synchronous=true, call-type=REGULAR, execution-context=UNSPECIFIED, sw-service-impl-policy=STANDARD, bsw-entry-kind=CONCRETE:
    Mcu_DeInit: service-id=11, is-reentrant=false
    Mcu_DistributePllClock: service-id=3, is-reentrant=false
    Mcu_GetPllStatus: service-id=4, is-reentrant=true
    Mcu_GetRamState: service-id=10, is-reentrant=true
    Mcu_GetResetRawValue: service-id=6, is-reentrant=true
    Mcu_GetResetReason: service-id=5, is-reentrant=true
    Mcu_GetVersionInfo: service-id=9, is-reentrant=true
    Mcu_Init: service-id=0, is-reentrant=false
    Mcu_InitClock: service-id=2, is-reentrant=false
    Mcu_InitRamSection: service-id=1, is-reentrant=false
    Mcu_PerformReset: service-id=7, is-reentrant=false
    Mcu_RegisterReadback: service-id=12, is-reentrant=true
    Mcu_SetMode: service-id=8, is-reentrant=true
