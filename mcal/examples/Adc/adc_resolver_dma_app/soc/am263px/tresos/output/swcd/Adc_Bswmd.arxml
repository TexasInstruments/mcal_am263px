AUTOSAR XML (schema 00044)
package /Adc_TI_AM263px
  bsw module description Adc: category=BSW_MODULE, module-id=123
    implemented-entrys:
      Adc_ADCINT{1..4}_IrqUnit5
      Adc_ADCINT{1..4}_IrqUnit6
      Adc_DeInit
      Adc_DisableGroupNotification
      Adc_DisableHardwareTrigger
      Adc_EnableGroupNotification
      Adc_EnableHardwareTrigger
      Adc_GetGroupStatus
      Adc_GetStreamLastPointer
      Adc_GetVersionInfo
      Adc_Init
      Adc_PollingMainFunction
      Adc_ReadGroup
      Adc_RegisterReadback
      Adc_SetupResultBuffer
      Adc_StartGroupConversion
      Adc_StopGroupConversion
    bsw module dependency Det: target-module-id=15, target-module=Det
    bsw module dependency Cdd_Dma: target-module-id=255, target-module=Cdd_Dma_ModuleEntry
    bsw internal behavior Adc_Behavior
      exclusive area ADC_EXCLUSIVE_AREA_0
      8 x bsw interrupt entity, all with reentrancy-level=NON-REENTRANT, interrupt-category=CAT-1, interrupt-source=Hardware:
        Adc_ADCINT1_IrqUnit5: implemented-entry=Adc_ADCINT1_IrqUnit5
          5 x bsw direct call point:
            Cdd_Dma_DisableTransferRegion
            Cdd_Dma_EnableTransferRegion
            Cdd_Dma_GetInitStatus
            Cdd_Dma_ParamSet
            Det_ReportRuntimeError: called-entry=Det_ReportRuntimeError
        Adc_ADCINT2_IrqUnit5: implemented-entry=Adc_ADCINT2_IrqUnit5
          5 x bsw direct call point:
            Cdd_Dma_DisableTransferRegion
            Cdd_Dma_EnableTransferRegion
            Cdd_Dma_GetInitStatus
            Cdd_Dma_ParamSet
            Det_ReportRuntimeError: called-entry=Det_ReportRuntimeError
        Adc_ADCINT3_IrqUnit5: implemented-entry=Adc_ADCINT3_IrqUnit5
          5 x bsw direct call point:
            Cdd_Dma_DisableTransferRegion
            Cdd_Dma_EnableTransferRegion
            Cdd_Dma_GetInitStatus
            Cdd_Dma_ParamSet
            Det_ReportRuntimeError: called-entry=Det_ReportRuntimeError
        Adc_ADCINT4_IrqUnit5: implemented-entry=Adc_ADCINT4_IrqUnit5
          5 x bsw direct call point:
            Cdd_Dma_DisableTransferRegion
            Cdd_Dma_EnableTransferRegion
            Cdd_Dma_GetInitStatus
            Cdd_Dma_ParamSet
            Det_ReportRuntimeError: called-entry=Det_ReportRuntimeError
        Adc_ADCINT1_IrqUnit6: implemented-entry=Adc_ADCINT1_IrqUnit6
          5 x bsw direct call point:
            Cdd_Dma_DisableTransferRegion
            Cdd_Dma_EnableTransferRegion
            Cdd_Dma_GetInitStatus
            Cdd_Dma_ParamSet
            Det_ReportRuntimeError: called-entry=Det_ReportRuntimeError
        Adc_ADCINT2_IrqUnit6: implemented-entry=Adc_ADCINT2_IrqUnit6
          5 x bsw direct call point:
            Cdd_Dma_DisableTransferRegion
            Cdd_Dma_EnableTransferRegion
            Cdd_Dma_GetInitStatus
            Cdd_Dma_ParamSet
            Det_ReportRuntimeError: called-entry=Det_ReportRuntimeError
        Adc_ADCINT3_IrqUnit6: implemented-entry=Adc_ADCINT3_IrqUnit6
          5 x bsw direct call point:
            Cdd_Dma_DisableTransferRegion
            Cdd_Dma_EnableTransferRegion
            Cdd_Dma_GetInitStatus
            Cdd_Dma_ParamSet
            Det_ReportRuntimeError: called-entry=Det_ReportRuntimeError
        Adc_ADCINT4_IrqUnit6: implemented-entry=Adc_ADCINT4_IrqUnit6
          5 x bsw direct call point:
            Cdd_Dma_DisableTransferRegion
            Cdd_Dma_EnableTransferRegion
            Cdd_Dma_GetInitStatus
            Cdd_Dma_ParamSet
            Det_ReportRuntimeError: called-entry=Det_ReportRuntimeError
      15 x bsw called entity:
        Adc_DeInit: can-enter-exclusive-area=ADC_EXCLUSIVE_AREA_0, reentrancy-level=SINGLE-CORE-REENTRANT, implemented-entry=Adc_DeInit
          bsw direct call point Det_ReportError: called-entry=Det_ReportError
          bsw direct call point Det_ReportRuntimeError: called-entry=Det_ReportRuntimeError
        Adc_DisableGroupNotification: can-enter-exclusive-area=ADC_EXCLUSIVE_AREA_0, reentrancy-level=SINGLE-CORE-REENTRANT, implemented-entry=Adc_DisableGroupNotification
          bsw direct call point Det_ReportError: called-entry=Det_ReportError
        Adc_DisableHardwareTrigger: can-enter-exclusive-area=ADC_EXCLUSIVE_AREA_0, reentrancy-level=SINGLE-CORE-REENTRANT, implemented-entry=Adc_DisableHardwareTrigger
          6 x bsw direct call point:
            Cdd_Dma_DisableTransferRegion
            Cdd_Dma_EnableTransferRegion
            Cdd_Dma_GetInitStatus
            Cdd_Dma_ParamSet
            Det_ReportError: called-entry=Det_ReportError
            Det_ReportRuntimeError: called-entry=Det_ReportRuntimeError
        Adc_EnableGroupNotification: can-enter-exclusive-area=ADC_EXCLUSIVE_AREA_0, reentrancy-level=SINGLE-CORE-REENTRANT, implemented-entry=Adc_EnableGroupNotification
          bsw direct call point Det_ReportError: called-entry=Det_ReportError
        Adc_EnableHardwareTrigger: can-enter-exclusive-area=ADC_EXCLUSIVE_AREA_0, reentrancy-level=SINGLE-CORE-REENTRANT, implemented-entry=Adc_EnableHardwareTrigger
          6 x bsw direct call point:
            Cdd_Dma_DisableTransferRegion
            Cdd_Dma_EnableTransferRegion
            Cdd_Dma_GetInitStatus
            Cdd_Dma_ParamSet
            Det_ReportError: called-entry=Det_ReportError
            Det_ReportRuntimeError: called-entry=Det_ReportRuntimeError
        Adc_GetGroupStatus: can-enter-exclusive-area=ADC_EXCLUSIVE_AREA_0, reentrancy-level=SINGLE-CORE-REENTRANT, implemented-entry=Adc_GetGroupStatus
          bsw direct call point Det_ReportError: called-entry=Det_ReportError
        Adc_GetStreamLastPointer: can-enter-exclusive-area=ADC_EXCLUSIVE_AREA_0, reentrancy-level=SINGLE-CORE-REENTRANT, implemented-entry=Adc_GetStreamLastPointer
          bsw direct call point Det_ReportError: called-entry=Det_ReportError
          bsw direct call point Det_ReportRuntimeError: called-entry=Det_ReportRuntimeError
        Adc_GetVersionInfo: reentrancy-level=SINGLE-CORE-REENTRANT, implemented-entry=Adc_GetVersionInfo
          bsw direct call point Det_ReportError: called-entry=Det_ReportError
        Adc_Init: reentrancy-level=NON-REENTRANT, implemented-entry=Adc_Init
          bsw direct call point Det_ReportError: called-entry=Det_ReportError
        Adc_PollingMainFunction: can-enter-exclusive-area=ADC_EXCLUSIVE_AREA_0, reentrancy-level=SINGLE-CORE-REENTRANT, implemented-entry=Adc_PollingMainFunction
          5 x bsw direct call point:
            Cdd_Dma_DisableTransferRegion
            Cdd_Dma_EnableTransferRegion
            Cdd_Dma_GetInitStatus
            Cdd_Dma_ParamSet
            Det_ReportRuntimeError: called-entry=Det_ReportRuntimeError
        Adc_ReadGroup: can-enter-exclusive-area=ADC_EXCLUSIVE_AREA_0, reentrancy-level=SINGLE-CORE-REENTRANT, implemented-entry=Adc_ReadGroup
          bsw direct call point Det_ReportError: called-entry=Det_ReportError
          bsw direct call point Det_ReportRuntimeError: called-entry=Det_ReportRuntimeError
        Adc_RegisterReadback: reentrancy-level=NON-REENTRANT, implemented-entry=Adc_RegisterReadback
          bsw direct call point Det_ReportError: called-entry=Det_ReportError
        Adc_SetupResultBuffer: can-enter-exclusive-area=ADC_EXCLUSIVE_AREA_0, reentrancy-level=SINGLE-CORE-REENTRANT, implemented-entry=Adc_SetupResultBuffer
          bsw direct call point Det_ReportError: called-entry=Det_ReportError
          bsw direct call point Det_ReportRuntimeError: called-entry=Det_ReportRuntimeError
        Adc_StartGroupConversion: can-enter-exclusive-area=ADC_EXCLUSIVE_AREA_0, reentrancy-level=SINGLE-CORE-REENTRANT, implemented-entry=Adc_StartGroupConversion
          6 x bsw direct call point:
            Cdd_Dma_DisableTransferRegion
            Cdd_Dma_EnableTransferRegion
            Cdd_Dma_GetInitStatus
            Cdd_Dma_ParamSet
            Det_ReportError: called-entry=Det_ReportError
            Det_ReportRuntimeError: called-entry=Det_ReportRuntimeError
        Adc_StopGroupConversion: can-enter-exclusive-area=ADC_EXCLUSIVE_AREA_0, reentrancy-level=SINGLE-CORE-REENTRANT, implemented-entry=Adc_StopGroupConversion
          6 x bsw direct call point:
            Cdd_Dma_DisableTransferRegion
            Cdd_Dma_EnableTransferRegion
            Cdd_Dma_GetInitStatus
            Cdd_Dma_ParamSet
            Det_ReportError: called-entry=Det_ReportError
            Det_ReportRuntimeError: called-entry=Det_ReportRuntimeError
  bsw implementation Adc_Impl: programming-language=C, sw-version=10.01.00, vendor-id=44, ar-release-version=4.3.1, behavior=Adc_Behavior, vendor-specific-module-def=Adc
    code-descriptors:
      code Files
        artifact-descriptors:
          short-label=V0::Adc_Dbg.h, category=SWHDR
          short-label=V0::Adc_Irq.c, category=SWSRC
          short-label=V0::Adc_Irq.h, category=SWHDR
          short-label=V0::Adc_Platform.c, category=SWSRC
          short-label=V0::Adc_Platform.h, category=SWHDR
          short-label=V0::Adc_Priv.c, category=SWSRC
          short-label=V0::Adc_Priv.h, category=SWHDR
          short-label=V0::Adc_Reg.h, category=SWHDR
          short-label=V0::Adc_RegResult.h, category=SWHDR
          short-label=V0::Adc_Types.h, category=SWHDR
          short-label=V0::Adc_Utils.c, category=SWSRC
          short-label=V0::Adc_Utils.h, category=SWHDR
          short-label=generate::include::Adc_Cfg.h, category=SWHDR
          short-label=generate::src::Adc_Cfg.c, category=SWSRC
          short-label=generate::src::Adc_PBcfg.c, category=SWSRC
          short-label=include::Adc.h, category=SWHDR
          short-label=src::Adc.c, category=SWSRC
    compiler tiarmclang: name=TI ARM Clang, options=-mcpu=cortex-r5 -mfpu=vfpv3-d16 -mfloat-abi=hard -c -mlittle-endian -ffunction-sections -gdwarf-3 -Werror -Os -x -save-temps -mthumb -DAM263PX_SIP_PACKAGE -DAM263PX_PLATFORM -DAM263PX_R_PACKAGE -DAM263PX_C_PACKAGE, vendor=Texas Instruments, version=4.0.0
    linker tiarmlnk: name=TI ARM Clang Linker, options=-mcpu=cortex-r5 -Wl,--ram_model -Wl,--reread_libs -Wl,--warn_sections -qq -Wl,--emit_warnings_as_errors --diag_suppress=10068 --diag_suppress=10063, vendor=Texas Instruments, version=4.0.0
    resource consumption ResourceConsumption
      5 x memory section:
        ADC_CODE: alignment=UNSPECIFIED, sw-addrmethod=CODE, symbol=CODE
        ADC_CONFIG_DATA: alignment=UNSPECIFIED, sw-addrmethod=CONFIG_DATA, symbol=CONFIG_DATA
        ADC_ISR_CODE: alignment=UNSPECIFIED, sw-addrmethod=CODE, symbol=ISR_CODE
        ADC_VAR_INIT_32: alignment=32, sw-addrmethod=VAR_INIT, symbol=VAR_INIT_32
        ADC_VAR_NO_INIT_UNSPECIFIED: alignment=UNSPECIFIED, sw-addrmethod=VAR_NO_INIT, symbol=VAR_NO_INIT_UNSPECIFIED
package /Adc_TI_AM263px/Adc_ModuleEntry
  43 x bsw module entry, all with sw-service-impl-policy=STANDARD, bsw-entry-kind=CONCRETE:
    Adc_ADCINT1_IrqUnit{0..6}: is-reentrant=false, is-synchronous=true, call-type=INTERRUPT, execution-context=INTERRUPT-CAT-1
    Adc_ADCINT2_IrqUnit{0..6}: is-reentrant=false, is-synchronous=true, call-type=INTERRUPT, execution-context=INTERRUPT-CAT-1
    Adc_ADCINT3_IrqUnit{0..6}: is-reentrant=false, is-synchronous=true, call-type=INTERRUPT, execution-context=INTERRUPT-CAT-1
    Adc_ADCINT4_IrqUnit{0..6}: is-reentrant=false, is-synchronous=true, call-type=INTERRUPT, execution-context=INTERRUPT-CAT-1
    Adc_DeInit: service-id=1, is-reentrant=true, is-synchronous=true, call-type=REGULAR, execution-context=UNSPECIFIED
    Adc_DisableGroupNotification: service-id=8, is-reentrant=true, is-synchronous=true, call-type=REGULAR, execution-context=UNSPECIFIED
    Adc_DisableHardwareTrigger: service-id=6, is-reentrant=true, is-synchronous=true, call-type=REGULAR, execution-context=UNSPECIFIED
    Adc_EnableGroupNotification: service-id=7, is-reentrant=true, is-synchronous=true, call-type=REGULAR, execution-context=UNSPECIFIED
    Adc_EnableHardwareTrigger: service-id=5, is-reentrant=true, is-synchronous=true, call-type=REGULAR, execution-context=UNSPECIFIED
    Adc_GetGroupStatus: service-id=9, is-reentrant=true, is-synchronous=true, call-type=REGULAR, execution-context=UNSPECIFIED
    Adc_GetStreamLastPointer: service-id=11, is-reentrant=true, is-synchronous=true, call-type=REGULAR, execution-context=UNSPECIFIED
    Adc_GetVersionInfo: service-id=10, is-reentrant=true, is-synchronous=true, call-type=REGULAR, execution-context=UNSPECIFIED
    Adc_Init: service-id=0, is-reentrant=false, is-synchronous=true, call-type=REGULAR, execution-context=UNSPECIFIED
    Adc_PollingMainFunction: service-id=21, is-reentrant=true, is-synchronous=true, call-type=REGULAR, execution-context=UNSPECIFIED
    Adc_ReadGroup: service-id=4, is-reentrant=true, is-synchronous=true, call-type=REGULAR, execution-context=UNSPECIFIED
    Adc_RegisterReadback: service-id=22, is-reentrant=false, is-synchronous=true, call-type=REGULAR, execution-context=UNSPECIFIED
    Adc_SetupResultBuffer: service-id=12, is-reentrant=true, is-synchronous=true, call-type=REGULAR, execution-context=UNSPECIFIED
    Adc_StartGroupConversion: service-id=2, is-reentrant=true, is-synchronous=false, call-type=REGULAR, execution-context=UNSPECIFIED
    Adc_StopGroupConversion: service-id=3, is-reentrant=true, is-synchronous=true, call-type=REGULAR, execution-context=UNSPECIFIED
